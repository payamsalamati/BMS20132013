/**
** Project Name : FeLiX
** Software Version : 4.2301.0
** Model Name : BMSAlgorithmInterface
** File Type : A2L
** Author : Anika.Klein
** Date : Wed Mar 22 09:06:34 2023
** Copyright : (c) KION Battery Systems GmbH, Karlstein am Main 2022 - All right reserved
** Short Description : A2L for BMS Algorithm
** Detailed Description : A2L file of BMS Algorithm for features:
KBSInterface, stateOfCharge, capacityEstimation, currentDerating,
heatingStrategy and dataProcessing.
** Modification History : 22.03.2023 : First Draft for 4.2301.0
**/ ASAP2_VERSION 1 71
/* Version 1.71 */
/begin PROJECT ProjectName "Project Comment Goes Here"
/begin HEADER "Header Comments go here" /end HEADER
/begin MODULE ModuleName "Module Comment Goes Here"
/begin MOD_PAR "MOD PAR Comment Goes Here" /end MOD_PAR
/begin MOD_COMMON "Mod Common Comment Here" BYTE_ORDER MSB_FIRST ALIGNMENT_BYTE 1 ALIGNMENT_WORD 2 ALIGNMENT_LONG 4 ALIGNMENT_FLOAT32_IEEE 4 ALIGNMENT_FLOAT64_IEEE 8 ALIGNMENT_INT64 8 /end MOD_COMMON
/begin MEASUREMENT Interface_main_100ms_rtZeventMonitor.diagnosticEvent_10.data_individualSnapshot "" UBYTE CM_uint8 0 0 0 255 ECU_ADDRESS 0x0000 DISPLAY_IDENTIFIER diagnosticEvent_10_KBS_data_individualSnapshot /end MEASUREMENT
/begin MEASUREMENT Interface_main_100ms_rtZeventMonitor.diagnosticEvent_10.identifier_diagnosticEvent "" UWORD CM_uint16 0 0 0 65535 ECU_ADDRESS 0x0000 DISPLAY_IDENTIFIER diagnosticEvent_10_KBS_identifier_diagnosticEvent /end MEASUREMENT
/begin MEASUREMENT Interface_main_100ms_rtZeventMonitor.diagnosticEvent_10.size_individualSnapshot "" ULONG CM_uint32 0 0 0 2147483646 ECU_ADDRESS 0x0000 DISPLAY_IDENTIFIER diagnosticEvent_10_KBS_size_individualSnapshot /end MEASUREMENT
/begin MEASUREMENT Interface_main_100ms_rtZeventMonitor.diagnosticEvent_10.status_diagnosticEvent "" UBYTE CM_ENUM_DIAGNOSTIC_EVENT 0 0 0 1 ECU_ADDRESS 0x0000 DISPLAY_IDENTIFIER diagnosticEvent_10_KBS_status_diagnosticEvent /end MEASUREMENT
/begin MEASUREMENT Interface_main_100ms_rtZeventMonitor.diagnosticEvent_11.data_individualSnapshot "" UBYTE CM_uint8 0 0 0 255 ECU_ADDRESS 0x0000 DISPLAY_IDENTIFIER diagnosticEvent_11_KBS_data_individualSnapshot /end MEASUREMENT
/begin MEASUREMENT Interface_main_100ms_rtZeventMonitor.diagnosticEvent_11.identifier_diagnosticEvent "" UWORD CM_uint16 0 0 0 65535 ECU_ADDRESS 0x0000 DISPLAY_IDENTIFIER diagnosticEvent_11_KBS_identifier_diagnosticEvent /end MEASUREMENT
/begin MEASUREMENT Interface_main_100ms_rtZeventMonitor.diagnosticEvent_11.size_individualSnapshot "" ULONG CM_uint32 0 0 0 2147483646 ECU_ADDRESS 0x0000 DISPLAY_IDENTIFIER diagnosticEvent_11_KBS_size_individualSnapshot /end MEASUREMENT
/begin MEASUREMENT Interface_main_100ms_rtZeventMonitor.diagnosticEvent_11.status_diagnosticEvent "" UBYTE CM_ENUM_DIAGNOSTIC_EVENT 0 0 0 1 ECU_ADDRESS 0x0000 DISPLAY_IDENTIFIER diagnosticEvent_11_KBS_status_diagnosticEvent /end MEASUREMENT
/begin MEASUREMENT Interface_main_100ms_rtZeventMonitor.diagnosticEvent_12.data_individualSnapshot "" UBYTE CM_uint8 0 0 0 255 ECU_ADDRESS 0x0000 DISPLAY_IDENTIFIER diagnosticEvent_12_KBS_data_individualSnapshot /end MEASUREMENT
/begin MEASUREMENT Interface_main_100ms_rtZeventMonitor.diagnosticEvent_12.identifier_diagnosticEvent "" UWORD CM_uint16 0 0 0 65535 ECU_ADDRESS 0x0000 DISPLAY_IDENTIFIER diagnosticEvent_12_KBS_identifier_diagnosticEvent /end MEASUREMENT
/begin MEASUREMENT Interface_main_100ms_rtZeventMonitor.diagnosticEvent_12.size_individualSnapshot "" ULONG CM_uint32 0 0 0 2147483646 ECU_ADDRESS 0x0000 DISPLAY_IDENTIFIER diagnosticEvent_12_KBS_size_individualSnapshot /end MEASUREMENT
/begin MEASUREMENT Interface_main_100ms_rtZeventMonitor.diagnosticEvent_12.status_diagnosticEvent "" UBYTE CM_ENUM_DIAGNOSTIC_EVENT 0 0 0 1 ECU_ADDRESS 0x0000 DISPLAY_IDENTIFIER diagnosticEvent_12_KBS_status_diagnosticEvent /end MEASUREMENT
/begin MEASUREMENT Interface_main_100ms_rtZeventMonitor.diagnosticEvent_13.data_individualSnapshot "" UBYTE CM_uint8 0 0 0 255 ECU_ADDRESS 0x0000 DISPLAY_IDENTIFIER diagnosticEvent_13_KBS_data_individualSnapshot /end MEASUREMENT
/begin MEASUREMENT Interface_main_100ms_rtZeventMonitor.diagnosticEvent_13.identifier_diagnosticEvent "" UWORD CM_uint16 0 0 0 65535 ECU_ADDRESS 0x0000 DISPLAY_IDENTIFIER diagnosticEvent_13_KBS_identifier_diagnosticEvent /end MEASUREMENT
/begin MEASUREMENT Interface_main_100ms_rtZeventMonitor.diagnosticEvent_13.size_individualSnapshot "" ULONG CM_uint32 0 0 0 2147483646 ECU_ADDRESS 0x0000 DISPLAY_IDENTIFIER diagnosticEvent_13_KBS_size_individualSnapshot /end MEASUREMENT
/begin MEASUREMENT Interface_main_100ms_rtZeventMonitor.diagnosticEvent_13.status_diagnosticEvent "" UBYTE CM_ENUM_DIAGNOSTIC_EVENT 0 0 0 1 ECU_ADDRESS 0x0000 DISPLAY_IDENTIFIER diagnosticEvent_13_KBS_status_diagnosticEvent /end MEASUREMENT
/begin MEASUREMENT Interface_main_100ms_rtZeventMonitor.diagnosticEvent_14.data_individualSnapshot "" UBYTE CM_uint8 0 0 0 255 ECU_ADDRESS 0x0000 DISPLAY_IDENTIFIER diagnosticEvent_14_KBS_data_individualSnapshot /end MEASUREMENT
/begin MEASUREMENT Interface_main_100ms_rtZeventMonitor.diagnosticEvent_14.identifier_diagnosticEvent "" UWORD CM_uint16 0 0 0 65535 ECU_ADDRESS 0x0000 DISPLAY_IDENTIFIER diagnosticEvent_14_KBS_identifier_diagnosticEvent /end MEASUREMENT
/begin MEASUREMENT Interface_main_100ms_rtZeventMonitor.diagnosticEvent_14.size_individualSnapshot "" ULONG CM_uint32 0 0 0 2147483646 ECU_ADDRESS 0x0000 DISPLAY_IDENTIFIER diagnosticEvent_14_KBS_size_individualSnapshot /end MEASUREMENT
/begin MEASUREMENT Interface_main_100ms_rtZeventMonitor.diagnosticEvent_14.status_diagnosticEvent "" UBYTE CM_ENUM_DIAGNOSTIC_EVENT 0 0 0 1 ECU_ADDRESS 0x0000 DISPLAY_IDENTIFIER diagnosticEvent_14_KBS_status_diagnosticEvent /end MEASUREMENT
/begin MEASUREMENT Interface_main_100ms_rtZeventMonitor.diagnosticEvent_15.data_individualSnapshot "" UBYTE CM_uint8 0 0 0 255 ECU_ADDRESS 0x0000 DISPLAY_IDENTIFIER diagnosticEvent_15_KBS_data_individualSnapshot /end MEASUREMENT
/begin MEASUREMENT Interface_main_100ms_rtZeventMonitor.diagnosticEvent_15.identifier_diagnosticEvent "" UWORD CM_uint16 0 0 0 65535 ECU_ADDRESS 0x0000 DISPLAY_IDENTIFIER diagnosticEvent_15_KBS_identifier_diagnosticEvent /end MEASUREMENT
/begin MEASUREMENT Interface_main_100ms_rtZeventMonitor.diagnosticEvent_15.size_individualSnapshot "" ULONG CM_uint32 0 0 0 2147483646 ECU_ADDRESS 0x0000 DISPLAY_IDENTIFIER diagnosticEvent_15_KBS_size_individualSnapshot /end MEASUREMENT
/begin MEASUREMENT Interface_main_100ms_rtZeventMonitor.diagnosticEvent_15.status_diagnosticEvent "" UBYTE CM_ENUM_DIAGNOSTIC_EVENT 0 0 0 1 ECU_ADDRESS 0x0000 DISPLAY_IDENTIFIER diagnosticEvent_15_KBS_status_diagnosticEvent /end MEASUREMENT
/begin MEASUREMENT Interface_main_100ms_rtZeventMonitor.diagnosticEvent_16.data_individualSnapshot "" UBYTE CM_uint8 0 0 0 255 ECU_ADDRESS 0x0000 DISPLAY_IDENTIFIER diagnosticEvent_16_KBS_data_individualSnapshot /end MEASUREMENT
/begin MEASUREMENT Interface_main_100ms_rtZeventMonitor.diagnosticEvent_16.identifier_diagnosticEvent "" UWORD CM_uint16 0 0 0 65535 ECU_ADDRESS 0x0000 DISPLAY_IDENTIFIER diagnosticEvent_16_KBS_identifier_diagnosticEvent /end MEASUREMENT
/begin MEASUREMENT Interface_main_100ms_rtZeventMonitor.diagnosticEvent_16.size_individualSnapshot "" ULONG CM_uint32 0 0 0 2147483646 ECU_ADDRESS 0x0000 DISPLAY_IDENTIFIER diagnosticEvent_16_KBS_size_individualSnapshot /end MEASUREMENT
/begin MEASUREMENT Interface_main_100ms_rtZeventMonitor.diagnosticEvent_16.status_diagnosticEvent "" UBYTE CM_ENUM_DIAGNOSTIC_EVENT 0 0 0 1 ECU_ADDRESS 0x0000 DISPLAY_IDENTIFIER diagnosticEvent_16_KBS_status_diagnosticEvent /end MEASUREMENT
/begin MEASUREMENT Interface_main_100ms_rtZeventMonitor.diagnosticEvent_17.data_individualSnapshot "" UBYTE CM_uint8 0 0 0 255 ECU_ADDRESS 0x0000 DISPLAY_IDENTIFIER diagnosticEvent_17_KBS_data_individualSnapshot /end MEASUREMENT
/begin MEASUREMENT Interface_main_100ms_rtZeventMonitor.diagnosticEvent_17.identifier_diagnosticEvent "" UWORD CM_uint16 0 0 0 65535 ECU_ADDRESS 0x0000 DISPLAY_IDENTIFIER diagnosticEvent_17_KBS_identifier_diagnosticEvent /end MEASUREMENT
/begin MEASUREMENT Interface_main_100ms_rtZeventMonitor.diagnosticEvent_17.size_individualSnapshot "" ULONG CM_uint32 0 0 0 2147483646 ECU_ADDRESS 0x0000 DISPLAY_IDENTIFIER diagnosticEvent_17_KBS_size_individualSnapshot /end MEASUREMENT
/begin MEASUREMENT Interface_main_100ms_rtZeventMonitor.diagnosticEvent_17.status_diagnosticEvent "" UBYTE CM_ENUM_DIAGNOSTIC_EVENT 0 0 0 1 ECU_ADDRESS 0x0000 DISPLAY_IDENTIFIER diagnosticEvent_17_KBS_status_diagnosticEvent /end MEASUREMENT
/begin MEASUREMENT Interface_main_100ms_rtZeventMonitor.diagnosticEvent_18.data_individualSnapshot "" UBYTE CM_uint8 0 0 0 255 ECU_ADDRESS 0x0000 DISPLAY_IDENTIFIER diagnosticEvent_18_KBS_data_individualSnapshot /end MEASUREMENT
/begin MEASUREMENT Interface_main_100ms_rtZeventMonitor.diagnosticEvent_18.identifier_diagnosticEvent "" UWORD CM_uint16 0 0 0 65535 ECU_ADDRESS 0x0000 DISPLAY_IDENTIFIER diagnosticEvent_18_KBS_identifier_diagnosticEvent /end MEASUREMENT
/begin MEASUREMENT Interface_main_100ms_rtZeventMonitor.diagnosticEvent_18.size_individualSnapshot "" ULONG CM_uint32 0 0 0 2147483646 ECU_ADDRESS 0x0000 DISPLAY_IDENTIFIER diagnosticEvent_18_KBS_size_individualSnapshot /end MEASUREMENT
/begin MEASUREMENT Interface_main_100ms_rtZeventMonitor.diagnosticEvent_18.status_diagnosticEvent "" UBYTE CM_ENUM_DIAGNOSTIC_EVENT 0 0 0 1 ECU_ADDRESS 0x0000 DISPLAY_IDENTIFIER diagnosticEvent_18_KBS_status_diagnosticEvent /end MEASUREMENT
/begin MEASUREMENT Interface_main_100ms_rtZeventMonitor.diagnosticEvent_19.data_individualSnapshot "" UBYTE CM_uint8 0 0 0 255 ECU_ADDRESS 0x0000 DISPLAY_IDENTIFIER diagnosticEvent_19_KBS_data_individualSnapshot /end MEASUREMENT
/begin MEASUREMENT Interface_main_100ms_rtZeventMonitor.diagnosticEvent_19.identifier_diagnosticEvent "" UWORD CM_uint16 0 0 0 65535 ECU_ADDRESS 0x0000 DISPLAY_IDENTIFIER diagnosticEvent_19_KBS_identifier_diagnosticEvent /end MEASUREMENT
/begin MEASUREMENT Interface_main_100ms_rtZeventMonitor.diagnosticEvent_19.size_individualSnapshot "" ULONG CM_uint32 0 0 0 2147483646 ECU_ADDRESS 0x0000 DISPLAY_IDENTIFIER diagnosticEvent_19_KBS_size_individualSnapshot /end MEASUREMENT
/begin MEASUREMENT Interface_main_100ms_rtZeventMonitor.diagnosticEvent_19.status_diagnosticEvent "" UBYTE CM_ENUM_DIAGNOSTIC_EVENT 0 0 0 1 ECU_ADDRESS 0x0000 DISPLAY_IDENTIFIER diagnosticEvent_19_KBS_status_diagnosticEvent /end MEASUREMENT
/begin MEASUREMENT Interface_main_100ms_rtZeventMonitor.diagnosticEvent_1.data_individualSnapshot "" UBYTE CM_uint8 0 0 0 255 ECU_ADDRESS 0x0000 DISPLAY_IDENTIFIER diagnosticEvent_1_KBS_data_individualSnapshot /end MEASUREMENT
/begin MEASUREMENT Interface_main_100ms_rtZeventMonitor.diagnosticEvent_1.identifier_diagnosticEvent "" UWORD CM_uint16 0 0 0 65535 ECU_ADDRESS 0x0000 DISPLAY_IDENTIFIER diagnosticEvent_1_KBS_identifier_diagnosticEvent /end MEASUREMENT
/begin MEASUREMENT Interface_main_100ms_rtZeventMonitor.diagnosticEvent_1.size_individualSnapshot "" ULONG CM_uint32 0 0 0 2147483646 ECU_ADDRESS 0x0000 DISPLAY_IDENTIFIER diagnosticEvent_1_KBS_size_individualSnapshot /end MEASUREMENT
/begin MEASUREMENT Interface_main_100ms_rtZeventMonitor.diagnosticEvent_1.status_diagnosticEvent "" UBYTE CM_ENUM_DIAGNOSTIC_EVENT 0 0 0 1 ECU_ADDRESS 0x0000 DISPLAY_IDENTIFIER diagnosticEvent_1_KBS_status_diagnosticEvent /end MEASUREMENT
/begin MEASUREMENT Interface_main_100ms_rtZeventMonitor.diagnosticEvent_20.data_individualSnapshot "" UBYTE CM_uint8 0 0 0 255 ECU_ADDRESS 0x0000 DISPLAY_IDENTIFIER diagnosticEvent_20_KBS_data_individualSnapshot /end MEASUREMENT
/begin MEASUREMENT Interface_main_100ms_rtZeventMonitor.diagnosticEvent_20.identifier_diagnosticEvent "" UWORD CM_uint16 0 0 0 65535 ECU_ADDRESS 0x0000 DISPLAY_IDENTIFIER diagnosticEvent_20_KBS_identifier_diagnosticEvent /end MEASUREMENT
/begin MEASUREMENT Interface_main_100ms_rtZeventMonitor.diagnosticEvent_20.size_individualSnapshot "" ULONG CM_uint32 0 0 0 2147483646 ECU_ADDRESS 0x0000 DISPLAY_IDENTIFIER diagnosticEvent_20_KBS_size_individualSnapshot /end MEASUREMENT
/begin MEASUREMENT Interface_main_100ms_rtZeventMonitor.diagnosticEvent_20.status_diagnosticEvent "" UBYTE CM_ENUM_DIAGNOSTIC_EVENT 0 0 0 1 ECU_ADDRESS 0x0000 DISPLAY_IDENTIFIER diagnosticEvent_20_KBS_status_diagnosticEvent /end MEASUREMENT
/begin MEASUREMENT Interface_main_100ms_rtZeventMonitor.diagnosticEvent_21.data_individualSnapshot "" UBYTE CM_uint8 0 0 0 255 ECU_ADDRESS 0x0000 DISPLAY_IDENTIFIER diagnosticEvent_21_KBS_data_individualSnapshot /end MEASUREMENT
/begin MEASUREMENT Interface_main_100ms_rtZeventMonitor.diagnosticEvent_21.identifier_diagnosticEvent "" UWORD CM_uint16 0 0 0 65535 ECU_ADDRESS 0x0000 DISPLAY_IDENTIFIER diagnosticEvent_21_KBS_identifier_diagnosticEvent /end MEASUREMENT
/begin MEASUREMENT Interface_main_100ms_rtZeventMonitor.diagnosticEvent_21.size_individualSnapshot "" ULONG CM_uint32 0 0 0 2147483646 ECU_ADDRESS 0x0000 DISPLAY_IDENTIFIER diagnosticEvent_21_KBS_size_individualSnapshot /end MEASUREMENT
/begin MEASUREMENT Interface_main_100ms_rtZeventMonitor.diagnosticEvent_21.status_diagnosticEvent "" UBYTE CM_ENUM_DIAGNOSTIC_EVENT 0 0 0 1 ECU_ADDRESS 0x0000 DISPLAY_IDENTIFIER diagnosticEvent_21_KBS_status_diagnosticEvent /end MEASUREMENT
/begin MEASUREMENT Interface_main_100ms_rtZeventMonitor.diagnosticEvent_22.data_individualSnapshot "" UBYTE CM_uint8 0 0 0 255 ECU_ADDRESS 0x0000 DISPLAY_IDENTIFIER diagnosticEvent_22_KBS_data_individualSnapshot /end MEASUREMENT
/begin MEASUREMENT Interface_main_100ms_rtZeventMonitor.diagnosticEvent_22.identifier_diagnosticEvent "" UWORD CM_uint16 0 0 0 65535 ECU_ADDRESS 0x0000 DISPLAY_IDENTIFIER diagnosticEvent_22_KBS_identifier_diagnosticEvent /end MEASUREMENT
/begin MEASUREMENT Interface_main_100ms_rtZeventMonitor.diagnosticEvent_22.size_individualSnapshot "" ULONG CM_uint32 0 0 0 2147483646 ECU_ADDRESS 0x0000 DISPLAY_IDENTIFIER diagnosticEvent_22_KBS_size_individualSnapshot /end MEASUREMENT
/begin MEASUREMENT Interface_main_100ms_rtZeventMonitor.diagnosticEvent_22.status_diagnosticEvent "" UBYTE CM_ENUM_DIAGNOSTIC_EVENT 0 0 0 1 ECU_ADDRESS 0x0000 DISPLAY_IDENTIFIER diagnosticEvent_22_KBS_status_diagnosticEvent /end MEASUREMENT
/begin MEASUREMENT Interface_main_100ms_rtZeventMonitor.diagnosticEvent_2.data_individualSnapshot "" UBYTE CM_uint8 0 0 0 255 ECU_ADDRESS 0x0000 DISPLAY_IDENTIFIER diagnosticEvent_2_KBS_data_individualSnapshot /end MEASUREMENT
/begin MEASUREMENT Interface_main_100ms_rtZeventMonitor.diagnosticEvent_2.identifier_diagnosticEvent "" UWORD CM_uint16 0 0 0 65535 ECU_ADDRESS 0x0000 DISPLAY_IDENTIFIER diagnosticEvent_2_KBS_identifier_diagnosticEvent /end MEASUREMENT
/begin MEASUREMENT Interface_main_100ms_rtZeventMonitor.diagnosticEvent_2.size_individualSnapshot "" ULONG CM_uint32 0 0 0 2147483646 ECU_ADDRESS 0x0000 DISPLAY_IDENTIFIER diagnosticEvent_2_KBS_size_individualSnapshot /end MEASUREMENT
/begin MEASUREMENT Interface_main_100ms_rtZeventMonitor.diagnosticEvent_2.status_diagnosticEvent "" UBYTE CM_ENUM_DIAGNOSTIC_EVENT 0 0 0 1 ECU_ADDRESS 0x0000 DISPLAY_IDENTIFIER diagnosticEvent_2_KBS_status_diagnosticEvent /end MEASUREMENT
/begin MEASUREMENT Interface_main_100ms_rtZeventMonitor.diagnosticEvent_3.data_individualSnapshot "" UBYTE CM_uint8 0 0 0 255 ECU_ADDRESS 0x0000 DISPLAY_IDENTIFIER diagnosticEvent_3_KBS_data_individualSnapshot /end MEASUREMENT
/begin MEASUREMENT Interface_main_100ms_rtZeventMonitor.diagnosticEvent_3.identifier_diagnosticEvent "" UWORD CM_uint16 0 0 0 65535 ECU_ADDRESS 0x0000 DISPLAY_IDENTIFIER diagnosticEvent_3_KBS_identifier_diagnosticEvent /end MEASUREMENT
/begin MEASUREMENT Interface_main_100ms_rtZeventMonitor.diagnosticEvent_3.size_individualSnapshot "" ULONG CM_uint32 0 0 0 2147483646 ECU_ADDRESS 0x0000 DISPLAY_IDENTIFIER diagnosticEvent_3_KBS_size_individualSnapshot /end MEASUREMENT
/begin MEASUREMENT Interface_main_100ms_rtZeventMonitor.diagnosticEvent_3.status_diagnosticEvent "" UBYTE CM_ENUM_DIAGNOSTIC_EVENT 0 0 0 1 ECU_ADDRESS 0x0000 DISPLAY_IDENTIFIER diagnosticEvent_3_KBS_status_diagnosticEvent /end MEASUREMENT
/begin MEASUREMENT Interface_main_100ms_rtZeventMonitor.diagnosticEvent_4.data_individualSnapshot "" UBYTE CM_uint8 0 0 0 255 ECU_ADDRESS 0x0000 DISPLAY_IDENTIFIER diagnosticEvent_4_KBS_data_individualSnapshot /end MEASUREMENT
/begin MEASUREMENT Interface_main_100ms_rtZeventMonitor.diagnosticEvent_4.identifier_diagnosticEvent "" UWORD CM_uint16 0 0 0 65535 ECU_ADDRESS 0x0000 DISPLAY_IDENTIFIER diagnosticEvent_4_KBS_identifier_diagnosticEvent /end MEASUREMENT
/begin MEASUREMENT Interface_main_100ms_rtZeventMonitor.diagnosticEvent_4.size_individualSnapshot "" ULONG CM_uint32 0 0 0 2147483646 ECU_ADDRESS 0x0000 DISPLAY_IDENTIFIER diagnosticEvent_4_KBS_size_individualSnapshot /end MEASUREMENT
/begin MEASUREMENT Interface_main_100ms_rtZeventMonitor.diagnosticEvent_4.status_diagnosticEvent "" UBYTE CM_ENUM_DIAGNOSTIC_EVENT 0 0 0 1 ECU_ADDRESS 0x0000 DISPLAY_IDENTIFIER diagnosticEvent_4_KBS_status_diagnosticEvent /end MEASUREMENT
/begin MEASUREMENT Interface_main_100ms_rtZeventMonitor.diagnosticEvent_5.data_individualSnapshot "" UBYTE CM_uint8 0 0 0 255 ECU_ADDRESS 0x0000 DISPLAY_IDENTIFIER diagnosticEvent_5_KBS_data_individualSnapshot /end MEASUREMENT
/begin MEASUREMENT Interface_main_100ms_rtZeventMonitor.diagnosticEvent_5.identifier_diagnosticEvent "" UWORD CM_uint16 0 0 0 65535 ECU_ADDRESS 0x0000 DISPLAY_IDENTIFIER diagnosticEvent_5_KBS_identifier_diagnosticEvent /end MEASUREMENT
/begin MEASUREMENT Interface_main_100ms_rtZeventMonitor.diagnosticEvent_5.size_individualSnapshot "" ULONG CM_uint32 0 0 0 2147483646 ECU_ADDRESS 0x0000 DISPLAY_IDENTIFIER diagnosticEvent_5_KBS_size_individualSnapshot /end MEASUREMENT
/begin MEASUREMENT Interface_main_100ms_rtZeventMonitor.diagnosticEvent_5.status_diagnosticEvent "" UBYTE CM_ENUM_DIAGNOSTIC_EVENT 0 0 0 1 ECU_ADDRESS 0x0000 DISPLAY_IDENTIFIER diagnosticEvent_5_KBS_status_diagnosticEvent /end MEASUREMENT
/begin MEASUREMENT Interface_main_100ms_rtZeventMonitor.diagnosticEvent_6.data_individualSnapshot "" UBYTE CM_uint8 0 0 0 255 ECU_ADDRESS 0x0000 DISPLAY_IDENTIFIER diagnosticEvent_6_KBS_data_individualSnapshot /end MEASUREMENT
/begin MEASUREMENT Interface_main_100ms_rtZeventMonitor.diagnosticEvent_6.identifier_diagnosticEvent "" UWORD CM_uint16 0 0 0 65535 ECU_ADDRESS 0x0000 DISPLAY_IDENTIFIER diagnosticEvent_6_KBS_identifier_diagnosticEvent /end MEASUREMENT
/begin MEASUREMENT Interface_main_100ms_rtZeventMonitor.diagnosticEvent_6.size_individualSnapshot "" ULONG CM_uint32 0 0 0 2147483646 ECU_ADDRESS 0x0000 DISPLAY_IDENTIFIER diagnosticEvent_6_KBS_size_individualSnapshot /end MEASUREMENT
/begin MEASUREMENT Interface_main_100ms_rtZeventMonitor.diagnosticEvent_6.status_diagnosticEvent "" UBYTE CM_ENUM_DIAGNOSTIC_EVENT 0 0 0 1 ECU_ADDRESS 0x0000 DISPLAY_IDENTIFIER diagnosticEvent_6_KBS_status_diagnosticEvent /end MEASUREMENT
/begin MEASUREMENT Interface_main_100ms_rtZeventMonitor.diagnosticEvent_7.data_individualSnapshot "" UBYTE CM_uint8 0 0 0 255 ECU_ADDRESS 0x0000 DISPLAY_IDENTIFIER diagnosticEvent_7_KBS_data_individualSnapshot /end MEASUREMENT
/begin MEASUREMENT Interface_main_100ms_rtZeventMonitor.diagnosticEvent_7.identifier_diagnosticEvent "" UWORD CM_uint16 0 0 0 65535 ECU_ADDRESS 0x0000 DISPLAY_IDENTIFIER diagnosticEvent_7_KBS_identifier_diagnosticEvent /end MEASUREMENT
/begin MEASUREMENT Interface_main_100ms_rtZeventMonitor.diagnosticEvent_7.size_individualSnapshot "" ULONG CM_uint32 0 0 0 2147483646 ECU_ADDRESS 0x0000 DISPLAY_IDENTIFIER diagnosticEvent_7_KBS_size_individualSnapshot /end MEASUREMENT
/begin MEASUREMENT Interface_main_100ms_rtZeventMonitor.diagnosticEvent_7.status_diagnosticEvent "" UBYTE CM_ENUM_DIAGNOSTIC_EVENT 0 0 0 1 ECU_ADDRESS 0x0000 DISPLAY_IDENTIFIER diagnosticEvent_7_KBS_status_diagnosticEvent /end MEASUREMENT
/begin MEASUREMENT Interface_main_100ms_rtZeventMonitor.diagnosticEvent_8.data_individualSnapshot "" UBYTE CM_uint8 0 0 0 255 ECU_ADDRESS 0x0000 DISPLAY_IDENTIFIER diagnosticEvent_8_KBS_data_individualSnapshot /end MEASUREMENT
/begin MEASUREMENT Interface_main_100ms_rtZeventMonitor.diagnosticEvent_8.identifier_diagnosticEvent "" UWORD CM_uint16 0 0 0 65535 ECU_ADDRESS 0x0000 DISPLAY_IDENTIFIER diagnosticEvent_8_KBS_identifier_diagnosticEvent /end MEASUREMENT
/begin MEASUREMENT Interface_main_100ms_rtZeventMonitor.diagnosticEvent_8.size_individualSnapshot "" ULONG CM_uint32 0 0 0 2147483646 ECU_ADDRESS 0x0000 DISPLAY_IDENTIFIER diagnosticEvent_8_KBS_size_individualSnapshot /end MEASUREMENT
/begin MEASUREMENT Interface_main_100ms_rtZeventMonitor.diagnosticEvent_8.status_diagnosticEvent "" UBYTE CM_ENUM_DIAGNOSTIC_EVENT 0 0 0 1 ECU_ADDRESS 0x0000 DISPLAY_IDENTIFIER diagnosticEvent_8_KBS_status_diagnosticEvent /end MEASUREMENT
/begin MEASUREMENT Interface_main_100ms_rtZeventMonitor.diagnosticEvent_9.data_individualSnapshot "" UBYTE CM_uint8 0 0 0 255 ECU_ADDRESS 0x0000 DISPLAY_IDENTIFIER diagnosticEvent_9_KBS_data_individualSnapshot /end MEASUREMENT
/begin MEASUREMENT Interface_main_100ms_rtZeventMonitor.diagnosticEvent_9.identifier_diagnosticEvent "" UWORD CM_uint16 0 0 0 65535 ECU_ADDRESS 0x0000 DISPLAY_IDENTIFIER diagnosticEvent_9_KBS_identifier_diagnosticEvent /end MEASUREMENT
/begin MEASUREMENT Interface_main_100ms_rtZeventMonitor.diagnosticEvent_9.size_individualSnapshot "" ULONG CM_uint32 0 0 0 2147483646 ECU_ADDRESS 0x0000 DISPLAY_IDENTIFIER diagnosticEvent_9_KBS_size_individualSnapshot /end MEASUREMENT
/begin MEASUREMENT Interface_main_100ms_rtZeventMonitor.diagnosticEvent_9.status_diagnosticEvent "" UBYTE CM_ENUM_DIAGNOSTIC_EVENT 0 0 0 1 ECU_ADDRESS 0x0000 DISPLAY_IDENTIFIER diagnosticEvent_9_KBS_status_diagnosticEvent /end MEASUREMENT
/begin MEASUREMENT Interface_main_100msrtB.OCV_Map_Cell "" UWORD CM_uint16_m_into_V 0 0 0 65535 LAYOUT COLUMN_DIR MATRIX_DIM 8 15 ECU_ADDRESS 0x0000 DISPLAY_IDENTIFIER OCV_Map_Cell /end MEASUREMENT
/begin MEASUREMENT Interface_main_100msrtB.PWM_BCM_Out "" UWORD CM_uint16_percent_ 0 0 0 65535 ECU_ADDRESS 0x0000 DISPLAY_IDENTIFIER PWM_BCM_Out /end MEASUREMENT
/begin MEASUREMENT Interface_main_100msrtB.SOC_Handler_Battery "" ULONG CM_uint32_percent_ 0 0 0 4294967295 ECU_ADDRESS 0x0000 DISPLAY_IDENTIFIER SOC_Handler_Battery /end MEASUREMENT
/begin MEASUREMENT Interface_main_100msrtB.SOC_Kernel_Battery "" ULONG CM_uint32_percent_ 0 0 0 4294967295 ECU_ADDRESS 0x0000 DISPLAY_IDENTIFIER SOC_Kernel_Battery /end MEASUREMENT
/begin MEASUREMENT Interface_main_100msrtB.SOC_Kernel_Cell "" ULONG CM_uint32_percent_ 0 0 0 4294967295 LAYOUT COLUMN_DIR MATRIX_DIM 8 15 ECU_ADDRESS 0x0000 DISPLAY_IDENTIFIER SOC_Kernel_Cell /end MEASUREMENT
/begin MEASUREMENT Interface_main_100msrtB.SOC_Kernel_Module "" ULONG CM_uint32_percent_ 0 0 0 4294967295 LAYOUT COLUMN_DIR MATRIX_DIM 8 1 ECU_ADDRESS 0x0000 DISPLAY_IDENTIFIER SOC_Kernel_Module /end MEASUREMENT
/begin MEASUREMENT Interface_main_100msrtB.SOC_Map_Cell "" ULONG CM_uint32_percent_ 0 0 0 4294967295 LAYOUT COLUMN_DIR MATRIX_DIM 8 15 ECU_ADDRESS 0x0000 DISPLAY_IDENTIFIER SOC_Map_Cell /end MEASUREMENT
/begin MEASUREMENT Interface_main_100msrtB.SOCwithSOH "" UWORD CM_uint16_percent_ 0 0 0 65535 ECU_ADDRESS 0x0000 DISPLAY_IDENTIFIER SOCwithSOH /end MEASUREMENT
/begin MEASUREMENT Interface_main_100msrtB.SOCwithoutSOH "" UWORD CM_uint16_percent_ 0 0 0 65535 ECU_ADDRESS 0x0000 DISPLAY_IDENTIFIER SOCwithoutSOH /end MEASUREMENT
/begin MEASUREMENT Interface_main_100msrtB.avgCellVoltage_Module "" UWORD CM_uint16_m_into_V 0 0 0 65535 LAYOUT COLUMN_DIR MATRIX_DIM 8 1 ECU_ADDRESS 0x0000 DISPLAY_IDENTIFIER avgCellVoltage_Module /end MEASUREMENT
/begin MEASUREMENT Interface_main_100msrtB.avgCellVoltage_Pack "" UWORD CM_uint16_m_into_V 0 0 0 65535 ECU_ADDRESS 0x0000 DISPLAY_IDENTIFIER avgCellVoltage_Pack /end MEASUREMENT
/begin MEASUREMENT Interface_main_100msrtB.avgCurrent_Heating "" SLONG CM_int32_m_into_A 0 0 -50000 2147483647 ECU_ADDRESS 0x0000 DISPLAY_IDENTIFIER avgCurrent_Heating /end MEASUREMENT
/begin MEASUREMENT Interface_main_100msrtB.avgTemperature_Module "" SWORD CM_int16_deg_C 0 0 -40 32767 LAYOUT COLUMN_DIR MATRIX_DIM 8 1 ECU_ADDRESS 0x0000 DISPLAY_IDENTIFIER avgTemperature_Module /end MEASUREMENT
/begin MEASUREMENT Interface_main_100msrtB.avgTemperature_Pack "" SWORD CM_int16_deg_C 0 0 -40 32767 ECU_ADDRESS 0x0000 DISPLAY_IDENTIFIER avgTemperature_Pack /end MEASUREMENT
/begin MEASUREMENT Interface_main_100msrtB.blockIdentifier_capacityEstimation "" ULONG CM_uint32 0 0 0 4294967295 ECU_ADDRESS 0x0000 DISPLAY_IDENTIFIER blockIdentifier_capacityEstimation /end MEASUREMENT
/begin MEASUREMENT Interface_main_100msrtB.blockIdentifier_currentDerating "" ULONG CM_uint32 0 0 0 4294967295 ECU_ADDRESS 0x0000 DISPLAY_IDENTIFIER blockIdentifier_currentDerating /end MEASUREMENT
/begin MEASUREMENT Interface_main_100msrtB.blockIdentifier_dataProcessing "" ULONG CM_uint32 0 0 0 4294967295 ECU_ADDRESS 0x0000 DISPLAY_IDENTIFIER blockIdentifier_dataProcessing /end MEASUREMENT
/begin MEASUREMENT Interface_main_100msrtB.blockIdentifier_heatingStrategy "" ULONG CM_uint32 0 0 0 4294967295 ECU_ADDRESS 0x0000 DISPLAY_IDENTIFIER blockIdentifier_heatingStrategy /end MEASUREMENT
/begin MEASUREMENT Interface_main_100msrtB.blockIdentifier_stateOfCharge "" ULONG CM_uint32 0 0 0 4294967295 ECU_ADDRESS 0x0000 DISPLAY_IDENTIFIER blockIdentifier_stateOfCharge /end MEASUREMENT
/begin MEASUREMENT Interface_main_100msrtB.capabilityFactor_BrakingResistor "" UWORD CM_uint16_percent_ 0 0 0 65535 ECU_ADDRESS 0x0000 DISPLAY_IDENTIFIER capabilityFactor_BrakingResistor /end MEASUREMENT
/begin MEASUREMENT Interface_main_100msrtB.capacity_Table_Cell "" ULONG CM_uint32_m_into_A_into_h 0 0 0 4294967295 LAYOUT COLUMN_DIR MATRIX_DIM 8 15 ECU_ADDRESS 0x0000 DISPLAY_IDENTIFIER capacity_Table_Cell /end MEASUREMENT
/begin MEASUREMENT Interface_main_100msrtB.cellNumber "" UWORD CM_uint16 0 0 0 65535 ECU_ADDRESS 0x0000 DISPLAY_IDENTIFIER cellNumber /end MEASUREMENT
/begin MEASUREMENT Interface_main_100msrtB.correctionFactor_RelativeChange "" ULONG CM_uint32_percent_ 0 0 0 4294967295 ECU_ADDRESS 0x0000 DISPLAY_IDENTIFIER correctionFactor_RelativeChange /end MEASUREMENT
/begin MEASUREMENT Interface_main_100msrtB.correctionFactor_RelativeChange_Charging "" ULONG CM_uint32_percent_ 0 0 0 4294967295 ECU_ADDRESS 0x0000 DISPLAY_IDENTIFIER correctionFactor_RelativeChange_Charging /end MEASUREMENT
/begin MEASUREMENT Interface_main_100msrtB.counter_capacityEstimation "" ULONG CM_uint32 0 0 0 4294967295 ECU_ADDRESS 0x0000 DISPLAY_IDENTIFIER counter_capacityEstimation /end MEASUREMENT
/begin MEASUREMENT Interface_main_100msrtB.counter_currentDerating "" ULONG CM_uint32 0 0 0 4294967295 ECU_ADDRESS 0x0000 DISPLAY_IDENTIFIER counter_currentDerating /end MEASUREMENT
/begin MEASUREMENT Interface_main_100msrtB.counter_dataProcessing "" ULONG CM_uint32 0 0 0 4294967295 ECU_ADDRESS 0x0000 DISPLAY_IDENTIFIER counter_dataProcessing /end MEASUREMENT
/begin MEASUREMENT Interface_main_100msrtB.counter_heatingStrategy "" ULONG CM_uint32 0 0 0 4294967295 ECU_ADDRESS 0x0000 DISPLAY_IDENTIFIER counter_heatingStrategy /end MEASUREMENT
/begin MEASUREMENT Interface_main_100msrtB.counter_stateOfCharge "" ULONG CM_uint32 0 0 0 4294967295 ECU_ADDRESS 0x0000 DISPLAY_IDENTIFIER counter_stateOfCharge /end MEASUREMENT
/begin MEASUREMENT Interface_main_100msrtB.currentLimited "" UBYTE CM_ENUM_CURRENTLIMITED 0 0 0 3 ECU_ADDRESS 0x0000 DISPLAY_IDENTIFIER currentLimited /end MEASUREMENT
/begin MEASUREMENT Interface_main_100msrtB.deltaChangeResidual_SOC "" SLONG CM_int32_percent_ 0 0 -100000 2147483647 ECU_ADDRESS 0x0000 DISPLAY_IDENTIFIER deltaChangeResidual_SOC /end MEASUREMENT
/begin MEASUREMENT Interface_main_100msrtB.deltaChange_SOC "" SLONG CM_int32_percent_ 0 0 -100000 2147483647 ECU_ADDRESS 0x0000 DISPLAY_IDENTIFIER deltaChange_SOC /end MEASUREMENT
/begin MEASUREMENT Interface_main_100msrtB.deltaChange_SOC_CCM "" SLONG CM_int32_percent_ 0 0 -100000 2147483647 ECU_ADDRESS 0x0000 DISPLAY_IDENTIFIER deltaChange_SOC_CCM /end MEASUREMENT
/begin MEASUREMENT Interface_main_100msrtB.deratingFactor_MaxCellVoltage "" UWORD CM_uint16_percent_ 0 0 0 65535 ECU_ADDRESS 0x0000 DISPLAY_IDENTIFIER deratingFactor_MaxCellVoltage /end MEASUREMENT
/begin MEASUREMENT Interface_main_100msrtB.deratingFactor_MaxDrive "" UWORD CM_uint16_percent_ 0 0 0 65535 ECU_ADDRESS 0x0000 DISPLAY_IDENTIFIER deratingFactor_MaxDrive /end MEASUREMENT
/begin MEASUREMENT Interface_main_100msrtB.deratingFactor_MaxRegeneration "" UWORD CM_uint16_percent_ 0 0 0 65535 ECU_ADDRESS 0x0000 DISPLAY_IDENTIFIER deratingFactor_MaxRegeneration /end MEASUREMENT
/begin MEASUREMENT Interface_main_100msrtB.deratingFactor_MinCellVoltage "" UWORD CM_uint16_percent_ 0 0 0 65535 ECU_ADDRESS 0x0000 DISPLAY_IDENTIFIER deratingFactor_MinCellVoltage /end MEASUREMENT
/begin MEASUREMENT Interface_main_100msrtB.designCapacity_BOL "" ULONG CM_uint32_m_into_A_into_h 0 0 0 4294967295 ECU_ADDRESS 0x0000 DISPLAY_IDENTIFIER designCapacity_BOL /end MEASUREMENT
/begin MEASUREMENT Interface_main_100msrtB.designCapacity_SOH "" ULONG CM_uint32_m_into_A_into_h 0 0 0 4294967295 ECU_ADDRESS 0x0000 DISPLAY_IDENTIFIER designCapacity_SOH /end MEASUREMENT
/begin MEASUREMENT Interface_main_100msrtB.fullChargeCapacity "" ULONG CM_uint32_m_into_A_into_h 0 0 0 4294967295 ECU_ADDRESS 0x0000 DISPLAY_IDENTIFIER fullChargeCapacity /end MEASUREMENT
/begin MEASUREMENT Interface_main_100msrtB.fullChargeCapacity_Max "" ULONG CM_uint32_m_into_A_into_h 0 0 0 4294967295 ECU_ADDRESS 0x0000 DISPLAY_IDENTIFIER fullChargeCapacity_Max /end MEASUREMENT
/begin MEASUREMENT Interface_main_100msrtB.fullChargeCapacity_Useable "" ULONG CM_uint32_m_into_A_into_h 0 0 0 4294967295 ECU_ADDRESS 0x0000 DISPLAY_IDENTIFIER fullChargeCapacity_Useable /end MEASUREMENT
/begin MEASUREMENT Interface_main_100msrtB.fullChargeEnergy "" ULONG CM_uint32_W_into_h 0 0 0 4294967295 ECU_ADDRESS 0x0000 DISPLAY_IDENTIFIER fullChargeEnergy /end MEASUREMENT
/begin MEASUREMENT Interface_main_100msrtB.fullChargeEnergy_Max "" ULONG CM_uint32_W_into_h 0 0 0 4294967295 ECU_ADDRESS 0x0000 DISPLAY_IDENTIFIER fullChargeEnergy_Max /end MEASUREMENT
/begin MEASUREMENT Interface_main_100msrtB.fullChargeEnergy_Useable "" ULONG CM_uint32_W_into_h 0 0 0 4294967295 ECU_ADDRESS 0x0000 DISPLAY_IDENTIFIER fullChargeEnergy_Useable /end MEASUREMENT
/begin MEASUREMENT Interface_main_100msrtB.fullChargeHysteresis_SOC "" UWORD CM_uint16_percent_ 0 0 0 65535 ECU_ADDRESS 0x0000 DISPLAY_IDENTIFIER fullChargeHysteresis_SOC /end MEASUREMENT
/begin MEASUREMENT Interface_main_100msrtB.fullDischargeHysteresis_SOC "" UWORD CM_uint16_percent_ 0 0 0 65535 ECU_ADDRESS 0x0000 DISPLAY_IDENTIFIER fullDischargeHysteresis_SOC /end MEASUREMENT
/begin MEASUREMENT Interface_main_100msrtB.heatingEnergyImbalance_Module "" ULONG CM_uint32_W_into_s 0 0 0 4294967295 LAYOUT COLUMN_DIR MATRIX_DIM 8 1 ECU_ADDRESS 0x0000 DISPLAY_IDENTIFIER heatingEnergyImbalance_Module /end MEASUREMENT
/begin MEASUREMENT Interface_main_100msrtB.heatingEnergy_Module "" ULONG CM_uint32_W_into_s 0 0 0 4294967295 LAYOUT COLUMN_DIR MATRIX_DIM 8 1 ECU_ADDRESS 0x0000 DISPLAY_IDENTIFIER heatingEnergy_Module /end MEASUREMENT
/begin MEASUREMENT Interface_main_100msrtB.heatingTime "" ULONG CM_uint32_s 0 0 0 4294967295 ECU_ADDRESS 0x0000 DISPLAY_IDENTIFIER heatingTime /end MEASUREMENT
/begin MEASUREMENT Interface_main_100msrtB.highestSOCImbalance "" UWORD CM_uint16_percent_ 0 0 0 65535 ECU_ADDRESS 0x0000 DISPLAY_IDENTIFIER highestSOCImbalance /end MEASUREMENT
/begin MEASUREMENT Interface_main_100msrtB.hysteresisTemperature_Heating "" SWORD CM_int16_deg_C 0 0 -40 32767 ECU_ADDRESS 0x0000 DISPLAY_IDENTIFIER hysteresisTemperature_Heating /end MEASUREMENT
/begin MEASUREMENT Interface_main_100msrtB.impedance_Battery "" ULONG CM_uint32_m_into_Ohm 0 0 0 4294967295 ECU_ADDRESS 0x0000 DISPLAY_IDENTIFIER impedance_Battery /end MEASUREMENT
/begin MEASUREMENT Interface_main_100msrtB.integratedCurrent_Battery "" SLONG CM_int32_m_into_A_into_s 0 0 -1000000 2147483647 ECU_ADDRESS 0x0000 DISPLAY_IDENTIFIER integratedCurrent_Battery /end MEASUREMENT
/begin MEASUREMENT Interface_main_100msrtB.interfaceVersion_capacityEstimation "" UWORD CM_uint16 0 0 0 65535 ECU_ADDRESS 0x0000 DISPLAY_IDENTIFIER interfaceVersion_capacityEstimation /end MEASUREMENT
/begin MEASUREMENT Interface_main_100msrtB.interfaceVersion_currentDerating "" UWORD CM_uint16 0 0 0 65535 ECU_ADDRESS 0x0000 DISPLAY_IDENTIFIER interfaceVersion_currentDerating /end MEASUREMENT
/begin MEASUREMENT Interface_main_100msrtB.interfaceVersion_dataProcessing "" UWORD CM_uint16 0 0 0 65535 ECU_ADDRESS 0x0000 DISPLAY_IDENTIFIER interfaceVersion_dataProcessing /end MEASUREMENT
/begin MEASUREMENT Interface_main_100msrtB.interfaceVersion_heatingStrategy "" UWORD CM_uint16 0 0 0 65535 ECU_ADDRESS 0x0000 DISPLAY_IDENTIFIER interfaceVersion_heatingStrategy /end MEASUREMENT
/begin MEASUREMENT Interface_main_100msrtB.interfaceVersion_stateOfCharge "" UWORD CM_uint16 0 0 0 65535 ECU_ADDRESS 0x0000 DISPLAY_IDENTIFIER interfaceVersion_stateOfCharge /end MEASUREMENT
/begin MEASUREMENT Interface_main_100msrtB.internalResistanceCharged_Cell "" ULONG CM_uint32___into_Ohm 0 0 0 4294967295 LAYOUT COLUMN_DIR MATRIX_DIM 8 15 ECU_ADDRESS 0x0000 DISPLAY_IDENTIFIER internalResistanceCharged_Cell /end MEASUREMENT
/begin MEASUREMENT Interface_main_100msrtB.internalResistanceDischarged_Cell "" ULONG CM_uint32___into_Ohm 0 0 0 4294967295 LAYOUT COLUMN_DIR MATRIX_DIM 8 15 ECU_ADDRESS 0x0000 DISPLAY_IDENTIFIER internalResistanceDischarged_Cell /end MEASUREMENT
/begin MEASUREMENT Interface_main_100msrtB.linearChange "" ULONG CM_uint32_m_into_A_per_s 0 0 0 4294967295 ECU_ADDRESS 0x0000 DISPLAY_IDENTIFIER linearChange /end MEASUREMENT
/begin MEASUREMENT Interface_main_100msrtB.maxCellVoltage_Module "" UWORD CM_uint16_m_into_V 0 0 0 65535 LAYOUT COLUMN_DIR MATRIX_DIM 8 1 ECU_ADDRESS 0x0000 DISPLAY_IDENTIFIER maxCellVoltage_Module /end MEASUREMENT
/begin MEASUREMENT Interface_main_100msrtB.maxCellVoltage_Pack "" UWORD CM_uint16_m_into_V 0 0 0 65535 ECU_ADDRESS 0x0000 DISPLAY_IDENTIFIER maxCellVoltage_Pack /end MEASUREMENT
/begin MEASUREMENT Interface_main_100msrtB.maxChargeCurrent_Continuous "" ULONG CM_uint32_m_into_A 0 0 0 4294967295 ECU_ADDRESS 0x0000 DISPLAY_IDENTIFIER maxChargeCurrent_Continuous /end MEASUREMENT
/begin MEASUREMENT Interface_main_100msrtB.maxChargeCurrent_Continuous_woHeating "" ULONG CM_uint32_m_into_A 0 0 0 4294967295 ECU_ADDRESS 0x0000 DISPLAY_IDENTIFIER maxChargeCurrent_Continuous_woHeating /end MEASUREMENT
/begin MEASUREMENT Interface_main_100msrtB.maxChargeCurrent_Pulse "" ULONG CM_uint32_m_into_A 0 0 0 4294967295 ECU_ADDRESS 0x0000 DISPLAY_IDENTIFIER maxChargeCurrent_Pulse /end MEASUREMENT
/begin MEASUREMENT Interface_main_100msrtB.maxChargeCurrent_Pulse_Balancing "" ULONG CM_uint32_m_into_A 0 0 0 4294967295 LAYOUT COLUMN_DIR MATRIX_DIM 8 15 ECU_ADDRESS 0x0000 DISPLAY_IDENTIFIER maxChargeCurrent_Pulse_Balancing /end MEASUREMENT
/begin MEASUREMENT Interface_main_100msrtB.maxChargePower_Continuous "" ULONG CM_uint32_W 0 0 0 4294967295 ECU_ADDRESS 0x0000 DISPLAY_IDENTIFIER maxChargePower_Continuous /end MEASUREMENT
/begin MEASUREMENT Interface_main_100msrtB.maxChargePower_Pulse "" ULONG CM_uint32_W 0 0 0 4294967295 ECU_ADDRESS 0x0000 DISPLAY_IDENTIFIER maxChargePower_Pulse /end MEASUREMENT
/begin MEASUREMENT Interface_main_100msrtB.maxCurrent_Heating "" SLONG CM_int32_m_into_A 0 0 -50000 2147483647 ECU_ADDRESS 0x0000 DISPLAY_IDENTIFIER maxCurrent_Heating /end MEASUREMENT
/begin MEASUREMENT Interface_main_100msrtB.maxDeratingFactor "" UWORD CM_uint16_percent_ 0 0 0 65535 ECU_ADDRESS 0x0000 DISPLAY_IDENTIFIER maxDeratingFactor /end MEASUREMENT
/begin MEASUREMENT Interface_main_100msrtB.maxDeratingFactor_Charging "" UWORD CM_uint16_percent_ 0 0 0 65535 ECU_ADDRESS 0x0000 DISPLAY_IDENTIFIER maxDeratingFactor_Charging /end MEASUREMENT
/begin MEASUREMENT Interface_main_100msrtB.maxDischargeCurrent_Continuous "" ULONG CM_uint32_m_into_A 0 0 0 4294967295 ECU_ADDRESS 0x0000 DISPLAY_IDENTIFIER maxDischargeCurrent_Continuous /end MEASUREMENT
/begin MEASUREMENT Interface_main_100msrtB.maxDischargeCurrent_Pulse "" ULONG CM_uint32_m_into_A 0 0 0 4294967295 ECU_ADDRESS 0x0000 DISPLAY_IDENTIFIER maxDischargeCurrent_Pulse /end MEASUREMENT
/begin MEASUREMENT Interface_main_100msrtB.maxDischargeCurrent_Pulse_Balancing "" ULONG CM_uint32_m_into_A 0 0 0 4294967295 LAYOUT COLUMN_DIR MATRIX_DIM 8 15 ECU_ADDRESS 0x0000 DISPLAY_IDENTIFIER maxDischargeCurrent_Pulse_Balancing /end MEASUREMENT
/begin MEASUREMENT Interface_main_100msrtB.maxDischargePower_Continuous "" ULONG CM_uint32_W 0 0 0 4294967295 ECU_ADDRESS 0x0000 DISPLAY_IDENTIFIER maxDischargePower_Continuous /end MEASUREMENT
/begin MEASUREMENT Interface_main_100msrtB.maxDischargePower_Pulse "" ULONG CM_uint32_W 0 0 0 4294967295 ECU_ADDRESS 0x0000 DISPLAY_IDENTIFIER maxDischargePower_Pulse /end MEASUREMENT
/begin MEASUREMENT Interface_main_100msrtB.maxSOC "" UWORD CM_uint16_percent_ 0 0 0 65535 ECU_ADDRESS 0x0000 DISPLAY_IDENTIFIER maxSOC /end MEASUREMENT
/begin MEASUREMENT Interface_main_100msrtB.maxTemperature_Module "" SWORD CM_int16_deg_C 0 0 -40 32767 LAYOUT COLUMN_DIR MATRIX_DIM 8 1 ECU_ADDRESS 0x0000 DISPLAY_IDENTIFIER maxTemperature_Module /end MEASUREMENT
/begin MEASUREMENT Interface_main_100msrtB.maxTemperature_Pack "" SWORD CM_int16_deg_C 0 0 -40 32767 ECU_ADDRESS 0x0000 DISPLAY_IDENTIFIER maxTemperature_Pack /end MEASUREMENT
/begin MEASUREMENT Interface_main_100msrtB.minCellVoltage_Module "" UWORD CM_uint16_m_into_V 0 0 0 65535 LAYOUT COLUMN_DIR MATRIX_DIM 8 1 ECU_ADDRESS 0x0000 DISPLAY_IDENTIFIER minCellVoltage_Module /end MEASUREMENT
/begin MEASUREMENT Interface_main_100msrtB.minCellVoltage_Pack "" UWORD CM_uint16_m_into_V 0 0 0 65535 ECU_ADDRESS 0x0000 DISPLAY_IDENTIFIER minCellVoltage_Pack /end MEASUREMENT
/begin MEASUREMENT Interface_main_100msrtB.minCurrent_Heating "" SLONG CM_int32_m_into_A 0 0 -50000 2147483647 ECU_ADDRESS 0x0000 DISPLAY_IDENTIFIER minCurrent_Heating /end MEASUREMENT
/begin MEASUREMENT Interface_main_100msrtB.minHeatingEnergy_String "" ULONG CM_uint32_W_into_s 0 0 0 4294967295 LAYOUT COLUMN_DIR MATRIX_DIM 8 1 ECU_ADDRESS 0x0000 DISPLAY_IDENTIFIER minHeatingEnergy_String /end MEASUREMENT
/begin MEASUREMENT Interface_main_100msrtB.minSOC "" UWORD CM_uint16_percent_ 0 0 0 65535 ECU_ADDRESS 0x0000 DISPLAY_IDENTIFIER minSOC /end MEASUREMENT
/begin MEASUREMENT Interface_main_100msrtB.minTemperature_Module "" SWORD CM_int16_deg_C 0 0 -40 32767 LAYOUT COLUMN_DIR MATRIX_DIM 8 1 ECU_ADDRESS 0x0000 DISPLAY_IDENTIFIER minTemperature_Module /end MEASUREMENT
/begin MEASUREMENT Interface_main_100msrtB.minTemperature_Pack "" SWORD CM_int16_deg_C 0 0 -40 32767 ECU_ADDRESS 0x0000 DISPLAY_IDENTIFIER minTemperature_Pack /end MEASUREMENT
/begin MEASUREMENT Interface_main_100msrtB.relaxationTime "" ULONG CM_uint32_m_into_s 0 0 0 4294967295 ECU_ADDRESS 0x0000 DISPLAY_IDENTIFIER relaxationTime /end MEASUREMENT
/begin MEASUREMENT Interface_main_100msrtB.remainingCapacity_Actual "" ULONG CM_uint32_m_into_A_into_h 0 0 0 4294967295 ECU_ADDRESS 0x0000 DISPLAY_IDENTIFIER remainingCapacity_Actual /end MEASUREMENT
/begin MEASUREMENT Interface_main_100msrtB.remainingCapacity_Actual_Cell "" ULONG CM_uint32_m_into_A_into_h 0 0 0 4294967295 LAYOUT COLUMN_DIR MATRIX_DIM 8 15 ECU_ADDRESS 0x0000 DISPLAY_IDENTIFIER remainingCapacity_Actual_Cell /end MEASUREMENT
/begin MEASUREMENT Interface_main_100msrtB.remainingCapacity_Useable "" ULONG CM_uint32_m_into_A_into_h 0 0 0 4294967295 ECU_ADDRESS 0x0000 DISPLAY_IDENTIFIER remainingCapacity_Useable /end MEASUREMENT
/begin MEASUREMENT Interface_main_100msrtB.set_heating_Module "" UBYTE CM_ENUM_GET_SET 0 0 0 1 LAYOUT ROW_DIR MATRIX_DIM 8 1 ECU_ADDRESS 0x0000 DISPLAY_IDENTIFIER set_heating_Module /end MEASUREMENT
/begin MEASUREMENT Interface_main_100msrtB.state_Handler_stateOfCharge "" UBYTE CM_ENUM_STATE_HANDLER_SOC 0 0 0 2 ECU_ADDRESS 0x0000 DISPLAY_IDENTIFIER state_Handler_stateOfCharge /end MEASUREMENT
/begin MEASUREMENT Interface_main_100msrtB.state_Kernel_heatingStrategy "" UBYTE CM_ENUM_STATE_KERNEL_HEATING 0 0 0 7 ECU_ADDRESS 0x0000 DISPLAY_IDENTIFIER state_Kernel_heatingStrategy /end MEASUREMENT
/begin MEASUREMENT Interface_main_100msrtB.state_Kernel_stateOfCharge "" UBYTE CM_ENUM_STATE_KERNEL_SOC 0 0 0 6 ECU_ADDRESS 0x0000 DISPLAY_IDENTIFIER state_Kernel_stateOfCharge /end MEASUREMENT
/begin MEASUREMENT Interface_main_100msrtB.state_energyBalance_Module "" UBYTE CM_ENUM_STATE_ENERGYBALANCE_MODULE 0 0 0 4 LAYOUT COLUMN_DIR MATRIX_DIM 8 1 ECU_ADDRESS 0x0000 DISPLAY_IDENTIFIER state_energyBalance_Module /end MEASUREMENT
/begin MEASUREMENT Interface_main_100msrtB.state_heating_Battery "" UBYTE CM_ENUM_STATE_HEATING 0 0 0 1 ECU_ADDRESS 0x0000 DISPLAY_IDENTIFIER state_heating_Battery /end MEASUREMENT
/begin MEASUREMENT Interface_main_100msrtB.state_relaxation_SOC "" UBYTE CM_ENUM_TRUE_FALSE 0 0 0 1 ECU_ADDRESS 0x0000 DISPLAY_IDENTIFIER state_relaxation_SOC /end MEASUREMENT
/begin MEASUREMENT Interface_main_100msrtB.state_sleepCompensation_SOC "" UBYTE CM_ENUM_TRUE_FALSE 0 0 0 1 ECU_ADDRESS 0x0000 DISPLAY_IDENTIFIER state_sleepCompensation_SOC /end MEASUREMENT
/begin MEASUREMENT Interface_main_100msrtB.state_temperature_Module "" UBYTE CM_ENUM_STATE_TEMPERATURE_MODULE 0 0 0 3 LAYOUT COLUMN_DIR MATRIX_DIM 8 1 ECU_ADDRESS 0x0000 DISPLAY_IDENTIFIER state_temperature_Module /end MEASUREMENT
/begin MEASUREMENT Interface_main_100msrtB.status_Init_capacityEstimation "" UBYTE CM_ENUM_STATUS 0 0 0 2 ECU_ADDRESS 0x0000 DISPLAY_IDENTIFIER status_Init_capacityEstimation /end MEASUREMENT
/begin MEASUREMENT Interface_main_100msrtB.status_Init_currentDerating "" UBYTE CM_ENUM_STATUS 0 0 0 2 ECU_ADDRESS 0x0000 DISPLAY_IDENTIFIER status_Init_currentDerating /end MEASUREMENT
/begin MEASUREMENT Interface_main_100msrtB.status_Init_dataProcessing "" UBYTE CM_ENUM_STATUS 0 0 0 2 ECU_ADDRESS 0x0000 DISPLAY_IDENTIFIER status_Init_dataProcessing /end MEASUREMENT
/begin MEASUREMENT Interface_main_100msrtB.status_Init_heatingStrategy "" UBYTE CM_ENUM_STATUS 0 0 0 2 ECU_ADDRESS 0x0000 DISPLAY_IDENTIFIER status_Init_heatingStrategy /end MEASUREMENT
/begin MEASUREMENT Interface_main_100msrtB.status_Init_stateOfCharge "" UBYTE CM_ENUM_STATUS 0 0 0 2 ECU_ADDRESS 0x0000 DISPLAY_IDENTIFIER status_Init_stateOfCharge /end MEASUREMENT
/begin MEASUREMENT Interface_main_100msrtB.status_capacityEstimation "" UBYTE CM_ENUM_STATUS 0 0 0 2 ECU_ADDRESS 0x0000 DISPLAY_IDENTIFIER status_capacityEstimation /end MEASUREMENT
/begin MEASUREMENT Interface_main_100msrtB.status_currentDerating "" UBYTE CM_ENUM_STATUS 0 0 0 2 ECU_ADDRESS 0x0000 DISPLAY_IDENTIFIER status_currentDerating /end MEASUREMENT
/begin MEASUREMENT Interface_main_100msrtB.status_dataProcessing "" UBYTE CM_ENUM_STATUS 0 0 0 2 ECU_ADDRESS 0x0000 DISPLAY_IDENTIFIER status_dataProcessing /end MEASUREMENT
/begin MEASUREMENT Interface_main_100msrtB.status_heatingStrategy "" UBYTE CM_ENUM_STATUS 0 0 0 2 ECU_ADDRESS 0x0000 DISPLAY_IDENTIFIER status_heatingStrategy /end MEASUREMENT
/begin MEASUREMENT Interface_main_100msrtB.status_stateOfCharge "" UBYTE CM_ENUM_STATUS 0 0 0 2 ECU_ADDRESS 0x0000 DISPLAY_IDENTIFIER status_stateOfCharge /end MEASUREMENT
/begin MEASUREMENT Interface_main_100msrtB.targetTemperature_Heating "" SWORD CM_int16_deg_C 0 0 -40 32767 ECU_ADDRESS 0x0000 DISPLAY_IDENTIFIER targetTemperature_Heating /end MEASUREMENT
/begin MEASUREMENT Interface_main_100msrtB.totalCurrent_Heating "" ULONG CM_uint32_m_into_A 0 0 0 4294967295 ECU_ADDRESS 0x0000 DISPLAY_IDENTIFIER totalCurrent_Heating /end MEASUREMENT
/begin MEASUREMENT Interface_main_100msrtB.useableSOC_Factory "" UWORD CM_uint16_percent_ 0 0 0 65535 ECU_ADDRESS 0x0000 DISPLAY_IDENTIFIER useableSOC_Factory /end MEASUREMENT
/begin MEASUREMENT Interface_main_100msrtB.useableSOC_Service "" UWORD CM_uint16_percent_ 0 0 0 65535 ECU_ADDRESS 0x0000 DISPLAY_IDENTIFIER useableSOC_Service /end MEASUREMENT
/begin MEASUREMENT Interface_main_100msrtB.useableSOH_Nominal "" UWORD CM_uint16_percent_ 0 0 0 65535 ECU_ADDRESS 0x0000 DISPLAY_IDENTIFIER useableSOH_Nominal /end MEASUREMENT
/begin MEASUREMENT Interface_main_100msrtB.voltage_Module "" ULONG CM_uint32_m_into_V 0 0 0 4294967295 LAYOUT COLUMN_DIR MATRIX_DIM 8 1 ECU_ADDRESS 0x0000 DISPLAY_IDENTIFIER voltage_Module /end MEASUREMENT
/begin AXIS_PTS bins_PWM "" 0x0000 NO_INPUT_QUANTITY Scalar_UWORD_Bin_21 0 CM_uint16_percent_ 21 0 65535 /end AXIS_PTS
/begin AXIS_PTS bins_SOC_CellMap "" 0x0000 NO_INPUT_QUANTITY Scalar_SWORD_Bin_21 0 CM_int16_percent_ 21 0 32767 /end AXIS_PTS
/begin AXIS_PTS bins_SOC_CurrentMap "" 0x0000 NO_INPUT_QUANTITY Scalar_SWORD_Bin_11 0 CM_int16_percent_ 11 0 32767 /end AXIS_PTS
/begin AXIS_PTS bins_temperature_CellMap "" 0x0000 NO_INPUT_QUANTITY Scalar_SWORD_Bin_21 0 CM_int16_deg_C 21 -40 32767 /end AXIS_PTS
/begin AXIS_PTS bins_temperature_CurrentMap "" 0x0000 NO_INPUT_QUANTITY Scalar_SWORD_Bin_14 0 CM_int16_deg_C 14 -40 32767 /end AXIS_PTS
/begin AXIS_PTS bins_temperature_ModuleTable "" 0x0000 NO_INPUT_QUANTITY Scalar_SWORD_Bin_27 0 CM_int16_deg_C 27 -40 32767 /end AXIS_PTS
/begin MEASUREMENT buffer_NVM_BMS.SOC_Handler_Battery "" ULONG CM_uint32_percent_ 0 0 0 4294967295 ECU_ADDRESS 0x0000 DISPLAY_IDENTIFIER buffer_NVM_BMS_SOC_Handler_Battery /end MEASUREMENT
/begin MEASUREMENT buffer_NVM_BMS.SOC_Kernel_Battery "" ULONG CM_uint32_percent_ 0 0 0 4294967295 ECU_ADDRESS 0x0000 DISPLAY_IDENTIFIER buffer_NVM_BMS_SOC_Kernel_Battery /end MEASUREMENT
/begin MEASUREMENT buffer_NVM_BMS.SOC_Kernel_Cell "" ULONG CM_uint32_percent_ 0 0 0 4294967295 LAYOUT COLUMN_DIR MATRIX_DIM 8 15 ECU_ADDRESS 0x0000 DISPLAY_IDENTIFIER buffer_NVM_BMS_SOC_Kernel_Cell /end MEASUREMENT
/begin MEASUREMENT buffer_NVM_BMS.SOH_Handler_Battery "" ULONG CM_uint32_percent_ 0 0 0 4294967295 ECU_ADDRESS 0x0000 DISPLAY_IDENTIFIER buffer_NVM_BMS_SOH_Handler_Battery /end MEASUREMENT
/begin MEASUREMENT buffer_NVM_BMS.calendricAge_Battery "" ULONG CM_uint32_s 0 0 0 4294967295 ECU_ADDRESS 0x0000 DISPLAY_IDENTIFIER buffer_NVM_BMS_calendricAge_Battery /end MEASUREMENT
/begin MEASUREMENT buffer_NVM_BMS.calendricAging_SOH_Battery "" ULONG CM_uint32_percent_ 0 0 0 4294967295 ECU_ADDRESS 0x0000 DISPLAY_IDENTIFIER buffer_NVM_BMS_calendricAging_SOH_Battery /end MEASUREMENT
/begin MEASUREMENT buffer_NVM_BMS.cellNumber "" UWORD CM_uint16 0 0 0 65535 ECU_ADDRESS 0x0000 DISPLAY_IDENTIFIER buffer_NVM_BMS_cellNumber /end MEASUREMENT
/begin MEASUREMENT buffer_NVM_BMS.cyclicAging_SOH_Battery "" ULONG CM_uint32_percent_ 0 0 0 4294967295 ECU_ADDRESS 0x0000 DISPLAY_IDENTIFIER buffer_NVM_BMS_cyclicAging_SOH_Battery /end MEASUREMENT
/begin MEASUREMENT buffer_NVM_BMS.deltaChangeResidual_SOC "" SLONG CM_int32_percent_ 0 0 -100000 2147483647 ECU_ADDRESS 0x0000 DISPLAY_IDENTIFIER buffer_NVM_BMS_deltaChangeResidual_SOC /end MEASUREMENT
/begin MEASUREMENT buffer_NVM_BMS.deratingFactor_MaxCellVoltage "" UWORD CM_uint16_percent_ 0 0 0 65535 ECU_ADDRESS 0x0000 DISPLAY_IDENTIFIER buffer_NVM_BMS_deratingFactor_MaxCellVoltage /end MEASUREMENT
/begin MEASUREMENT buffer_NVM_BMS.deratingFactor_MaxDrive "" UWORD CM_uint16_percent_ 0 0 0 65535 ECU_ADDRESS 0x0000 DISPLAY_IDENTIFIER buffer_NVM_BMS_deratingFactor_MaxDrive /end MEASUREMENT
/begin MEASUREMENT buffer_NVM_BMS.deratingFactor_MaxRegeneration "" UWORD CM_uint16_percent_ 0 0 0 65535 ECU_ADDRESS 0x0000 DISPLAY_IDENTIFIER buffer_NVM_BMS_deratingFactor_MaxRegeneration /end MEASUREMENT
/begin MEASUREMENT buffer_NVM_BMS.deratingFactor_MinCellVoltage "" UWORD CM_uint16_percent_ 0 0 0 65535 ECU_ADDRESS 0x0000 DISPLAY_IDENTIFIER buffer_NVM_BMS_deratingFactor_MinCellVoltage /end MEASUREMENT
/begin MEASUREMENT buffer_NVM_BMS.energy_Battery "" ULONG CM_uint32_W_into_h 0 0 0 4294967295 ECU_ADDRESS 0x0000 DISPLAY_IDENTIFIER buffer_NVM_BMS_energy_Battery /end MEASUREMENT
/begin MEASUREMENT buffer_NVM_BMS.energy_NegativeDischarge_Battery "" ULONG CM_uint32_W_into_h 0 0 0 4294967295 ECU_ADDRESS 0x0000 DISPLAY_IDENTIFIER buffer_NVM_BMS_energy_NegativeDischarge_Battery /end MEASUREMENT
/begin MEASUREMENT buffer_NVM_BMS.energy_PositiveCharge_Battery "" ULONG CM_uint32_W_into_h 0 0 0 4294967295 ECU_ADDRESS 0x0000 DISPLAY_IDENTIFIER buffer_NVM_BMS_energy_PositiveCharge_Battery /end MEASUREMENT
/begin MEASUREMENT buffer_NVM_BMS.energy_PositiveDischarge_Battery "" ULONG CM_uint32_W_into_h 0 0 0 4294967295 ECU_ADDRESS 0x0000 DISPLAY_IDENTIFIER buffer_NVM_BMS_energy_PositiveDischarge_Battery /end MEASUREMENT
/begin MEASUREMENT buffer_NVM_BMS.heatingEnergy_Module "" ULONG CM_uint32_W_into_s 0 0 0 4294967295 LAYOUT COLUMN_DIR MATRIX_DIM 8 1 ECU_ADDRESS 0x0000 DISPLAY_IDENTIFIER buffer_NVM_BMS_heatingEnergy_Module /end MEASUREMENT
/begin MEASUREMENT buffer_NVM_BMS.idleTime_Battery "" ULONG CM_uint32_s 0 0 0 4294967295 ECU_ADDRESS 0x0000 DISPLAY_IDENTIFIER buffer_NVM_BMS_idleTime_Battery /end MEASUREMENT
/begin MEASUREMENT buffer_NVM_BMS.maxChargeCurrent_Continuous "" ULONG CM_uint32_m_into_A 0 0 0 4294967295 ECU_ADDRESS 0x0000 DISPLAY_IDENTIFIER buffer_NVM_BMS_maxChargeCurrent_Continuous /end MEASUREMENT
/begin MEASUREMENT buffer_NVM_BMS.maxChargeCurrent_Pulse "" ULONG CM_uint32_m_into_A 0 0 0 4294967295 ECU_ADDRESS 0x0000 DISPLAY_IDENTIFIER buffer_NVM_BMS_maxChargeCurrent_Pulse /end MEASUREMENT
/begin MEASUREMENT buffer_NVM_BMS.maxDischargeCurrent_Continuous "" ULONG CM_uint32_m_into_A 0 0 0 4294967295 ECU_ADDRESS 0x0000 DISPLAY_IDENTIFIER buffer_NVM_BMS_maxDischargeCurrent_Continuous /end MEASUREMENT
/begin MEASUREMENT buffer_NVM_BMS.maxDischargeCurrent_Pulse "" ULONG CM_uint32_m_into_A 0 0 0 4294967295 ECU_ADDRESS 0x0000 DISPLAY_IDENTIFIER buffer_NVM_BMS_maxDischargeCurrent_Pulse /end MEASUREMENT
/begin MEASUREMENT buffer_NVM_BMS.minHeatingEnergy_String "" ULONG CM_uint32_W_into_s 0 0 0 4294967295 LAYOUT COLUMN_DIR MATRIX_DIM 8 1 ECU_ADDRESS 0x0000 DISPLAY_IDENTIFIER buffer_NVM_BMS_minHeatingEnergy_String /end MEASUREMENT
/begin MEASUREMENT buffer_NVM_BMS.noFullCycles_Battery "" ULONG CM_uint32 0 0 0 4294967295 ECU_ADDRESS 0x0000 DISPLAY_IDENTIFIER buffer_NVM_BMS_noFullCycles_Battery /end MEASUREMENT
/begin MEASUREMENT buffer_NVM_BMS.operationTime_Battery "" ULONG CM_uint32_s 0 0 0 4294967295 ECU_ADDRESS 0x0000 DISPLAY_IDENTIFIER buffer_NVM_BMS_operationTime_Battery /end MEASUREMENT
/begin MEASUREMENT buffer_NVM_BMS.parameter_service_EOC "" UWORD CM_uint16_percent_ 0 0 0 65535 ECU_ADDRESS 0x0000 DISPLAY_IDENTIFIER buffer_NVM_BMS_parameter_service_EOC READ_WRITE /end MEASUREMENT
/begin MEASUREMENT buffer_NVM_BMS.parameter_service_EOD "" UWORD CM_uint16_percent_ 0 0 0 65535 ECU_ADDRESS 0x0000 DISPLAY_IDENTIFIER buffer_NVM_BMS_parameter_service_EOD READ_WRITE /end MEASUREMENT
/begin MEASUREMENT buffer_NVM_BMS.parameter_service_PWUPHeating_Enable "" UBYTE CM_ENUM_ENABLE 0 0 0 1 ECU_ADDRESS 0x0000 DISPLAY_IDENTIFIER buffer_NVM_BMS_parameter_service_PWUPHeating_Enable READ_WRITE /end MEASUREMENT
/begin MEASUREMENT buffer_NVM_BMS.parameter_service_diagnosticDerating "" UBYTE CM_uint8_percent_ 0 0 0 255 ECU_ADDRESS 0x0000 DISPLAY_IDENTIFIER buffer_NVM_BMS_parameter_service_diagnosticDerating READ_WRITE /end MEASUREMENT
/begin MEASUREMENT buffer_NVM_BMS.state_energyBalance_Module "" UBYTE CM_ENUM_STATE_ENERGYBALANCE_MODULE 0 0 0 4 LAYOUT COLUMN_DIR MATRIX_DIM 8 1 ECU_ADDRESS 0x0000 DISPLAY_IDENTIFIER buffer_NVM_BMS_state_energyBalance_Module /end MEASUREMENT
/begin MEASUREMENT buffer_NVM_BMS.state_temperature_Module "" UBYTE CM_ENUM_STATE_TEMPERATURE_MODULE 0 0 0 3 LAYOUT COLUMN_DIR MATRIX_DIM 8 1 ECU_ADDRESS 0x0000 DISPLAY_IDENTIFIER buffer_NVM_BMS_state_temperature_Module /end MEASUREMENT
/begin MEASUREMENT Interface_initialize_NVM_BMSrtB.buffer_NVM_BMS_l.SOC_Handler_Battery "" ULONG CM_uint32_percent_ 0 0 0 4294967295 ECU_ADDRESS 0x0000 DISPLAY_IDENTIFIER init_buffer_NVM_BMS_SOC_Handler_Battery /end MEASUREMENT
/begin MEASUREMENT Interface_initialize_NVM_BMSrtB.buffer_NVM_BMS_l.SOC_Kernel_Battery "" ULONG CM_uint32_percent_ 0 0 0 4294967295 ECU_ADDRESS 0x0000 DISPLAY_IDENTIFIER init_buffer_NVM_BMS_SOC_Kernel_Battery /end MEASUREMENT
/begin MEASUREMENT Interface_initialize_NVM_BMSrtB.buffer_NVM_BMS_l.SOC_Kernel_Cell "" ULONG CM_uint32_percent_ 0 0 0 4294967295 LAYOUT COLUMN_DIR MATRIX_DIM 8 15 ECU_ADDRESS 0x0000 DISPLAY_IDENTIFIER init_buffer_NVM_BMS_SOC_Kernel_Cell /end MEASUREMENT
/begin MEASUREMENT Interface_initialize_NVM_BMSrtB.buffer_NVM_BMS_l.SOH_Handler_Battery "" ULONG CM_uint32_percent_ 0 0 0 4294967295 ECU_ADDRESS 0x0000 DISPLAY_IDENTIFIER init_buffer_NVM_BMS_SOH_Handler_Battery /end MEASUREMENT
/begin MEASUREMENT Interface_initialize_NVM_BMSrtB.buffer_NVM_BMS_l.calendricAge_Battery "" ULONG CM_uint32_s 0 0 0 4294967295 ECU_ADDRESS 0x0000 DISPLAY_IDENTIFIER init_buffer_NVM_BMS_calendricAge_Battery /end MEASUREMENT
/begin MEASUREMENT Interface_initialize_NVM_BMSrtB.buffer_NVM_BMS_l.calendricAging_SOH_Battery "" ULONG CM_uint32_percent_ 0 0 0 4294967295 ECU_ADDRESS 0x0000 DISPLAY_IDENTIFIER init_buffer_NVM_BMS_calendricAging_SOH_Battery /end MEASUREMENT
/begin MEASUREMENT Interface_initialize_NVM_BMSrtB.buffer_NVM_BMS_l.cellNumber "" UWORD CM_uint16 0 0 0 65535 ECU_ADDRESS 0x0000 DISPLAY_IDENTIFIER init_buffer_NVM_BMS_cellNumber /end MEASUREMENT
/begin MEASUREMENT Interface_initialize_NVM_BMSrtB.buffer_NVM_BMS_l.cyclicAging_SOH_Battery "" ULONG CM_uint32_percent_ 0 0 0 4294967295 ECU_ADDRESS 0x0000 DISPLAY_IDENTIFIER init_buffer_NVM_BMS_cyclicAging_SOH_Battery /end MEASUREMENT
/begin MEASUREMENT Interface_initialize_NVM_BMSrtB.buffer_NVM_BMS_l.deltaChangeResidual_SOC "" SLONG CM_int32_percent_ 0 0 -100000 2147483647 ECU_ADDRESS 0x0000 DISPLAY_IDENTIFIER init_buffer_NVM_BMS_deltaChangeResidual_SOC /end MEASUREMENT
/begin MEASUREMENT Interface_initialize_NVM_BMSrtB.buffer_NVM_BMS_l.deratingFactor_MaxCellVoltage "" UWORD CM_uint16_percent_ 0 0 0 65535 ECU_ADDRESS 0x0000 DISPLAY_IDENTIFIER init_buffer_NVM_BMS_deratingFactor_MaxCellVoltage /end MEASUREMENT
/begin MEASUREMENT Interface_initialize_NVM_BMSrtB.buffer_NVM_BMS_l.deratingFactor_MaxDrive "" UWORD CM_uint16_percent_ 0 0 0 65535 ECU_ADDRESS 0x0000 DISPLAY_IDENTIFIER init_buffer_NVM_BMS_deratingFactor_MaxDrive /end MEASUREMENT
/begin MEASUREMENT Interface_initialize_NVM_BMSrtB.buffer_NVM_BMS_l.deratingFactor_MaxRegeneration "" UWORD CM_uint16_percent_ 0 0 0 65535 ECU_ADDRESS 0x0000 DISPLAY_IDENTIFIER init_buffer_NVM_BMS_deratingFactor_MaxRegeneration /end MEASUREMENT
/begin MEASUREMENT Interface_initialize_NVM_BMSrtB.buffer_NVM_BMS_l.deratingFactor_MinCellVoltage "" UWORD CM_uint16_percent_ 0 0 0 65535 ECU_ADDRESS 0x0000 DISPLAY_IDENTIFIER init_buffer_NVM_BMS_deratingFactor_MinCellVoltage /end MEASUREMENT
/begin MEASUREMENT Interface_initialize_NVM_BMSrtB.buffer_NVM_BMS_l.energy_Battery "" ULONG CM_uint32_W_into_h 0 0 0 4294967295 ECU_ADDRESS 0x0000 DISPLAY_IDENTIFIER init_buffer_NVM_BMS_energy_Battery /end MEASUREMENT
/begin MEASUREMENT Interface_initialize_NVM_BMSrtB.buffer_NVM_BMS_l.energy_NegativeDischarge_Battery "" ULONG CM_uint32_W_into_h 0 0 0 4294967295 ECU_ADDRESS 0x0000 DISPLAY_IDENTIFIER init_buffer_NVM_BMS_energy_NegativeDischarge_Battery /end MEASUREMENT
/begin MEASUREMENT Interface_initialize_NVM_BMSrtB.buffer_NVM_BMS_l.energy_PositiveCharge_Battery "" ULONG CM_uint32_W_into_h 0 0 0 4294967295 ECU_ADDRESS 0x0000 DISPLAY_IDENTIFIER init_buffer_NVM_BMS_energy_PositiveCharge_Battery /end MEASUREMENT
/begin MEASUREMENT Interface_initialize_NVM_BMSrtB.buffer_NVM_BMS_l.energy_PositiveDischarge_Battery "" ULONG CM_uint32_W_into_h 0 0 0 4294967295 ECU_ADDRESS 0x0000 DISPLAY_IDENTIFIER init_buffer_NVM_BMS_energy_PositiveDischarge_Battery /end MEASUREMENT
/begin MEASUREMENT Interface_initialize_NVM_BMSrtB.buffer_NVM_BMS_l.heatingEnergy_Module "" ULONG CM_uint32_W_into_s 0 0 0 4294967295 LAYOUT COLUMN_DIR MATRIX_DIM 8 1 ECU_ADDRESS 0x0000 DISPLAY_IDENTIFIER init_buffer_NVM_BMS_heatingEnergy_Module /end MEASUREMENT
/begin MEASUREMENT Interface_initialize_NVM_BMSrtB.buffer_NVM_BMS_l.idleTime_Battery "" ULONG CM_uint32_s 0 0 0 4294967295 ECU_ADDRESS 0x0000 DISPLAY_IDENTIFIER init_buffer_NVM_BMS_idleTime_Battery /end MEASUREMENT
/begin MEASUREMENT Interface_initialize_NVM_BMSrtB.buffer_NVM_BMS_l.maxChargeCurrent_Continuous "" ULONG CM_uint32_m_into_A 0 0 0 4294967295 ECU_ADDRESS 0x0000 DISPLAY_IDENTIFIER init_buffer_NVM_BMS_maxChargeCurrent_Continuous /end MEASUREMENT
/begin MEASUREMENT Interface_initialize_NVM_BMSrtB.buffer_NVM_BMS_l.maxChargeCurrent_Pulse "" ULONG CM_uint32_m_into_A 0 0 0 4294967295 ECU_ADDRESS 0x0000 DISPLAY_IDENTIFIER init_buffer_NVM_BMS_maxChargeCurrent_Pulse /end MEASUREMENT
/begin MEASUREMENT Interface_initialize_NVM_BMSrtB.buffer_NVM_BMS_l.maxDischargeCurrent_Continuous "" ULONG CM_uint32_m_into_A 0 0 0 4294967295 ECU_ADDRESS 0x0000 DISPLAY_IDENTIFIER init_buffer_NVM_BMS_maxDischargeCurrent_Continuous /end MEASUREMENT
/begin MEASUREMENT Interface_initialize_NVM_BMSrtB.buffer_NVM_BMS_l.maxDischargeCurrent_Pulse "" ULONG CM_uint32_m_into_A 0 0 0 4294967295 ECU_ADDRESS 0x0000 DISPLAY_IDENTIFIER init_buffer_NVM_BMS_maxDischargeCurrent_Pulse /end MEASUREMENT
/begin MEASUREMENT Interface_initialize_NVM_BMSrtB.buffer_NVM_BMS_l.minHeatingEnergy_String "" ULONG CM_uint32_W_into_s 0 0 0 4294967295 LAYOUT COLUMN_DIR MATRIX_DIM 8 1 ECU_ADDRESS 0x0000 DISPLAY_IDENTIFIER init_buffer_NVM_BMS_minHeatingEnergy_String /end MEASUREMENT
/begin MEASUREMENT Interface_initialize_NVM_BMSrtB.buffer_NVM_BMS_l.noFullCycles_Battery "" ULONG CM_uint32 0 0 0 4294967295 ECU_ADDRESS 0x0000 DISPLAY_IDENTIFIER init_buffer_NVM_BMS_noFullCycles_Battery /end MEASUREMENT
/begin MEASUREMENT Interface_initialize_NVM_BMSrtB.buffer_NVM_BMS_l.operationTime_Battery "" ULONG CM_uint32_s 0 0 0 4294967295 ECU_ADDRESS 0x0000 DISPLAY_IDENTIFIER init_buffer_NVM_BMS_operationTime_Battery /end MEASUREMENT
/begin MEASUREMENT Interface_initialize_NVM_BMSrtB.buffer_NVM_BMS_l.parameter_service_EOC "" UWORD CM_uint16_percent_ 0 0 0 65535 ECU_ADDRESS 0x0000 DISPLAY_IDENTIFIER init_buffer_NVM_BMS_parameter_service_EOC READ_WRITE /end MEASUREMENT
/begin MEASUREMENT Interface_initialize_NVM_BMSrtB.buffer_NVM_BMS_l.parameter_service_EOD "" UWORD CM_uint16_percent_ 0 0 0 65535 ECU_ADDRESS 0x0000 DISPLAY_IDENTIFIER init_buffer_NVM_BMS_parameter_service_EOD READ_WRITE /end MEASUREMENT
/begin MEASUREMENT Interface_initialize_NVM_BMSrtB.buffer_NVM_BMS_l.parameter_service_PWUPHeating_Enable "" UBYTE CM_ENUM_ENABLE 0 0 0 1 ECU_ADDRESS 0x0000 DISPLAY_IDENTIFIER init_buffer_NVM_BMS_parameter_service_PWUPHeating_Enable READ_WRITE /end MEASUREMENT
/begin MEASUREMENT Interface_initialize_NVM_BMSrtB.buffer_NVM_BMS_l.parameter_service_diagnosticDerating "" UBYTE CM_uint8_percent_ 0 0 0 255 ECU_ADDRESS 0x0000 DISPLAY_IDENTIFIER init_buffer_NVM_BMS_parameter_service_diagnosticDerating READ_WRITE /end MEASUREMENT
/begin MEASUREMENT Interface_initialize_NVM_BMSrtB.buffer_NVM_BMS_l.state_energyBalance_Module "" UBYTE CM_ENUM_STATE_ENERGYBALANCE_MODULE 0 0 0 4 LAYOUT COLUMN_DIR MATRIX_DIM 8 1 ECU_ADDRESS 0x0000 DISPLAY_IDENTIFIER init_buffer_NVM_BMS_state_energyBalance_Module /end MEASUREMENT
/begin MEASUREMENT Interface_initialize_NVM_BMSrtB.buffer_NVM_BMS_l.state_temperature_Module "" UBYTE CM_ENUM_STATE_TEMPERATURE_MODULE 0 0 0 3 LAYOUT COLUMN_DIR MATRIX_DIM 8 1 ECU_ADDRESS 0x0000 DISPLAY_IDENTIFIER init_buffer_NVM_BMS_state_temperature_Module /end MEASUREMENT
/begin MEASUREMENT buffer_NVM_CSC.SOH_Kernel_Module "" ULONG CM_uint32_percent_ 0 0 0 4294967295 LAYOUT ROW_DIR MATRIX_DIM 8 1 ECU_ADDRESS 0x0000 DISPLAY_IDENTIFIER buffer_NVM_CSC_SOH_Kernel_Module /end MEASUREMENT
/begin MEASUREMENT buffer_NVM_CSC.calendricAge_Module "" ULONG CM_uint32_s 0 0 0 4294967295 LAYOUT ROW_DIR MATRIX_DIM 8 1 ECU_ADDRESS 0x0000 DISPLAY_IDENTIFIER buffer_NVM_CSC_calendricAge_Module /end MEASUREMENT
/begin MEASUREMENT buffer_NVM_CSC.calendricAging_SOH_Module "" ULONG CM_uint32_percent_ 0 0 0 4294967295 LAYOUT ROW_DIR MATRIX_DIM 8 1 ECU_ADDRESS 0x0000 DISPLAY_IDENTIFIER buffer_NVM_CSC_calendricAging_SOH_Module /end MEASUREMENT
/begin MEASUREMENT buffer_NVM_CSC.cyclicAging_SOH_Module "" ULONG CM_uint32_percent_ 0 0 0 4294967295 LAYOUT ROW_DIR MATRIX_DIM 8 1 ECU_ADDRESS 0x0000 DISPLAY_IDENTIFIER buffer_NVM_CSC_cyclicAging_SOH_Module /end MEASUREMENT
/begin MEASUREMENT buffer_NVM_CSC.energy_Module "" ULONG CM_uint32_W_into_h 0 0 0 4294967295 LAYOUT ROW_DIR MATRIX_DIM 8 1 ECU_ADDRESS 0x0000 DISPLAY_IDENTIFIER buffer_NVM_CSC_energy_Module /end MEASUREMENT
/begin MEASUREMENT buffer_NVM_CSC.energy_NegativeDischarge_Module "" ULONG CM_uint32_W_into_h 0 0 0 4294967295 LAYOUT ROW_DIR MATRIX_DIM 8 1 ECU_ADDRESS 0x0000 DISPLAY_IDENTIFIER buffer_NVM_CSC_energy_NegativeDischarge_Module /end MEASUREMENT
/begin MEASUREMENT buffer_NVM_CSC.energy_PositiveCharge_Module "" ULONG CM_uint32_W_into_h 0 0 0 4294967295 LAYOUT ROW_DIR MATRIX_DIM 8 1 ECU_ADDRESS 0x0000 DISPLAY_IDENTIFIER buffer_NVM_CSC_energy_PositiveCharge_Module /end MEASUREMENT
/begin MEASUREMENT buffer_NVM_CSC.energy_PositiveDischarge_Module "" ULONG CM_uint32_W_into_h 0 0 0 4294967295 LAYOUT ROW_DIR MATRIX_DIM 8 1 ECU_ADDRESS 0x0000 DISPLAY_IDENTIFIER buffer_NVM_CSC_energy_PositiveDischarge_Module /end MEASUREMENT
/begin MEASUREMENT buffer_NVM_CSC.idleTime_Module "" ULONG CM_uint32_s 0 0 0 4294967295 LAYOUT ROW_DIR MATRIX_DIM 8 1 ECU_ADDRESS 0x0000 DISPLAY_IDENTIFIER buffer_NVM_CSC_idleTime_Module /end MEASUREMENT
/begin MEASUREMENT buffer_NVM_CSC.operationTime_Module "" ULONG CM_uint32_s 0 0 0 4294967295 LAYOUT ROW_DIR MATRIX_DIM 8 1 ECU_ADDRESS 0x0000 DISPLAY_IDENTIFIER buffer_NVM_CSC_operationTime_Module /end MEASUREMENT
/begin MEASUREMENT Interface_initialize_NVM_CSCrtB.data_NVM_CSC_init.CSC1.SOH_Kernel_Module "" ULONG CM_uint32 0 0 0 2147483646 ECU_ADDRESS 0x0000 DISPLAY_IDENTIFIER CSC1_SOH_Kernel_Module /end MEASUREMENT
/begin MEASUREMENT Interface_initialize_NVM_CSCrtB.data_NVM_CSC_init.CSC1.calendricAge_Module "" ULONG CM_uint32 0 0 0 2147483646 ECU_ADDRESS 0x0000 DISPLAY_IDENTIFIER CSC1_calendricAge_Module /end MEASUREMENT
/begin MEASUREMENT Interface_initialize_NVM_CSCrtB.data_NVM_CSC_init.CSC1.calendricAging_SOH_Module "" ULONG CM_uint32 0 0 0 2147483646 ECU_ADDRESS 0x0000 DISPLAY_IDENTIFIER CSC1_calendricAging_SOH_Module /end MEASUREMENT
/begin MEASUREMENT Interface_initialize_NVM_CSCrtB.data_NVM_CSC_init.CSC1.cyclicAging_SOH_Module "" ULONG CM_uint32 0 0 0 2147483646 ECU_ADDRESS 0x0000 DISPLAY_IDENTIFIER CSC1_cyclicAging_SOH_Module /end MEASUREMENT
/begin MEASUREMENT Interface_initialize_NVM_CSCrtB.data_NVM_CSC_init.CSC1.energy_Module "" ULONG CM_uint32 0 0 0 2147483646 ECU_ADDRESS 0x0000 DISPLAY_IDENTIFIER CSC1_energy_Module /end MEASUREMENT
/begin MEASUREMENT Interface_initialize_NVM_CSCrtB.data_NVM_CSC_init.CSC1.energy_NegativeDischarge_Module "" ULONG CM_uint32 0 0 0 2147483646 ECU_ADDRESS 0x0000 DISPLAY_IDENTIFIER CSC1_energy_NegativeDischarge_Module /end MEASUREMENT
/begin MEASUREMENT Interface_initialize_NVM_CSCrtB.data_NVM_CSC_init.CSC1.energy_PositiveCharge_Module "" ULONG CM_uint32 0 0 0 2147483646 ECU_ADDRESS 0x0000 DISPLAY_IDENTIFIER CSC1_energy_PositiveCharge_Module /end MEASUREMENT
/begin MEASUREMENT Interface_initialize_NVM_CSCrtB.data_NVM_CSC_init.CSC1.energy_PositiveDischarge_Module "" ULONG CM_uint32 0 0 0 2147483646 ECU_ADDRESS 0x0000 DISPLAY_IDENTIFIER CSC1_energy_PositiveDischarge_Module /end MEASUREMENT
/begin MEASUREMENT Interface_initialize_NVM_CSCrtB.data_NVM_CSC_init.CSC1.idleTime_Module "" ULONG CM_uint32 0 0 0 2147483646 ECU_ADDRESS 0x0000 DISPLAY_IDENTIFIER CSC1_idleTime_Module /end MEASUREMENT
/begin MEASUREMENT Interface_initialize_NVM_CSCrtB.data_NVM_CSC_init.CSC1.operationTime_Module "" ULONG CM_uint32 0 0 0 2147483646 ECU_ADDRESS 0x0000 DISPLAY_IDENTIFIER CSC1_operationTime_Module /end MEASUREMENT
/begin MEASUREMENT Interface_initialize_NVM_CSCrtB.data_NVM_CSC_init.CSC2.SOH_Kernel_Module "" ULONG CM_uint32 0 0 0 2147483646 ECU_ADDRESS 0x0000 DISPLAY_IDENTIFIER CSC2_SOH_Kernel_Module /end MEASUREMENT
/begin MEASUREMENT Interface_initialize_NVM_CSCrtB.data_NVM_CSC_init.CSC2.calendricAge_Module "" ULONG CM_uint32 0 0 0 2147483646 ECU_ADDRESS 0x0000 DISPLAY_IDENTIFIER CSC2_calendricAge_Module /end MEASUREMENT
/begin MEASUREMENT Interface_initialize_NVM_CSCrtB.data_NVM_CSC_init.CSC2.calendricAging_SOH_Module "" ULONG CM_uint32 0 0 0 2147483646 ECU_ADDRESS 0x0000 DISPLAY_IDENTIFIER CSC2_calendricAging_SOH_Module /end MEASUREMENT
/begin MEASUREMENT Interface_initialize_NVM_CSCrtB.data_NVM_CSC_init.CSC2.cyclicAging_SOH_Module "" ULONG CM_uint32 0 0 0 2147483646 ECU_ADDRESS 0x0000 DISPLAY_IDENTIFIER CSC2_cyclicAging_SOH_Module /end MEASUREMENT
/begin MEASUREMENT Interface_initialize_NVM_CSCrtB.data_NVM_CSC_init.CSC2.energy_Module "" ULONG CM_uint32 0 0 0 2147483646 ECU_ADDRESS 0x0000 DISPLAY_IDENTIFIER CSC2_energy_Module /end MEASUREMENT
/begin MEASUREMENT Interface_initialize_NVM_CSCrtB.data_NVM_CSC_init.CSC2.energy_NegativeDischarge_Module "" ULONG CM_uint32 0 0 0 2147483646 ECU_ADDRESS 0x0000 DISPLAY_IDENTIFIER CSC2_energy_NegativeDischarge_Module /end MEASUREMENT
/begin MEASUREMENT Interface_initialize_NVM_CSCrtB.data_NVM_CSC_init.CSC2.energy_PositiveCharge_Module "" ULONG CM_uint32 0 0 0 2147483646 ECU_ADDRESS 0x0000 DISPLAY_IDENTIFIER CSC2_energy_PositiveCharge_Module /end MEASUREMENT
/begin MEASUREMENT Interface_initialize_NVM_CSCrtB.data_NVM_CSC_init.CSC2.energy_PositiveDischarge_Module "" ULONG CM_uint32 0 0 0 2147483646 ECU_ADDRESS 0x0000 DISPLAY_IDENTIFIER CSC2_energy_PositiveDischarge_Module /end MEASUREMENT
/begin MEASUREMENT Interface_initialize_NVM_CSCrtB.data_NVM_CSC_init.CSC2.idleTime_Module "" ULONG CM_uint32 0 0 0 2147483646 ECU_ADDRESS 0x0000 DISPLAY_IDENTIFIER CSC2_idleTime_Module /end MEASUREMENT
/begin MEASUREMENT Interface_initialize_NVM_CSCrtB.data_NVM_CSC_init.CSC2.operationTime_Module "" ULONG CM_uint32 0 0 0 2147483646 ECU_ADDRESS 0x0000 DISPLAY_IDENTIFIER CSC2_operationTime_Module /end MEASUREMENT
/begin MEASUREMENT Interface_initialize_NVM_CSCrtB.data_NVM_CSC_init.CSC3.SOH_Kernel_Module "" ULONG CM_uint32 0 0 0 2147483646 ECU_ADDRESS 0x0000 DISPLAY_IDENTIFIER CSC3_SOH_Kernel_Module /end MEASUREMENT
/begin MEASUREMENT Interface_initialize_NVM_CSCrtB.data_NVM_CSC_init.CSC3.calendricAge_Module "" ULONG CM_uint32 0 0 0 2147483646 ECU_ADDRESS 0x0000 DISPLAY_IDENTIFIER CSC3_calendricAge_Module /end MEASUREMENT
/begin MEASUREMENT Interface_initialize_NVM_CSCrtB.data_NVM_CSC_init.CSC3.calendricAging_SOH_Module "" ULONG CM_uint32 0 0 0 2147483646 ECU_ADDRESS 0x0000 DISPLAY_IDENTIFIER CSC3_calendricAging_SOH_Module /end MEASUREMENT
/begin MEASUREMENT Interface_initialize_NVM_CSCrtB.data_NVM_CSC_init.CSC3.cyclicAging_SOH_Module "" ULONG CM_uint32 0 0 0 2147483646 ECU_ADDRESS 0x0000 DISPLAY_IDENTIFIER CSC3_cyclicAging_SOH_Module /end MEASUREMENT
/begin MEASUREMENT Interface_initialize_NVM_CSCrtB.data_NVM_CSC_init.CSC3.energy_Module "" ULONG CM_uint32 0 0 0 2147483646 ECU_ADDRESS 0x0000 DISPLAY_IDENTIFIER CSC3_energy_Module /end MEASUREMENT
/begin MEASUREMENT Interface_initialize_NVM_CSCrtB.data_NVM_CSC_init.CSC3.energy_NegativeDischarge_Module "" ULONG CM_uint32 0 0 0 2147483646 ECU_ADDRESS 0x0000 DISPLAY_IDENTIFIER CSC3_energy_NegativeDischarge_Module /end MEASUREMENT
/begin MEASUREMENT Interface_initialize_NVM_CSCrtB.data_NVM_CSC_init.CSC3.energy_PositiveCharge_Module "" ULONG CM_uint32 0 0 0 2147483646 ECU_ADDRESS 0x0000 DISPLAY_IDENTIFIER CSC3_energy_PositiveCharge_Module /end MEASUREMENT
/begin MEASUREMENT Interface_initialize_NVM_CSCrtB.data_NVM_CSC_init.CSC3.energy_PositiveDischarge_Module "" ULONG CM_uint32 0 0 0 2147483646 ECU_ADDRESS 0x0000 DISPLAY_IDENTIFIER CSC3_energy_PositiveDischarge_Module /end MEASUREMENT
/begin MEASUREMENT Interface_initialize_NVM_CSCrtB.data_NVM_CSC_init.CSC3.idleTime_Module "" ULONG CM_uint32 0 0 0 2147483646 ECU_ADDRESS 0x0000 DISPLAY_IDENTIFIER CSC3_idleTime_Module /end MEASUREMENT
/begin MEASUREMENT Interface_initialize_NVM_CSCrtB.data_NVM_CSC_init.CSC3.operationTime_Module "" ULONG CM_uint32 0 0 0 2147483646 ECU_ADDRESS 0x0000 DISPLAY_IDENTIFIER CSC3_operationTime_Module /end MEASUREMENT
/begin MEASUREMENT Interface_initialize_NVM_CSCrtB.data_NVM_CSC_init.CSC4.SOH_Kernel_Module "" ULONG CM_uint32 0 0 0 2147483646 ECU_ADDRESS 0x0000 DISPLAY_IDENTIFIER CSC4_SOH_Kernel_Module /end MEASUREMENT
/begin MEASUREMENT Interface_initialize_NVM_CSCrtB.data_NVM_CSC_init.CSC4.calendricAge_Module "" ULONG CM_uint32 0 0 0 2147483646 ECU_ADDRESS 0x0000 DISPLAY_IDENTIFIER CSC4_calendricAge_Module /end MEASUREMENT
/begin MEASUREMENT Interface_initialize_NVM_CSCrtB.data_NVM_CSC_init.CSC4.calendricAging_SOH_Module "" ULONG CM_uint32 0 0 0 2147483646 ECU_ADDRESS 0x0000 DISPLAY_IDENTIFIER CSC4_calendricAging_SOH_Module /end MEASUREMENT
/begin MEASUREMENT Interface_initialize_NVM_CSCrtB.data_NVM_CSC_init.CSC4.cyclicAging_SOH_Module "" ULONG CM_uint32 0 0 0 2147483646 ECU_ADDRESS 0x0000 DISPLAY_IDENTIFIER CSC4_cyclicAging_SOH_Module /end MEASUREMENT
/begin MEASUREMENT Interface_initialize_NVM_CSCrtB.data_NVM_CSC_init.CSC4.energy_Module "" ULONG CM_uint32 0 0 0 2147483646 ECU_ADDRESS 0x0000 DISPLAY_IDENTIFIER CSC4_energy_Module /end MEASUREMENT
/begin MEASUREMENT Interface_initialize_NVM_CSCrtB.data_NVM_CSC_init.CSC4.energy_NegativeDischarge_Module "" ULONG CM_uint32 0 0 0 2147483646 ECU_ADDRESS 0x0000 DISPLAY_IDENTIFIER CSC4_energy_NegativeDischarge_Module /end MEASUREMENT
/begin MEASUREMENT Interface_initialize_NVM_CSCrtB.data_NVM_CSC_init.CSC4.energy_PositiveCharge_Module "" ULONG CM_uint32 0 0 0 2147483646 ECU_ADDRESS 0x0000 DISPLAY_IDENTIFIER CSC4_energy_PositiveCharge_Module /end MEASUREMENT
/begin MEASUREMENT Interface_initialize_NVM_CSCrtB.data_NVM_CSC_init.CSC4.energy_PositiveDischarge_Module "" ULONG CM_uint32 0 0 0 2147483646 ECU_ADDRESS 0x0000 DISPLAY_IDENTIFIER CSC4_energy_PositiveDischarge_Module /end MEASUREMENT
/begin MEASUREMENT Interface_initialize_NVM_CSCrtB.data_NVM_CSC_init.CSC4.idleTime_Module "" ULONG CM_uint32 0 0 0 2147483646 ECU_ADDRESS 0x0000 DISPLAY_IDENTIFIER CSC4_idleTime_Module /end MEASUREMENT
/begin MEASUREMENT Interface_initialize_NVM_CSCrtB.data_NVM_CSC_init.CSC4.operationTime_Module "" ULONG CM_uint32 0 0 0 2147483646 ECU_ADDRESS 0x0000 DISPLAY_IDENTIFIER CSC4_operationTime_Module /end MEASUREMENT
/begin MEASUREMENT Interface_initialize_NVM_CSCrtB.data_NVM_CSC_init.CSC5.SOH_Kernel_Module "" ULONG CM_uint32 0 0 0 2147483646 ECU_ADDRESS 0x0000 DISPLAY_IDENTIFIER CSC5_SOH_Kernel_Module /end MEASUREMENT
/begin MEASUREMENT Interface_initialize_NVM_CSCrtB.data_NVM_CSC_init.CSC5.calendricAge_Module "" ULONG CM_uint32 0 0 0 2147483646 ECU_ADDRESS 0x0000 DISPLAY_IDENTIFIER CSC5_calendricAge_Module /end MEASUREMENT
/begin MEASUREMENT Interface_initialize_NVM_CSCrtB.data_NVM_CSC_init.CSC5.calendricAging_SOH_Module "" ULONG CM_uint32 0 0 0 2147483646 ECU_ADDRESS 0x0000 DISPLAY_IDENTIFIER CSC5_calendricAging_SOH_Module /end MEASUREMENT
/begin MEASUREMENT Interface_initialize_NVM_CSCrtB.data_NVM_CSC_init.CSC5.cyclicAging_SOH_Module "" ULONG CM_uint32 0 0 0 2147483646 ECU_ADDRESS 0x0000 DISPLAY_IDENTIFIER CSC5_cyclicAging_SOH_Module /end MEASUREMENT
/begin MEASUREMENT Interface_initialize_NVM_CSCrtB.data_NVM_CSC_init.CSC5.energy_Module "" ULONG CM_uint32 0 0 0 2147483646 ECU_ADDRESS 0x0000 DISPLAY_IDENTIFIER CSC5_energy_Module /end MEASUREMENT
/begin MEASUREMENT Interface_initialize_NVM_CSCrtB.data_NVM_CSC_init.CSC5.energy_NegativeDischarge_Module "" ULONG CM_uint32 0 0 0 2147483646 ECU_ADDRESS 0x0000 DISPLAY_IDENTIFIER CSC5_energy_NegativeDischarge_Module /end MEASUREMENT
/begin MEASUREMENT Interface_initialize_NVM_CSCrtB.data_NVM_CSC_init.CSC5.energy_PositiveCharge_Module "" ULONG CM_uint32 0 0 0 2147483646 ECU_ADDRESS 0x0000 DISPLAY_IDENTIFIER CSC5_energy_PositiveCharge_Module /end MEASUREMENT
/begin MEASUREMENT Interface_initialize_NVM_CSCrtB.data_NVM_CSC_init.CSC5.energy_PositiveDischarge_Module "" ULONG CM_uint32 0 0 0 2147483646 ECU_ADDRESS 0x0000 DISPLAY_IDENTIFIER CSC5_energy_PositiveDischarge_Module /end MEASUREMENT
/begin MEASUREMENT Interface_initialize_NVM_CSCrtB.data_NVM_CSC_init.CSC5.idleTime_Module "" ULONG CM_uint32 0 0 0 2147483646 ECU_ADDRESS 0x0000 DISPLAY_IDENTIFIER CSC5_idleTime_Module /end MEASUREMENT
/begin MEASUREMENT Interface_initialize_NVM_CSCrtB.data_NVM_CSC_init.CSC5.operationTime_Module "" ULONG CM_uint32 0 0 0 2147483646 ECU_ADDRESS 0x0000 DISPLAY_IDENTIFIER CSC5_operationTime_Module /end MEASUREMENT
/begin MEASUREMENT Interface_initialize_NVM_CSCrtB.data_NVM_CSC_init.CSC6.SOH_Kernel_Module "" ULONG CM_uint32 0 0 0 2147483646 ECU_ADDRESS 0x0000 DISPLAY_IDENTIFIER CSC6_SOH_Kernel_Module /end MEASUREMENT
/begin MEASUREMENT Interface_initialize_NVM_CSCrtB.data_NVM_CSC_init.CSC6.calendricAge_Module "" ULONG CM_uint32 0 0 0 2147483646 ECU_ADDRESS 0x0000 DISPLAY_IDENTIFIER CSC6_calendricAge_Module /end MEASUREMENT
/begin MEASUREMENT Interface_initialize_NVM_CSCrtB.data_NVM_CSC_init.CSC6.calendricAging_SOH_Module "" ULONG CM_uint32 0 0 0 2147483646 ECU_ADDRESS 0x0000 DISPLAY_IDENTIFIER CSC6_calendricAging_SOH_Module /end MEASUREMENT
/begin MEASUREMENT Interface_initialize_NVM_CSCrtB.data_NVM_CSC_init.CSC6.cyclicAging_SOH_Module "" ULONG CM_uint32 0 0 0 2147483646 ECU_ADDRESS 0x0000 DISPLAY_IDENTIFIER CSC6_cyclicAging_SOH_Module /end MEASUREMENT
/begin MEASUREMENT Interface_initialize_NVM_CSCrtB.data_NVM_CSC_init.CSC6.energy_Module "" ULONG CM_uint32 0 0 0 2147483646 ECU_ADDRESS 0x0000 DISPLAY_IDENTIFIER CSC6_energy_Module /end MEASUREMENT
/begin MEASUREMENT Interface_initialize_NVM_CSCrtB.data_NVM_CSC_init.CSC6.energy_NegativeDischarge_Module "" ULONG CM_uint32 0 0 0 2147483646 ECU_ADDRESS 0x0000 DISPLAY_IDENTIFIER CSC6_energy_NegativeDischarge_Module /end MEASUREMENT
/begin MEASUREMENT Interface_initialize_NVM_CSCrtB.data_NVM_CSC_init.CSC6.energy_PositiveCharge_Module "" ULONG CM_uint32 0 0 0 2147483646 ECU_ADDRESS 0x0000 DISPLAY_IDENTIFIER CSC6_energy_PositiveCharge_Module /end MEASUREMENT
/begin MEASUREMENT Interface_initialize_NVM_CSCrtB.data_NVM_CSC_init.CSC6.energy_PositiveDischarge_Module "" ULONG CM_uint32 0 0 0 2147483646 ECU_ADDRESS 0x0000 DISPLAY_IDENTIFIER CSC6_energy_PositiveDischarge_Module /end MEASUREMENT
/begin MEASUREMENT Interface_initialize_NVM_CSCrtB.data_NVM_CSC_init.CSC6.idleTime_Module "" ULONG CM_uint32 0 0 0 2147483646 ECU_ADDRESS 0x0000 DISPLAY_IDENTIFIER CSC6_idleTime_Module /end MEASUREMENT
/begin MEASUREMENT Interface_initialize_NVM_CSCrtB.data_NVM_CSC_init.CSC6.operationTime_Module "" ULONG CM_uint32 0 0 0 2147483646 ECU_ADDRESS 0x0000 DISPLAY_IDENTIFIER CSC6_operationTime_Module /end MEASUREMENT
/begin MEASUREMENT Interface_initialize_NVM_CSCrtB.data_NVM_CSC_init.CSC7.SOH_Kernel_Module "" ULONG CM_uint32 0 0 0 2147483646 ECU_ADDRESS 0x0000 DISPLAY_IDENTIFIER CSC7_SOH_Kernel_Module /end MEASUREMENT
/begin MEASUREMENT Interface_initialize_NVM_CSCrtB.data_NVM_CSC_init.CSC7.calendricAge_Module "" ULONG CM_uint32 0 0 0 2147483646 ECU_ADDRESS 0x0000 DISPLAY_IDENTIFIER CSC7_calendricAge_Module /end MEASUREMENT
/begin MEASUREMENT Interface_initialize_NVM_CSCrtB.data_NVM_CSC_init.CSC7.calendricAging_SOH_Module "" ULONG CM_uint32 0 0 0 2147483646 ECU_ADDRESS 0x0000 DISPLAY_IDENTIFIER CSC7_calendricAging_SOH_Module /end MEASUREMENT
/begin MEASUREMENT Interface_initialize_NVM_CSCrtB.data_NVM_CSC_init.CSC7.cyclicAging_SOH_Module "" ULONG CM_uint32 0 0 0 2147483646 ECU_ADDRESS 0x0000 DISPLAY_IDENTIFIER CSC7_cyclicAging_SOH_Module /end MEASUREMENT
/begin MEASUREMENT Interface_initialize_NVM_CSCrtB.data_NVM_CSC_init.CSC7.energy_Module "" ULONG CM_uint32 0 0 0 2147483646 ECU_ADDRESS 0x0000 DISPLAY_IDENTIFIER CSC7_energy_Module /end MEASUREMENT
/begin MEASUREMENT Interface_initialize_NVM_CSCrtB.data_NVM_CSC_init.CSC7.energy_NegativeDischarge_Module "" ULONG CM_uint32 0 0 0 2147483646 ECU_ADDRESS 0x0000 DISPLAY_IDENTIFIER CSC7_energy_NegativeDischarge_Module /end MEASUREMENT
/begin MEASUREMENT Interface_initialize_NVM_CSCrtB.data_NVM_CSC_init.CSC7.energy_PositiveCharge_Module "" ULONG CM_uint32 0 0 0 2147483646 ECU_ADDRESS 0x0000 DISPLAY_IDENTIFIER CSC7_energy_PositiveCharge_Module /end MEASUREMENT
/begin MEASUREMENT Interface_initialize_NVM_CSCrtB.data_NVM_CSC_init.CSC7.energy_PositiveDischarge_Module "" ULONG CM_uint32 0 0 0 2147483646 ECU_ADDRESS 0x0000 DISPLAY_IDENTIFIER CSC7_energy_PositiveDischarge_Module /end MEASUREMENT
/begin MEASUREMENT Interface_initialize_NVM_CSCrtB.data_NVM_CSC_init.CSC7.idleTime_Module "" ULONG CM_uint32 0 0 0 2147483646 ECU_ADDRESS 0x0000 DISPLAY_IDENTIFIER CSC7_idleTime_Module /end MEASUREMENT
/begin MEASUREMENT Interface_initialize_NVM_CSCrtB.data_NVM_CSC_init.CSC7.operationTime_Module "" ULONG CM_uint32 0 0 0 2147483646 ECU_ADDRESS 0x0000 DISPLAY_IDENTIFIER CSC7_operationTime_Module /end MEASUREMENT
/begin MEASUREMENT Interface_initialize_NVM_CSCrtB.data_NVM_CSC_init.CSC8.SOH_Kernel_Module "" ULONG CM_uint32 0 0 0 2147483646 ECU_ADDRESS 0x0000 DISPLAY_IDENTIFIER CSC8_SOH_Kernel_Module /end MEASUREMENT
/begin MEASUREMENT Interface_initialize_NVM_CSCrtB.data_NVM_CSC_init.CSC8.calendricAge_Module "" ULONG CM_uint32 0 0 0 2147483646 ECU_ADDRESS 0x0000 DISPLAY_IDENTIFIER CSC8_calendricAge_Module /end MEASUREMENT
/begin MEASUREMENT Interface_initialize_NVM_CSCrtB.data_NVM_CSC_init.CSC8.calendricAging_SOH_Module "" ULONG CM_uint32 0 0 0 2147483646 ECU_ADDRESS 0x0000 DISPLAY_IDENTIFIER CSC8_calendricAging_SOH_Module /end MEASUREMENT
/begin MEASUREMENT Interface_initialize_NVM_CSCrtB.data_NVM_CSC_init.CSC8.cyclicAging_SOH_Module "" ULONG CM_uint32 0 0 0 2147483646 ECU_ADDRESS 0x0000 DISPLAY_IDENTIFIER CSC8_cyclicAging_SOH_Module /end MEASUREMENT
/begin MEASUREMENT Interface_initialize_NVM_CSCrtB.data_NVM_CSC_init.CSC8.energy_Module "" ULONG CM_uint32 0 0 0 2147483646 ECU_ADDRESS 0x0000 DISPLAY_IDENTIFIER CSC8_energy_Module /end MEASUREMENT
/begin MEASUREMENT Interface_initialize_NVM_CSCrtB.data_NVM_CSC_init.CSC8.energy_NegativeDischarge_Module "" ULONG CM_uint32 0 0 0 2147483646 ECU_ADDRESS 0x0000 DISPLAY_IDENTIFIER CSC8_energy_NegativeDischarge_Module /end MEASUREMENT
/begin MEASUREMENT Interface_initialize_NVM_CSCrtB.data_NVM_CSC_init.CSC8.energy_PositiveCharge_Module "" ULONG CM_uint32 0 0 0 2147483646 ECU_ADDRESS 0x0000 DISPLAY_IDENTIFIER CSC8_energy_PositiveCharge_Module /end MEASUREMENT
/begin MEASUREMENT Interface_initialize_NVM_CSCrtB.data_NVM_CSC_init.CSC8.energy_PositiveDischarge_Module "" ULONG CM_uint32 0 0 0 2147483646 ECU_ADDRESS 0x0000 DISPLAY_IDENTIFIER CSC8_energy_PositiveDischarge_Module /end MEASUREMENT
/begin MEASUREMENT Interface_initialize_NVM_CSCrtB.data_NVM_CSC_init.CSC8.idleTime_Module "" ULONG CM_uint32 0 0 0 2147483646 ECU_ADDRESS 0x0000 DISPLAY_IDENTIFIER CSC8_idleTime_Module /end MEASUREMENT
/begin MEASUREMENT Interface_initialize_NVM_CSCrtB.data_NVM_CSC_init.CSC8.operationTime_Module "" ULONG CM_uint32 0 0 0 2147483646 ECU_ADDRESS 0x0000 DISPLAY_IDENTIFIER CSC8_operationTime_Module /end MEASUREMENT
/begin MEASUREMENT Interface_main_100msrtB.update_input_Values.bus_KBSInput.AhCounter_CurrentSensor "" SLONG CM_int32_m_into_A_into_s 0 0 -100000000 2147483647 ECU_ADDRESS 0x0000 DISPLAY_IDENTIFIER KBSInput_AhCounter_CurrentSensor /end MEASUREMENT
/begin MEASUREMENT Interface_main_100msrtB.update_input_Values.bus_KBSInput.avgPowerConsumption_Vehicle "" ULONG CM_uint32_W 0 0 0 4294967295 ECU_ADDRESS 0x0000 DISPLAY_IDENTIFIER KBSInput_avgPowerConsumption_Vehicle /end MEASUREMENT
/begin MEASUREMENT Interface_main_100msrtB.update_input_Values.bus_KBSInput.chargingCurrent "" ULONG CM_uint32_A 0 0 0 4294967295 ECU_ADDRESS 0x0000 DISPLAY_IDENTIFIER KBSInput_chargingCurrent /end MEASUREMENT
/begin MEASUREMENT Interface_main_100msrtB.update_input_Values.bus_KBSInput.chargingPower "" ULONG CM_uint32_W 0 0 0 4294967295 ECU_ADDRESS 0x0000 DISPLAY_IDENTIFIER KBSInput_chargingPower /end MEASUREMENT
/begin MEASUREMENT Interface_main_100msrtB.update_input_Values.bus_KBSInput.chargingVoltage "" ULONG CM_uint32_V 0 0 0 4294967295 ECU_ADDRESS 0x0000 DISPLAY_IDENTIFIER KBSInput_chargingVoltage /end MEASUREMENT
/begin MEASUREMENT Interface_main_100msrtB.update_input_Values.bus_KBSInput.current_Battery "" SLONG CM_int32_m_into_A 0 0 -10000000 2147483647 ECU_ADDRESS 0x0000 DISPLAY_IDENTIFIER KBSInput_current_Battery /end MEASUREMENT
/begin MEASUREMENT Interface_main_100msrtB.update_input_Values.bus_KBSInput.current_CPS "" UWORD CM_uint16_m_into_A 0 0 0 65535 ECU_ADDRESS 0x0000 DISPLAY_IDENTIFIER KBSInput_current_CPS /end MEASUREMENT
/begin MEASUREMENT Interface_main_100msrtB.update_input_Values.bus_KBSInput.dateTime "" ULONG CM_uint32_s 0 0 0 4294967295 ECU_ADDRESS 0x0000 DISPLAY_IDENTIFIER KBSInput_dateTime /end MEASUREMENT
/begin MEASUREMENT Interface_main_100msrtB.update_input_Values.bus_KBSInput.durationLastCall_1000ms "" ULONG CM_uint32_m_into_s 0 0 0 4294967295 ECU_ADDRESS 0x0000 DISPLAY_IDENTIFIER KBSInput_durationLastCall_1000ms /end MEASUREMENT
/begin MEASUREMENT Interface_main_100msrtB.update_input_Values.bus_KBSInput.durationLastCall_100ms "" ULONG CM_uint32_m_into_s 0 0 0 4294967295 ECU_ADDRESS 0x0000 DISPLAY_IDENTIFIER KBSInput_durationLastCall_100ms /end MEASUREMENT
/begin MEASUREMENT Interface_main_100msrtB.update_input_Values.bus_KBSInput.durationLastCall_10ms "" ULONG CM_uint32_m_into_s 0 0 0 4294967295 ECU_ADDRESS 0x0000 DISPLAY_IDENTIFIER KBSInput_durationLastCall_10ms /end MEASUREMENT
/begin MEASUREMENT Interface_main_100msrtB.update_input_Values.bus_KBSInput.factorPowerReduction "" UBYTE CM_uint8_percent_ 0 0 0 255 ECU_ADDRESS 0x0000 DISPLAY_IDENTIFIER KBSInput_factorPowerReduction /end MEASUREMENT
/begin MEASUREMENT Interface_main_100msrtB.update_input_Values.bus_KBSInput.get_PWM_BCM "" UWORD CM_uint16_percent_ 0 0 0 65535 ECU_ADDRESS 0x0000 DISPLAY_IDENTIFIER KBSInput_get_PWM_BCM /end MEASUREMENT
/begin MEASUREMENT Interface_main_100msrtB.update_input_Values.bus_KBSInput.get_balancing_Battery "" UBYTE CM_ENUM_GET_SET 0 0 0 1 ECU_ADDRESS 0x0000 DISPLAY_IDENTIFIER KBSInput_get_balancing_Battery /end MEASUREMENT
/begin MEASUREMENT Interface_main_100msrtB.update_input_Values.bus_KBSInput.get_balancing_Cell "" UBYTE CM_ENUM_GET_SET 0 0 0 1 LAYOUT COLUMN_DIR MATRIX_DIM 8 15 ECU_ADDRESS 0x0000 DISPLAY_IDENTIFIER KBSInput_get_balancing_Cell /end MEASUREMENT
/begin MEASUREMENT Interface_main_100msrtB.update_input_Values.bus_KBSInput.get_enable_BCM "" UBYTE CM_ENUM_GET_SET 0 0 0 1 ECU_ADDRESS 0x0000 DISPLAY_IDENTIFIER KBSInput_get_enable_BCM /end MEASUREMENT
/begin MEASUREMENT Interface_main_100msrtB.update_input_Values.bus_KBSInput.get_heating_Module "" UBYTE CM_ENUM_GET_SET 0 0 0 1 LAYOUT ROW_DIR MATRIX_DIM 8 1 ECU_ADDRESS 0x0000 DISPLAY_IDENTIFIER KBSInput_get_heating_Module /end MEASUREMENT
/begin MEASUREMENT Interface_main_100msrtB.update_input_Values.bus_KBSInput.get_speed_Fan "" UWORD CM_uint16_1_per_min 0 0 0 65535 ECU_ADDRESS 0x0000 DISPLAY_IDENTIFIER KBSInput_get_speed_Fan /end MEASUREMENT
/begin MEASUREMENT Interface_main_100msrtB.update_input_Values.bus_KBSInput.heatingCurrent_Module "" SLONG CM_int32_m_into_A 0 0 -50000 2147483647 LAYOUT ROW_DIR MATRIX_DIM 8 1 ECU_ADDRESS 0x0000 DISPLAY_IDENTIFIER KBSInput_heatingCurrent_Module /end MEASUREMENT
/begin MEASUREMENT Interface_main_100msrtB.update_input_Values.bus_KBSInput.operatingMode_Fan "" UBYTE CM_ENUM_OPERATINGMODE_FAN 0 0 0 2 ECU_ADDRESS 0x0000 DISPLAY_IDENTIFIER KBSInput_operatingMode_Fan /end MEASUREMENT
/begin MEASUREMENT Interface_main_100msrtB.update_input_Values.bus_KBSInput.selfDischargeTime "" ULONG CM_uint32_s 0 0 0 4294967295 ECU_ADDRESS 0x0000 DISPLAY_IDENTIFIER KBSInput_selfDischargeTime /end MEASUREMENT
/begin MEASUREMENT Interface_main_100msrtB.update_input_Values.bus_KBSInput.state_BMS "" UBYTE CM_ENUM_STATE_BMS 0 0 0 136 ECU_ADDRESS 0x0000 DISPLAY_IDENTIFIER KBSInput_state_BMS /end MEASUREMENT
/begin MEASUREMENT Interface_main_100msrtB.update_input_Values.bus_KBSInput.state_Charger "" UBYTE CM_ENUM_CONNECTION 0 0 0 1 ECU_ADDRESS 0x0000 DISPLAY_IDENTIFIER KBSInput_state_Charger /end MEASUREMENT
/begin MEASUREMENT Interface_main_100msrtB.update_input_Values.bus_KBSInput.state_Truck "" UBYTE CM_ENUM_CONNECTION 0 0 0 1 ECU_ADDRESS 0x0000 DISPLAY_IDENTIFIER KBSInput_state_Truck /end MEASUREMENT
/begin MEASUREMENT Interface_main_100msrtB.update_input_Values.bus_KBSInput.temperature_MasterPCB "" SWORD CM_int16_deg_C 0 0 -40 32767 ECU_ADDRESS 0x0000 DISPLAY_IDENTIFIER KBSInput_temperature_MasterPCB /end MEASUREMENT
/begin MEASUREMENT Interface_main_100msrtB.update_input_Values.bus_KBSInput.temperature_Sensor "" SWORD CM_int16_deg_C 0 0 -40 32767 LAYOUT COLUMN_DIR MATRIX_DIM 8 8 ECU_ADDRESS 0x0000 DISPLAY_IDENTIFIER KBSInput_temperature_Sensor /end MEASUREMENT
/begin MEASUREMENT Interface_main_100msrtB.update_input_Values.bus_KBSInput.voltageAfterContactors "" ULONG CM_uint32_m_into_V 0 0 0 4294967295 ECU_ADDRESS 0x0000 DISPLAY_IDENTIFIER KBSInput_voltageAfterContactors /end MEASUREMENT
/begin MEASUREMENT Interface_main_100msrtB.update_input_Values.bus_KBSInput.voltageBeforeContactors "" ULONG CM_uint32_m_into_V 0 0 0 4294967295 ECU_ADDRESS 0x0000 DISPLAY_IDENTIFIER KBSInput_voltageBeforeContactors /end MEASUREMENT
/begin MEASUREMENT Interface_main_100msrtB.update_input_Values.bus_KBSInput.voltageBetweenContactors "" ULONG CM_uint32_m_into_V 0 0 0 4294967295 ECU_ADDRESS 0x0000 DISPLAY_IDENTIFIER KBSInput_voltageBetweenContactors /end MEASUREMENT
/begin MEASUREMENT Interface_main_100msrtB.update_input_Values.bus_KBSInput.voltage_Cell "" UWORD CM_uint16_m_into_V 0 0 0 65535 LAYOUT COLUMN_DIR MATRIX_DIM 8 15 ECU_ADDRESS 0x0000 DISPLAY_IDENTIFIER KBSInput_voltage_Cell /end MEASUREMENT
/begin MEASUREMENT Interface_main_100msrtB.update_input_Values.bus_KBSInput.workTime_Component "" ULONG CM_uint32_s 0 0 0 4294967295 ECU_ADDRESS 0x0000 DISPLAY_IDENTIFIER KBSInput_workTime_Component /end MEASUREMENT
/begin MEASUREMENT Interface_main_100msrtB.update_input_Values.bus_KBSInput.workTime_Truck "" ULONG CM_uint32_s 0 0 0 4294967295 ECU_ADDRESS 0x0000 DISPLAY_IDENTIFIER KBSInput_workTime_Truck /end MEASUREMENT
/begin MEASUREMENT kbsInput.AhCounter_CurrentSensor "" SLONG CM_int32_m_into_A_into_s 0 0 -100000000 2147483647 ECU_ADDRESS 0x0000 DISPLAY_IDENTIFIER kbsInput_AhCounter_CurrentSensor /end MEASUREMENT
/begin MEASUREMENT kbsInput.avgPowerConsumption_Vehicle "" ULONG CM_uint32_W 0 0 0 4294967295 ECU_ADDRESS 0x0000 DISPLAY_IDENTIFIER kbsInput_avgPowerConsumption_Vehicle /end MEASUREMENT
/begin MEASUREMENT kbsInput.chargingCurrent "" ULONG CM_uint32_A 0 0 0 4294967295 ECU_ADDRESS 0x0000 DISPLAY_IDENTIFIER kbsInput_chargingCurrent /end MEASUREMENT
/begin MEASUREMENT kbsInput.chargingPower "" ULONG CM_uint32_W 0 0 0 4294967295 ECU_ADDRESS 0x0000 DISPLAY_IDENTIFIER kbsInput_chargingPower /end MEASUREMENT
/begin MEASUREMENT kbsInput.chargingVoltage "" ULONG CM_uint32_V 0 0 0 4294967295 ECU_ADDRESS 0x0000 DISPLAY_IDENTIFIER kbsInput_chargingVoltage /end MEASUREMENT
/begin MEASUREMENT kbsInput.current_Battery "" SLONG CM_int32_m_into_A 0 0 -10000000 2147483647 ECU_ADDRESS 0x0000 DISPLAY_IDENTIFIER kbsInput_current_Battery /end MEASUREMENT
/begin MEASUREMENT kbsInput.current_CPS "" UWORD CM_uint16_m_into_A 0 0 0 65535 ECU_ADDRESS 0x0000 DISPLAY_IDENTIFIER kbsInput_current_CPS /end MEASUREMENT
/begin MEASUREMENT kbsInput.dateTime "" ULONG CM_uint32_s 0 0 0 4294967295 ECU_ADDRESS 0x0000 DISPLAY_IDENTIFIER kbsInput_dateTime /end MEASUREMENT
/begin MEASUREMENT kbsInput.durationLastCall_1000ms "" ULONG CM_uint32_m_into_s 0 0 0 4294967295 ECU_ADDRESS 0x0000 DISPLAY_IDENTIFIER kbsInput_durationLastCall_1000ms /end MEASUREMENT
/begin MEASUREMENT kbsInput.durationLastCall_100ms "" ULONG CM_uint32_m_into_s 0 0 0 4294967295 ECU_ADDRESS 0x0000 DISPLAY_IDENTIFIER kbsInput_durationLastCall_100ms /end MEASUREMENT
/begin MEASUREMENT kbsInput.durationLastCall_10ms "" ULONG CM_uint32_m_into_s 0 0 0 4294967295 ECU_ADDRESS 0x0000 DISPLAY_IDENTIFIER kbsInput_durationLastCall_10ms /end MEASUREMENT
/begin MEASUREMENT kbsInput.factorPowerReduction "" UBYTE CM_uint8_percent_ 0 0 0 255 ECU_ADDRESS 0x0000 DISPLAY_IDENTIFIER kbsInput_factorPowerReduction /end MEASUREMENT
/begin MEASUREMENT kbsInput.get_PWM_BCM "" UWORD CM_uint16_percent_ 0 0 0 65535 ECU_ADDRESS 0x0000 DISPLAY_IDENTIFIER kbsInput_get_PWM_BCM /end MEASUREMENT
/begin MEASUREMENT kbsInput.get_balancing_Battery "" UBYTE CM_ENUM_GET_SET 0 0 0 1 ECU_ADDRESS 0x0000 DISPLAY_IDENTIFIER kbsInput_get_balancing_Battery /end MEASUREMENT
/begin MEASUREMENT kbsInput.get_balancing_Cell "" UBYTE CM_ENUM_GET_SET 0 0 0 1 LAYOUT COLUMN_DIR MATRIX_DIM 8 15 ECU_ADDRESS 0x0000 DISPLAY_IDENTIFIER kbsInput_get_balancing_Cell /end MEASUREMENT
/begin MEASUREMENT kbsInput.get_enable_BCM "" UBYTE CM_ENUM_GET_SET 0 0 0 1 ECU_ADDRESS 0x0000 DISPLAY_IDENTIFIER kbsInput_get_enable_BCM /end MEASUREMENT
/begin MEASUREMENT kbsInput.get_heating_Module "" UBYTE CM_ENUM_GET_SET 0 0 0 1 LAYOUT ROW_DIR MATRIX_DIM 8 1 ECU_ADDRESS 0x0000 DISPLAY_IDENTIFIER kbsInput_get_heating_Module /end MEASUREMENT
/begin MEASUREMENT kbsInput.get_speed_Fan "" UWORD CM_uint16_1_per_min 0 0 0 65535 ECU_ADDRESS 0x0000 DISPLAY_IDENTIFIER kbsInput_get_speed_Fan /end MEASUREMENT
/begin MEASUREMENT kbsInput.heatingCurrent_Module "" SLONG CM_int32_m_into_A 0 0 -50000 2147483647 LAYOUT ROW_DIR MATRIX_DIM 8 1 ECU_ADDRESS 0x0000 DISPLAY_IDENTIFIER kbsInput_heatingCurrent_Module /end MEASUREMENT
/begin MEASUREMENT kbsInput.operatingMode_Fan "" UBYTE CM_ENUM_OPERATINGMODE_FAN 0 0 0 2 ECU_ADDRESS 0x0000 DISPLAY_IDENTIFIER kbsInput_operatingMode_Fan /end MEASUREMENT
/begin MEASUREMENT kbsInput.selfDischargeTime "" ULONG CM_uint32_s 0 0 0 4294967295 ECU_ADDRESS 0x0000 DISPLAY_IDENTIFIER kbsInput_selfDischargeTime /end MEASUREMENT
/begin MEASUREMENT kbsInput.state_BMS "" UBYTE CM_ENUM_STATE_BMS 0 0 0 136 ECU_ADDRESS 0x0000 DISPLAY_IDENTIFIER kbsInput_state_BMS /end MEASUREMENT
/begin MEASUREMENT kbsInput.state_Charger "" UBYTE CM_ENUM_CONNECTION 0 0 0 1 ECU_ADDRESS 0x0000 DISPLAY_IDENTIFIER kbsInput_state_Charger /end MEASUREMENT
/begin MEASUREMENT kbsInput.state_Truck "" UBYTE CM_ENUM_CONNECTION 0 0 0 1 ECU_ADDRESS 0x0000 DISPLAY_IDENTIFIER kbsInput_state_Truck /end MEASUREMENT
/begin MEASUREMENT kbsInput.temperature_MasterPCB "" SWORD CM_int16_deg_C 0 0 -40 32767 ECU_ADDRESS 0x0000 DISPLAY_IDENTIFIER kbsInput_temperature_MasterPCB /end MEASUREMENT
/begin MEASUREMENT kbsInput.temperature_Sensor "" SWORD CM_int16_deg_C 0 0 -40 32767 LAYOUT COLUMN_DIR MATRIX_DIM 8 8 ECU_ADDRESS 0x0000 DISPLAY_IDENTIFIER kbsInput_temperature_Sensor /end MEASUREMENT
/begin MEASUREMENT kbsInput.voltageAfterContactors "" ULONG CM_uint32_m_into_V 0 0 0 4294967295 ECU_ADDRESS 0x0000 DISPLAY_IDENTIFIER kbsInput_voltageAfterContactors /end MEASUREMENT
/begin MEASUREMENT kbsInput.voltageBeforeContactors "" ULONG CM_uint32_m_into_V 0 0 0 4294967295 ECU_ADDRESS 0x0000 DISPLAY_IDENTIFIER kbsInput_voltageBeforeContactors /end MEASUREMENT
/begin MEASUREMENT kbsInput.voltageBetweenContactors "" ULONG CM_uint32_m_into_V 0 0 0 4294967295 ECU_ADDRESS 0x0000 DISPLAY_IDENTIFIER kbsInput_voltageBetweenContactors /end MEASUREMENT
/begin MEASUREMENT kbsInput.voltage_Cell "" UWORD CM_uint16_m_into_V 0 0 0 65535 LAYOUT COLUMN_DIR MATRIX_DIM 8 15 ECU_ADDRESS 0x0000 DISPLAY_IDENTIFIER kbsInput_voltage_Cell /end MEASUREMENT
/begin MEASUREMENT kbsInput.workTime_Component "" ULONG CM_uint32_s 0 0 0 4294967295 ECU_ADDRESS 0x0000 DISPLAY_IDENTIFIER kbsInput_workTime_Component /end MEASUREMENT
/begin MEASUREMENT kbsInput.workTime_Truck "" ULONG CM_uint32_s 0 0 0 4294967295 ECU_ADDRESS 0x0000 DISPLAY_IDENTIFIER kbsInput_workTime_Truck /end MEASUREMENT
/begin MEASUREMENT kbsOutput.SOCwithSOH "" UWORD CM_uint16_percent_ 0 0 0 65535 ECU_ADDRESS 0x0000 DISPLAY_IDENTIFIER kbsOutput_SOCwithSOH /end MEASUREMENT
/begin MEASUREMENT kbsOutput.SOCwithoutSOH "" UWORD CM_uint16_percent_ 0 0 0 65535 ECU_ADDRESS 0x0000 DISPLAY_IDENTIFIER kbsOutput_SOCwithoutSOH /end MEASUREMENT
/begin MEASUREMENT kbsOutput.SOH_Capacity "" UWORD CM_uint16_percent_ 0 0 0 65535 ECU_ADDRESS 0x0000 DISPLAY_IDENTIFIER kbsOutput_SOH_Capacity /end MEASUREMENT
/begin MEASUREMENT kbsOutput.SOH_Performance "" UWORD CM_uint16_percent_ 0 0 0 65535 ECU_ADDRESS 0x0000 DISPLAY_IDENTIFIER kbsOutput_SOH_Performance /end MEASUREMENT
/begin MEASUREMENT kbsOutput.currentLimited "" UBYTE CM_ENUM_CURRENTLIMITED 0 0 0 3 ECU_ADDRESS 0x0000 DISPLAY_IDENTIFIER kbsOutput_currentLimited /end MEASUREMENT
/begin MEASUREMENT kbsOutput.maxChargeCurrent_Continuous "" ULONG CM_uint32_m_into_A 0 0 0 4294967295 ECU_ADDRESS 0x0000 DISPLAY_IDENTIFIER kbsOutput_maxChargeCurrent_Continuous /end MEASUREMENT
/begin MEASUREMENT kbsOutput.maxChargeCurrent_Pulse "" ULONG CM_uint32_m_into_A 0 0 0 4294967295 ECU_ADDRESS 0x0000 DISPLAY_IDENTIFIER kbsOutput_maxChargeCurrent_Pulse /end MEASUREMENT
/begin MEASUREMENT kbsOutput.maxChargePower_Continuous "" ULONG CM_uint32_W 0 0 0 4294967295 ECU_ADDRESS 0x0000 DISPLAY_IDENTIFIER kbsOutput_maxChargePower_Continuous /end MEASUREMENT
/begin MEASUREMENT kbsOutput.maxChargePower_Pulse "" ULONG CM_uint32_W 0 0 0 4294967295 ECU_ADDRESS 0x0000 DISPLAY_IDENTIFIER kbsOutput_maxChargePower_Pulse /end MEASUREMENT
/begin MEASUREMENT kbsOutput.maxDischargeCurrent_Continuous "" ULONG CM_uint32_m_into_A 0 0 0 4294967295 ECU_ADDRESS 0x0000 DISPLAY_IDENTIFIER kbsOutput_maxDischargeCurrent_Continuous /end MEASUREMENT
/begin MEASUREMENT kbsOutput.maxDischargeCurrent_Pulse "" ULONG CM_uint32_m_into_A 0 0 0 4294967295 ECU_ADDRESS 0x0000 DISPLAY_IDENTIFIER kbsOutput_maxDischargeCurrent_Pulse /end MEASUREMENT
/begin MEASUREMENT kbsOutput.maxDischargePower_Continuous "" ULONG CM_uint32_W 0 0 0 4294967295 ECU_ADDRESS 0x0000 DISPLAY_IDENTIFIER kbsOutput_maxDischargePower_Continuous /end MEASUREMENT
/begin MEASUREMENT kbsOutput.maxDischargePower_Pulse "" ULONG CM_uint32_W 0 0 0 4294967295 ECU_ADDRESS 0x0000 DISPLAY_IDENTIFIER kbsOutput_maxDischargePower_Pulse /end MEASUREMENT
/begin MEASUREMENT kbsOutput.remainingCapacity_Actual "" ULONG CM_uint32_m_into_A_into_h 0 0 0 4294967295 ECU_ADDRESS 0x0000 DISPLAY_IDENTIFIER kbsOutput_remainingCapacity_Actual /end MEASUREMENT
/begin MEASUREMENT kbsOutput.set_balancing_Cell "" UBYTE CM_ENUM_GET_SET 0 0 0 1 LAYOUT COLUMN_DIR MATRIX_DIM 8 15 ECU_ADDRESS 0x0000 DISPLAY_IDENTIFIER kbsOutput_set_balancing_Cell /end MEASUREMENT
/begin MEASUREMENT kbsOutput.set_enable_BCM "" UBYTE CM_ENUM_GET_SET 0 0 0 1 ECU_ADDRESS 0x0000 DISPLAY_IDENTIFIER kbsOutput_set_enable_BCM /end MEASUREMENT
/begin MEASUREMENT kbsOutput.set_heating_Module "" UBYTE CM_ENUM_GET_SET 0 0 0 1 LAYOUT ROW_DIR MATRIX_DIM 8 1 ECU_ADDRESS 0x0000 DISPLAY_IDENTIFIER kbsOutput_set_heating_Module /end MEASUREMENT
/begin MEASUREMENT kbsOutput.set_speed_Fan "" UWORD CM_uint16_1_per_min 0 0 0 65535 ECU_ADDRESS 0x0000 DISPLAY_IDENTIFIER kbsOutput_set_speed_Fan /end MEASUREMENT
/begin MEASUREMENT kbsOutput.state_balancing_Battery "" UBYTE CM_ENUM_STATE_BALANCING 0 0 0 1 ECU_ADDRESS 0x0000 DISPLAY_IDENTIFIER kbsOutput_state_balancing_Battery /end MEASUREMENT
/begin MEASUREMENT Interface_main_100msrtB.assignLastValues.last_OCV_Map_Cell "" UWORD CM_uint16_m_into_V 0 0 0 65535 LAYOUT COLUMN_DIR MATRIX_DIM 8 15 ECU_ADDRESS 0x0000 DISPLAY_IDENTIFIER last_OCV_Map_Cell /end MEASUREMENT
/begin MEASUREMENT Interface_main_100msrtB.assignLastValues.last_PWM_BCM_Out "" UWORD CM_uint16_percent_ 0 0 0 65535 ECU_ADDRESS 0x0000 DISPLAY_IDENTIFIER last_PWM_BCM_Out /end MEASUREMENT
/begin MEASUREMENT Interface_main_100msrtB.read_buffer_NVM_BMS_stateOfCharge.NVM_BMS_last_SOC_Handler_Battery "" ULONG CM_uint32_percent_ 0 0 0 4294967295 ECU_ADDRESS 0x0000 DISPLAY_IDENTIFIER last_SOC_Handler_Battery /end MEASUREMENT
/begin MEASUREMENT Interface_main_100msrtB.read_buffer_NVM_BMS_stateOfCharge.NVM_BMS_last_SOC_Kernel_Battery "" ULONG CM_uint32_percent_ 0 0 0 4294967295 ECU_ADDRESS 0x0000 DISPLAY_IDENTIFIER last_SOC_Kernel_Battery /end MEASUREMENT
/begin MEASUREMENT Interface_main_100msrtB.read_buffer_NVM_BMS_stateOfCharge.NVM_BMS_last_SOC_Kernel_Cell "" ULONG CM_uint32_percent_ 0 0 0 4294967295 LAYOUT COLUMN_DIR MATRIX_DIM 8 15 ECU_ADDRESS 0x0000 DISPLAY_IDENTIFIER last_SOC_Kernel_Cell /end MEASUREMENT
/begin MEASUREMENT Interface_main_100msrtB.assignLastValues.last_SOC_Map_Cell "" ULONG CM_uint32_percent_ 0 0 0 4294967295 LAYOUT COLUMN_DIR MATRIX_DIM 8 15 ECU_ADDRESS 0x0000 DISPLAY_IDENTIFIER last_SOC_Map_Cell /end MEASUREMENT
/begin MEASUREMENT Interface_main_100msrtB.assignLastValues.last_capacity_Table_Cell "" ULONG CM_uint32_m_into_A_into_h 0 0 0 4294967295 LAYOUT COLUMN_DIR MATRIX_DIM 8 15 ECU_ADDRESS 0x0000 DISPLAY_IDENTIFIER last_capacity_Table_Cell /end MEASUREMENT
/begin MEASUREMENT Interface_main_100msrtB.read_buffer_NVM_BMS_dataProcessing.NVM_BMS_last_cellNumber "" UWORD CM_uint16 0 0 0 65535 ECU_ADDRESS 0x0000 DISPLAY_IDENTIFIER last_cellNumber /end MEASUREMENT
/begin MEASUREMENT Interface_main_100msrtB.assignLastValues.last_counter_capacityEstimation "" ULONG CM_uint32 0 0 0 4294967295 ECU_ADDRESS 0x0000 DISPLAY_IDENTIFIER last_counter_capacityEstimation /end MEASUREMENT
/begin MEASUREMENT Interface_main_100msrtB.assignLastValues.last_counter_currentDerating "" ULONG CM_uint32 0 0 0 4294967295 ECU_ADDRESS 0x0000 DISPLAY_IDENTIFIER last_counter_currentDerating /end MEASUREMENT
/begin MEASUREMENT Interface_main_100msrtB.assignLastValues.last_counter_dataProcessing "" ULONG CM_uint32 0 0 0 4294967295 ECU_ADDRESS 0x0000 DISPLAY_IDENTIFIER last_counter_dataProcessing /end MEASUREMENT
/begin MEASUREMENT Interface_main_100msrtB.assignLastValues.last_counter_heatingStrategy "" ULONG CM_uint32 0 0 0 4294967295 ECU_ADDRESS 0x0000 DISPLAY_IDENTIFIER last_counter_heatingStrategy /end MEASUREMENT
/begin MEASUREMENT Interface_main_100msrtB.assignLastValues.last_counter_stateOfCharge "" ULONG CM_uint32 0 0 0 4294967295 ECU_ADDRESS 0x0000 DISPLAY_IDENTIFIER last_counter_stateOfCharge /end MEASUREMENT
/begin MEASUREMENT Interface_main_100msrtB.read_buffer_NVM_BMS_stateOfCharge.NVM_BMS_last_deltaChangeResidual_SOC "" SLONG CM_int32_percent_ 0 0 -100000 2147483647 ECU_ADDRESS 0x0000 DISPLAY_IDENTIFIER last_deltaChangeResidual_SOC /end MEASUREMENT
/begin MEASUREMENT Interface_main_100msrtB.read_buffer_NVM_BMS_currentDerating.NVM_BMS_last_deratingFactor_MaxCellVoltage "" UWORD CM_uint16_percent_ 0 0 0 65535 ECU_ADDRESS 0x0000 DISPLAY_IDENTIFIER last_deratingFactor_MaxCellVoltage /end MEASUREMENT
/begin MEASUREMENT Interface_main_100msrtB.read_buffer_NVM_BMS_currentDerating.NVM_BMS_last_deratingFactor_MaxDrive "" UWORD CM_uint16_percent_ 0 0 0 65535 ECU_ADDRESS 0x0000 DISPLAY_IDENTIFIER last_deratingFactor_MaxDrive /end MEASUREMENT
/begin MEASUREMENT Interface_main_100msrtB.read_buffer_NVM_BMS_currentDerating.NVM_BMS_last_deratingFactor_MaxRegeneration "" UWORD CM_uint16_percent_ 0 0 0 65535 ECU_ADDRESS 0x0000 DISPLAY_IDENTIFIER last_deratingFactor_MaxRegeneration /end MEASUREMENT
/begin MEASUREMENT Interface_main_100msrtB.read_buffer_NVM_BMS_currentDerating.NVM_BMS_last_deratingFactor_MinCellVoltage "" UWORD CM_uint16_percent_ 0 0 0 65535 ECU_ADDRESS 0x0000 DISPLAY_IDENTIFIER last_deratingFactor_MinCellVoltage /end MEASUREMENT
/begin MEASUREMENT Interface_main_100msrtB.read_buffer_NVM_BMS_heatingStrategy.NVM_BMS_last_heatingEnergy_Module "" ULONG CM_uint32_W_into_s 0 0 0 4294967295 LAYOUT COLUMN_DIR MATRIX_DIM 8 1 ECU_ADDRESS 0x0000 DISPLAY_IDENTIFIER last_heatingEnergy_Module /end MEASUREMENT
/begin MEASUREMENT Interface_main_100msrtB.assignLastValues.last_internalResistanceCharged_Cell "" ULONG CM_uint32___into_Ohm 0 0 0 4294967295 LAYOUT COLUMN_DIR MATRIX_DIM 8 15 ECU_ADDRESS 0x0000 DISPLAY_IDENTIFIER last_internalResistanceCharged_Cell /end MEASUREMENT
/begin MEASUREMENT Interface_main_100msrtB.assignLastValues.last_internalResistanceDischarged_Cell "" ULONG CM_uint32___into_Ohm 0 0 0 4294967295 LAYOUT COLUMN_DIR MATRIX_DIM 8 15 ECU_ADDRESS 0x0000 DISPLAY_IDENTIFIER last_internalResistanceDischarged_Cell /end MEASUREMENT
/begin MEASUREMENT Interface_main_100msrtB.read_buffer_NVM_BMS_currentDerating.NVM_BMS_last_maxChargeCurrent_Continuous "" ULONG CM_uint32_m_into_A 0 0 0 4294967295 ECU_ADDRESS 0x0000 DISPLAY_IDENTIFIER last_maxChargeCurrent_Continuous /end MEASUREMENT
/begin MEASUREMENT Interface_main_100msrtB.read_buffer_NVM_BMS_currentDerating.NVM_BMS_last_maxChargeCurrent_Pulse "" ULONG CM_uint32_m_into_A 0 0 0 4294967295 ECU_ADDRESS 0x0000 DISPLAY_IDENTIFIER last_maxChargeCurrent_Pulse /end MEASUREMENT
/begin MEASUREMENT Interface_main_100msrtB.read_buffer_NVM_BMS_currentDerating.NVM_BMS_last_maxDischargeCurrent_Continuous "" ULONG CM_uint32_m_into_A 0 0 0 4294967295 ECU_ADDRESS 0x0000 DISPLAY_IDENTIFIER last_maxDischargeCurrent_Continuous /end MEASUREMENT
/begin MEASUREMENT Interface_main_100msrtB.read_buffer_NVM_BMS_currentDerating.NVM_BMS_last_maxDischargeCurrent_Pulse "" ULONG CM_uint32_m_into_A 0 0 0 4294967295 ECU_ADDRESS 0x0000 DISPLAY_IDENTIFIER last_maxDischargeCurrent_Pulse /end MEASUREMENT
/begin MEASUREMENT Interface_main_100msrtB.read_buffer_NVM_BMS_heatingStrategy.NVM_BMS_last_minHeatingEnergy_String "" ULONG CM_uint32_W_into_s 0 0 0 4294967295 LAYOUT COLUMN_DIR MATRIX_DIM 8 1 ECU_ADDRESS 0x0000 DISPLAY_IDENTIFIER last_minHeatingEnergy_String /end MEASUREMENT
/begin MEASUREMENT Interface_main_100msrtB.assignLastValues.last_relaxationTime "" ULONG CM_uint32_m_into_s 0 0 0 4294967295 ECU_ADDRESS 0x0000 DISPLAY_IDENTIFIER last_relaxationTime /end MEASUREMENT
/begin MEASUREMENT Interface_main_100msrtB.assignLastValues.last_state_Handler_stateOfCharge "" UBYTE CM_ENUM_STATE_HANDLER_SOC 0 0 0 2 ECU_ADDRESS 0x0000 DISPLAY_IDENTIFIER last_state_Handler_stateOfCharge /end MEASUREMENT
/begin MEASUREMENT Interface_main_100msrtB.read_buffer_NVM_BMS_heatingStrategy.NVM_BMS_last_state_energyBalance_Module "" UBYTE CM_ENUM_STATE_ENERGYBALANCE_MODULE 0 0 0 4 LAYOUT COLUMN_DIR MATRIX_DIM 8 1 ECU_ADDRESS 0x0000 DISPLAY_IDENTIFIER last_state_energyBalance_Module /end MEASUREMENT
/begin MEASUREMENT Interface_main_100msrtB.assignLastValues.last_state_sleepCompensation_SOC "" UBYTE CM_ENUM_TRUE_FALSE 0 0 0 1 ECU_ADDRESS 0x0000 DISPLAY_IDENTIFIER last_state_sleepCompensation_SOC /end MEASUREMENT
/begin MEASUREMENT Interface_main_100msrtB.read_buffer_NVM_BMS_heatingStrategy.NVM_BMS_last_state_temperature_Module "" UBYTE CM_ENUM_STATE_TEMPERATURE_MODULE 0 0 0 3 LAYOUT COLUMN_DIR MATRIX_DIM 8 1 ECU_ADDRESS 0x0000 DISPLAY_IDENTIFIER last_state_temperature_Module /end MEASUREMENT
/begin CHARACTERISTIC map_OCV "" MAP 0x0000 Scalar_UWORD_Map_21_21 0 CM_uint16_m_into_V 0 65535
 /begin AXIS_DESCR COM_AXIS NO_INPUT_QUANTITY NO_COMPU_METHOD 21 0 0 AXIS_PTS_REF bins_temperature_CellMap /end AXIS_DESCR
 /begin AXIS_DESCR COM_AXIS NO_INPUT_QUANTITY NO_COMPU_METHOD 21 0 0 AXIS_PTS_REF bins_SOC_CellMap /end AXIS_DESCR
/end CHARACTERISTIC
/begin CHARACTERISTIC map_chargingCurrent_Continuous "" MAP 0x0000 Scalar_ULONG_Map_14_11 0 CM_uint32_m_into_A 0 4294967295
 /begin AXIS_DESCR COM_AXIS NO_INPUT_QUANTITY NO_COMPU_METHOD 14 0 0 AXIS_PTS_REF bins_temperature_CurrentMap /end AXIS_DESCR
 /begin AXIS_DESCR COM_AXIS NO_INPUT_QUANTITY NO_COMPU_METHOD 11 0 0 AXIS_PTS_REF bins_SOC_CurrentMap /end AXIS_DESCR
/end CHARACTERISTIC
/begin CHARACTERISTIC map_chargingCurrent_Pulse "" MAP 0x0000 Scalar_ULONG_Map_14_11 0 CM_uint32_m_into_A 0 4294967295
 /begin AXIS_DESCR COM_AXIS NO_INPUT_QUANTITY NO_COMPU_METHOD 14 0 0 AXIS_PTS_REF bins_temperature_CurrentMap /end AXIS_DESCR
 /begin AXIS_DESCR COM_AXIS NO_INPUT_QUANTITY NO_COMPU_METHOD 11 0 0 AXIS_PTS_REF bins_SOC_CurrentMap /end AXIS_DESCR
/end CHARACTERISTIC
/begin CHARACTERISTIC map_chargingInternalResistance "" MAP 0x0000 Scalar_ULONG_Map_21_21 0 CM_uint32___into_Ohm 0 4294967295
 /begin AXIS_DESCR COM_AXIS NO_INPUT_QUANTITY NO_COMPU_METHOD 21 0 0 AXIS_PTS_REF bins_temperature_CellMap /end AXIS_DESCR
 /begin AXIS_DESCR COM_AXIS NO_INPUT_QUANTITY NO_COMPU_METHOD 21 0 0 AXIS_PTS_REF bins_SOC_CellMap /end AXIS_DESCR
/end CHARACTERISTIC
/begin CHARACTERISTIC map_dischargingCurrent_Continuous "" MAP 0x0000 Scalar_ULONG_Map_14_11 0 CM_uint32_m_into_A 0 4294967295
 /begin AXIS_DESCR COM_AXIS NO_INPUT_QUANTITY NO_COMPU_METHOD 14 0 0 AXIS_PTS_REF bins_temperature_CurrentMap /end AXIS_DESCR
 /begin AXIS_DESCR COM_AXIS NO_INPUT_QUANTITY NO_COMPU_METHOD 11 0 0 AXIS_PTS_REF bins_SOC_CurrentMap /end AXIS_DESCR
/end CHARACTERISTIC
/begin CHARACTERISTIC map_dischargingCurrent_Pulse "" MAP 0x0000 Scalar_ULONG_Map_14_11 0 CM_uint32_m_into_A 0 4294967295
 /begin AXIS_DESCR COM_AXIS NO_INPUT_QUANTITY NO_COMPU_METHOD 14 0 0 AXIS_PTS_REF bins_temperature_CurrentMap /end AXIS_DESCR
 /begin AXIS_DESCR COM_AXIS NO_INPUT_QUANTITY NO_COMPU_METHOD 11 0 0 AXIS_PTS_REF bins_SOC_CurrentMap /end AXIS_DESCR
/end CHARACTERISTIC
/begin CHARACTERISTIC map_dischargingInternalResistance "" MAP 0x0000 Scalar_ULONG_Map_21_21 0 CM_uint32___into_Ohm 0 4294967295
 /begin AXIS_DESCR COM_AXIS NO_INPUT_QUANTITY NO_COMPU_METHOD 21 0 0 AXIS_PTS_REF bins_temperature_CellMap /end AXIS_DESCR
 /begin AXIS_DESCR COM_AXIS NO_INPUT_QUANTITY NO_COMPU_METHOD 21 0 0 AXIS_PTS_REF bins_SOC_CellMap /end AXIS_DESCR
/end CHARACTERISTIC
/begin MEASUREMENT monitor.diagnosticEvent_1.identifier_diagnosticEvent "" UWORD CM_uint16 0 0 0 65535 ECU_ADDRESS 0x0000 DISPLAY_IDENTIFIER diagnosticEvent_1_identifier_diagnosticEvent /end MEASUREMENT
/begin MEASUREMENT monitor.diagnosticEvent_1.size_individualSnapshot "" ULONG CM_uint32 0 0 0 2147483646 ECU_ADDRESS 0x0000 DISPLAY_IDENTIFIER diagnosticEvent_1_size_individualSnapshot /end MEASUREMENT
/begin MEASUREMENT monitor.diagnosticEvent_1.status_diagnosticEvent "" UBYTE CM_ENUM_DIAGNOSTIC_EVENT 0 0 0 1 ECU_ADDRESS 0x0000 DISPLAY_IDENTIFIER diagnosticEvent_1_status_diagnosticEvent /end MEASUREMENT
/begin MEASUREMENT monitor.diagnosticEvent_10.identifier_diagnosticEvent "" UWORD CM_uint16 0 0 0 65535 ECU_ADDRESS 0x0000 DISPLAY_IDENTIFIER diagnosticEvent_10_identifier_diagnosticEvent /end MEASUREMENT
/begin MEASUREMENT monitor.diagnosticEvent_10.size_individualSnapshot "" ULONG CM_uint32 0 0 0 2147483646 ECU_ADDRESS 0x0000 DISPLAY_IDENTIFIER diagnosticEvent_10_size_individualSnapshot /end MEASUREMENT
/begin MEASUREMENT monitor.diagnosticEvent_10.status_diagnosticEvent "" UBYTE CM_ENUM_DIAGNOSTIC_EVENT 0 0 0 1 ECU_ADDRESS 0x0000 DISPLAY_IDENTIFIER diagnosticEvent_10_status_diagnosticEvent /end MEASUREMENT
/begin MEASUREMENT monitor.diagnosticEvent_11.identifier_diagnosticEvent "" UWORD CM_uint16 0 0 0 65535 ECU_ADDRESS 0x0000 DISPLAY_IDENTIFIER diagnosticEvent_11_identifier_diagnosticEvent /end MEASUREMENT
/begin MEASUREMENT monitor.diagnosticEvent_11.size_individualSnapshot "" ULONG CM_uint32 0 0 0 2147483646 ECU_ADDRESS 0x0000 DISPLAY_IDENTIFIER diagnosticEvent_11_size_individualSnapshot /end MEASUREMENT
/begin MEASUREMENT monitor.diagnosticEvent_11.status_diagnosticEvent "" UBYTE CM_ENUM_DIAGNOSTIC_EVENT 0 0 0 1 ECU_ADDRESS 0x0000 DISPLAY_IDENTIFIER diagnosticEvent_11_status_diagnosticEvent /end MEASUREMENT
/begin MEASUREMENT monitor.diagnosticEvent_12.identifier_diagnosticEvent "" UWORD CM_uint16 0 0 0 65535 ECU_ADDRESS 0x0000 DISPLAY_IDENTIFIER diagnosticEvent_12_identifier_diagnosticEvent /end MEASUREMENT
/begin MEASUREMENT monitor.diagnosticEvent_12.size_individualSnapshot "" ULONG CM_uint32 0 0 0 2147483646 ECU_ADDRESS 0x0000 DISPLAY_IDENTIFIER diagnosticEvent_12_size_individualSnapshot /end MEASUREMENT
/begin MEASUREMENT monitor.diagnosticEvent_12.status_diagnosticEvent "" UBYTE CM_ENUM_DIAGNOSTIC_EVENT 0 0 0 1 ECU_ADDRESS 0x0000 DISPLAY_IDENTIFIER diagnosticEvent_12_status_diagnosticEvent /end MEASUREMENT
/begin MEASUREMENT monitor.diagnosticEvent_13.identifier_diagnosticEvent "" UWORD CM_uint16 0 0 0 65535 ECU_ADDRESS 0x0000 DISPLAY_IDENTIFIER diagnosticEvent_13_identifier_diagnosticEvent /end MEASUREMENT
/begin MEASUREMENT monitor.diagnosticEvent_13.size_individualSnapshot "" ULONG CM_uint32 0 0 0 2147483646 ECU_ADDRESS 0x0000 DISPLAY_IDENTIFIER diagnosticEvent_13_size_individualSnapshot /end MEASUREMENT
/begin MEASUREMENT monitor.diagnosticEvent_13.status_diagnosticEvent "" UBYTE CM_ENUM_DIAGNOSTIC_EVENT 0 0 0 1 ECU_ADDRESS 0x0000 DISPLAY_IDENTIFIER diagnosticEvent_13_status_diagnosticEvent /end MEASUREMENT
/begin MEASUREMENT monitor.diagnosticEvent_14.identifier_diagnosticEvent "" UWORD CM_uint16 0 0 0 65535 ECU_ADDRESS 0x0000 DISPLAY_IDENTIFIER diagnosticEvent_14_identifier_diagnosticEvent /end MEASUREMENT
/begin MEASUREMENT monitor.diagnosticEvent_14.size_individualSnapshot "" ULONG CM_uint32 0 0 0 2147483646 ECU_ADDRESS 0x0000 DISPLAY_IDENTIFIER diagnosticEvent_14_size_individualSnapshot /end MEASUREMENT
/begin MEASUREMENT monitor.diagnosticEvent_14.status_diagnosticEvent "" UBYTE CM_ENUM_DIAGNOSTIC_EVENT 0 0 0 1 ECU_ADDRESS 0x0000 DISPLAY_IDENTIFIER diagnosticEvent_14_status_diagnosticEvent /end MEASUREMENT
/begin MEASUREMENT monitor.diagnosticEvent_15.identifier_diagnosticEvent "" UWORD CM_uint16 0 0 0 65535 ECU_ADDRESS 0x0000 DISPLAY_IDENTIFIER diagnosticEvent_15_identifier_diagnosticEvent /end MEASUREMENT
/begin MEASUREMENT monitor.diagnosticEvent_15.size_individualSnapshot "" ULONG CM_uint32 0 0 0 2147483646 ECU_ADDRESS 0x0000 DISPLAY_IDENTIFIER diagnosticEvent_15_size_individualSnapshot /end MEASUREMENT
/begin MEASUREMENT monitor.diagnosticEvent_15.status_diagnosticEvent "" UBYTE CM_ENUM_DIAGNOSTIC_EVENT 0 0 0 1 ECU_ADDRESS 0x0000 DISPLAY_IDENTIFIER diagnosticEvent_15_status_diagnosticEvent /end MEASUREMENT
/begin MEASUREMENT monitor.diagnosticEvent_16.identifier_diagnosticEvent "" UWORD CM_uint16 0 0 0 65535 ECU_ADDRESS 0x0000 DISPLAY_IDENTIFIER diagnosticEvent_16_identifier_diagnosticEvent /end MEASUREMENT
/begin MEASUREMENT monitor.diagnosticEvent_16.size_individualSnapshot "" ULONG CM_uint32 0 0 0 2147483646 ECU_ADDRESS 0x0000 DISPLAY_IDENTIFIER diagnosticEvent_16_size_individualSnapshot /end MEASUREMENT
/begin MEASUREMENT monitor.diagnosticEvent_16.status_diagnosticEvent "" UBYTE CM_ENUM_DIAGNOSTIC_EVENT 0 0 0 1 ECU_ADDRESS 0x0000 DISPLAY_IDENTIFIER diagnosticEvent_16_status_diagnosticEvent /end MEASUREMENT
/begin MEASUREMENT monitor.diagnosticEvent_17.identifier_diagnosticEvent "" UWORD CM_uint16 0 0 0 65535 ECU_ADDRESS 0x0000 DISPLAY_IDENTIFIER diagnosticEvent_17_identifier_diagnosticEvent /end MEASUREMENT
/begin MEASUREMENT monitor.diagnosticEvent_17.size_individualSnapshot "" ULONG CM_uint32 0 0 0 2147483646 ECU_ADDRESS 0x0000 DISPLAY_IDENTIFIER diagnosticEvent_17_size_individualSnapshot /end MEASUREMENT
/begin MEASUREMENT monitor.diagnosticEvent_17.status_diagnosticEvent "" UBYTE CM_ENUM_DIAGNOSTIC_EVENT 0 0 0 1 ECU_ADDRESS 0x0000 DISPLAY_IDENTIFIER diagnosticEvent_17_status_diagnosticEvent /end MEASUREMENT
/begin MEASUREMENT monitor.diagnosticEvent_18.identifier_diagnosticEvent "" UWORD CM_uint16 0 0 0 65535 ECU_ADDRESS 0x0000 DISPLAY_IDENTIFIER diagnosticEvent_18_identifier_diagnosticEvent /end MEASUREMENT
/begin MEASUREMENT monitor.diagnosticEvent_18.size_individualSnapshot "" ULONG CM_uint32 0 0 0 2147483646 ECU_ADDRESS 0x0000 DISPLAY_IDENTIFIER diagnosticEvent_18_size_individualSnapshot /end MEASUREMENT
/begin MEASUREMENT monitor.diagnosticEvent_18.status_diagnosticEvent "" UBYTE CM_ENUM_DIAGNOSTIC_EVENT 0 0 0 1 ECU_ADDRESS 0x0000 DISPLAY_IDENTIFIER diagnosticEvent_18_status_diagnosticEvent /end MEASUREMENT
/begin MEASUREMENT monitor.diagnosticEvent_19.identifier_diagnosticEvent "" UWORD CM_uint16 0 0 0 65535 ECU_ADDRESS 0x0000 DISPLAY_IDENTIFIER diagnosticEvent_19_identifier_diagnosticEvent /end MEASUREMENT
/begin MEASUREMENT monitor.diagnosticEvent_19.size_individualSnapshot "" ULONG CM_uint32 0 0 0 2147483646 ECU_ADDRESS 0x0000 DISPLAY_IDENTIFIER diagnosticEvent_19_size_individualSnapshot /end MEASUREMENT
/begin MEASUREMENT monitor.diagnosticEvent_19.status_diagnosticEvent "" UBYTE CM_ENUM_DIAGNOSTIC_EVENT 0 0 0 1 ECU_ADDRESS 0x0000 DISPLAY_IDENTIFIER diagnosticEvent_19_status_diagnosticEvent /end MEASUREMENT
/begin MEASUREMENT monitor.diagnosticEvent_2.identifier_diagnosticEvent "" UWORD CM_uint16 0 0 0 65535 ECU_ADDRESS 0x0000 DISPLAY_IDENTIFIER diagnosticEvent_2_identifier_diagnosticEvent /end MEASUREMENT
/begin MEASUREMENT monitor.diagnosticEvent_2.size_individualSnapshot "" ULONG CM_uint32 0 0 0 2147483646 ECU_ADDRESS 0x0000 DISPLAY_IDENTIFIER diagnosticEvent_2_size_individualSnapshot /end MEASUREMENT
/begin MEASUREMENT monitor.diagnosticEvent_2.status_diagnosticEvent "" UBYTE CM_ENUM_DIAGNOSTIC_EVENT 0 0 0 1 ECU_ADDRESS 0x0000 DISPLAY_IDENTIFIER diagnosticEvent_2_status_diagnosticEvent /end MEASUREMENT
/begin MEASUREMENT monitor.diagnosticEvent_20.identifier_diagnosticEvent "" UWORD CM_uint16 0 0 0 65535 ECU_ADDRESS 0x0000 DISPLAY_IDENTIFIER diagnosticEvent_20_identifier_diagnosticEvent /end MEASUREMENT
/begin MEASUREMENT monitor.diagnosticEvent_20.size_individualSnapshot "" ULONG CM_uint32 0 0 0 2147483646 ECU_ADDRESS 0x0000 DISPLAY_IDENTIFIER diagnosticEvent_20_size_individualSnapshot /end MEASUREMENT
/begin MEASUREMENT monitor.diagnosticEvent_20.status_diagnosticEvent "" UBYTE CM_ENUM_DIAGNOSTIC_EVENT 0 0 0 1 ECU_ADDRESS 0x0000 DISPLAY_IDENTIFIER diagnosticEvent_20_status_diagnosticEvent /end MEASUREMENT
/begin MEASUREMENT monitor.diagnosticEvent_21.identifier_diagnosticEvent "" UWORD CM_uint16 0 0 0 65535 ECU_ADDRESS 0x0000 DISPLAY_IDENTIFIER diagnosticEvent_21_identifier_diagnosticEvent /end MEASUREMENT
/begin MEASUREMENT monitor.diagnosticEvent_21.size_individualSnapshot "" ULONG CM_uint32 0 0 0 2147483646 ECU_ADDRESS 0x0000 DISPLAY_IDENTIFIER diagnosticEvent_21_size_individualSnapshot /end MEASUREMENT
/begin MEASUREMENT monitor.diagnosticEvent_21.status_diagnosticEvent "" UBYTE CM_ENUM_DIAGNOSTIC_EVENT 0 0 0 1 ECU_ADDRESS 0x0000 DISPLAY_IDENTIFIER diagnosticEvent_21_status_diagnosticEvent /end MEASUREMENT
/begin MEASUREMENT monitor.diagnosticEvent_22.identifier_diagnosticEvent "" UWORD CM_uint16 0 0 0 65535 ECU_ADDRESS 0x0000 DISPLAY_IDENTIFIER diagnosticEvent_22_identifier_diagnosticEvent /end MEASUREMENT
/begin MEASUREMENT monitor.diagnosticEvent_22.size_individualSnapshot "" ULONG CM_uint32 0 0 0 2147483646 ECU_ADDRESS 0x0000 DISPLAY_IDENTIFIER diagnosticEvent_22_size_individualSnapshot /end MEASUREMENT
/begin MEASUREMENT monitor.diagnosticEvent_22.status_diagnosticEvent "" UBYTE CM_ENUM_DIAGNOSTIC_EVENT 0 0 0 1 ECU_ADDRESS 0x0000 DISPLAY_IDENTIFIER diagnosticEvent_22_status_diagnosticEvent /end MEASUREMENT
/begin MEASUREMENT monitor.diagnosticEvent_3.identifier_diagnosticEvent "" UWORD CM_uint16 0 0 0 65535 ECU_ADDRESS 0x0000 DISPLAY_IDENTIFIER diagnosticEvent_3_identifier_diagnosticEvent /end MEASUREMENT
/begin MEASUREMENT monitor.diagnosticEvent_3.size_individualSnapshot "" ULONG CM_uint32 0 0 0 2147483646 ECU_ADDRESS 0x0000 DISPLAY_IDENTIFIER diagnosticEvent_3_size_individualSnapshot /end MEASUREMENT
/begin MEASUREMENT monitor.diagnosticEvent_3.status_diagnosticEvent "" UBYTE CM_ENUM_DIAGNOSTIC_EVENT 0 0 0 1 ECU_ADDRESS 0x0000 DISPLAY_IDENTIFIER diagnosticEvent_3_status_diagnosticEvent /end MEASUREMENT
/begin MEASUREMENT monitor.diagnosticEvent_4.identifier_diagnosticEvent "" UWORD CM_uint16 0 0 0 65535 ECU_ADDRESS 0x0000 DISPLAY_IDENTIFIER diagnosticEvent_4_identifier_diagnosticEvent /end MEASUREMENT
/begin MEASUREMENT monitor.diagnosticEvent_4.size_individualSnapshot "" ULONG CM_uint32 0 0 0 2147483646 ECU_ADDRESS 0x0000 DISPLAY_IDENTIFIER diagnosticEvent_4_size_individualSnapshot /end MEASUREMENT
/begin MEASUREMENT monitor.diagnosticEvent_4.status_diagnosticEvent "" UBYTE CM_ENUM_DIAGNOSTIC_EVENT 0 0 0 1 ECU_ADDRESS 0x0000 DISPLAY_IDENTIFIER diagnosticEvent_4_status_diagnosticEvent /end MEASUREMENT
/begin MEASUREMENT monitor.diagnosticEvent_5.identifier_diagnosticEvent "" UWORD CM_uint16 0 0 0 65535 ECU_ADDRESS 0x0000 DISPLAY_IDENTIFIER diagnosticEvent_5_identifier_diagnosticEvent /end MEASUREMENT
/begin MEASUREMENT monitor.diagnosticEvent_5.size_individualSnapshot "" ULONG CM_uint32 0 0 0 2147483646 ECU_ADDRESS 0x0000 DISPLAY_IDENTIFIER diagnosticEvent_5_size_individualSnapshot /end MEASUREMENT
/begin MEASUREMENT monitor.diagnosticEvent_5.status_diagnosticEvent "" UBYTE CM_ENUM_DIAGNOSTIC_EVENT 0 0 0 1 ECU_ADDRESS 0x0000 DISPLAY_IDENTIFIER diagnosticEvent_5_status_diagnosticEvent /end MEASUREMENT
/begin MEASUREMENT monitor.diagnosticEvent_6.identifier_diagnosticEvent "" UWORD CM_uint16 0 0 0 65535 ECU_ADDRESS 0x0000 DISPLAY_IDENTIFIER diagnosticEvent_6_identifier_diagnosticEvent /end MEASUREMENT
/begin MEASUREMENT monitor.diagnosticEvent_6.size_individualSnapshot "" ULONG CM_uint32 0 0 0 2147483646 ECU_ADDRESS 0x0000 DISPLAY_IDENTIFIER diagnosticEvent_6_size_individualSnapshot /end MEASUREMENT
/begin MEASUREMENT monitor.diagnosticEvent_6.status_diagnosticEvent "" UBYTE CM_ENUM_DIAGNOSTIC_EVENT 0 0 0 1 ECU_ADDRESS 0x0000 DISPLAY_IDENTIFIER diagnosticEvent_6_status_diagnosticEvent /end MEASUREMENT
/begin MEASUREMENT monitor.diagnosticEvent_7.identifier_diagnosticEvent "" UWORD CM_uint16 0 0 0 65535 ECU_ADDRESS 0x0000 DISPLAY_IDENTIFIER diagnosticEvent_7_identifier_diagnosticEvent /end MEASUREMENT
/begin MEASUREMENT monitor.diagnosticEvent_7.size_individualSnapshot "" ULONG CM_uint32 0 0 0 2147483646 ECU_ADDRESS 0x0000 DISPLAY_IDENTIFIER diagnosticEvent_7_size_individualSnapshot /end MEASUREMENT
/begin MEASUREMENT monitor.diagnosticEvent_7.status_diagnosticEvent "" UBYTE CM_ENUM_DIAGNOSTIC_EVENT 0 0 0 1 ECU_ADDRESS 0x0000 DISPLAY_IDENTIFIER diagnosticEvent_7_status_diagnosticEvent /end MEASUREMENT
/begin MEASUREMENT monitor.diagnosticEvent_8.identifier_diagnosticEvent "" UWORD CM_uint16 0 0 0 65535 ECU_ADDRESS 0x0000 DISPLAY_IDENTIFIER diagnosticEvent_8_identifier_diagnosticEvent /end MEASUREMENT
/begin MEASUREMENT monitor.diagnosticEvent_8.size_individualSnapshot "" ULONG CM_uint32 0 0 0 2147483646 ECU_ADDRESS 0x0000 DISPLAY_IDENTIFIER diagnosticEvent_8_size_individualSnapshot /end MEASUREMENT
/begin MEASUREMENT monitor.diagnosticEvent_8.status_diagnosticEvent "" UBYTE CM_ENUM_DIAGNOSTIC_EVENT 0 0 0 1 ECU_ADDRESS 0x0000 DISPLAY_IDENTIFIER diagnosticEvent_8_status_diagnosticEvent /end MEASUREMENT
/begin MEASUREMENT monitor.diagnosticEvent_9.identifier_diagnosticEvent "" UWORD CM_uint16 0 0 0 65535 ECU_ADDRESS 0x0000 DISPLAY_IDENTIFIER diagnosticEvent_9_identifier_diagnosticEvent /end MEASUREMENT
/begin MEASUREMENT monitor.diagnosticEvent_9.size_individualSnapshot "" ULONG CM_uint32 0 0 0 2147483646 ECU_ADDRESS 0x0000 DISPLAY_IDENTIFIER diagnosticEvent_9_size_individualSnapshot /end MEASUREMENT
/begin MEASUREMENT monitor.diagnosticEvent_9.status_diagnosticEvent "" UBYTE CM_ENUM_DIAGNOSTIC_EVENT 0 0 0 1 ECU_ADDRESS 0x0000 DISPLAY_IDENTIFIER diagnosticEvent_9_status_diagnosticEvent /end MEASUREMENT
/begin CHARACTERISTIC parameter_BCMCheck_Enable "" VALUE 0x0000 Scalar_UBYTE 0 CM_ENUM_ENABLE 0 1 /end CHARACTERISTIC
/begin CHARACTERISTIC parameter_EOCLimiter_Enable "" VALUE 0x0000 Scalar_UBYTE 0 CM_ENUM_ENABLE 0 1 /end CHARACTERISTIC
/begin CHARACTERISTIC parameter_EOCVoltageOffset_Cell "" VALUE 0x0000 Scalar_UWORD 0 CM_uint16_m_into_V 0 65535 /end CHARACTERISTIC
/begin CHARACTERISTIC parameter_EOCVoltage_Cell "" VALUE 0x0000 Scalar_UWORD 0 CM_uint16_m_into_V 0 65535 /end CHARACTERISTIC
/begin CHARACTERISTIC parameter_EODVoltageOffset_Cell "" VALUE 0x0000 Scalar_UWORD 0 CM_uint16_m_into_V 0 65535 /end CHARACTERISTIC
/begin CHARACTERISTIC parameter_EODVoltage_Cell "" VALUE 0x0000 Scalar_UWORD 0 CM_uint16_m_into_V 0 65535 /end CHARACTERISTIC
/begin CHARACTERISTIC parameter_NTC_Configuration "" VAL_BLK 0x0000 Scalar_UBYTE 0 CM_ENUM_PARAMETER_NTC_CONFIGURATION 0 8 MATRIX_DIM 8 /end CHARACTERISTIC
/begin CHARACTERISTIC parameter_OCVReferencing_Enable "" VALUE 0x0000 Scalar_UBYTE 0 CM_ENUM_ENABLE 0 1 /end CHARACTERISTIC
/begin CHARACTERISTIC parameter_PIDController_Enable "" VALUE 0x0000 Scalar_UBYTE 0 CM_ENUM_ENABLE 0 1 /end CHARACTERISTIC
/begin CHARACTERISTIC parameter_PWUPReferencing_Enable "" VALUE 0x0000 Scalar_UBYTE 0 CM_ENUM_ENABLE 0 1 /end CHARACTERISTIC
/begin CHARACTERISTIC parameter_SOCFullChargeHysteresis_Enable "" VALUE 0x0000 Scalar_UBYTE 0 CM_ENUM_ENABLE 0 1 /end CHARACTERISTIC
/begin CHARACTERISTIC parameter_SOCFullCharge_Enable "" VALUE 0x0000 Scalar_UBYTE 0 CM_ENUM_ENABLE 0 1 /end CHARACTERISTIC
/begin CHARACTERISTIC parameter_SOCFullDischargeHysteresis_Enable "" VALUE 0x0000 Scalar_UBYTE 0 CM_ENUM_ENABLE 0 1 /end CHARACTERISTIC
/begin CHARACTERISTIC parameter_SOCFullDischarge_Enable "" VALUE 0x0000 Scalar_UBYTE 0 CM_ENUM_ENABLE 0 1 /end CHARACTERISTIC
/begin CHARACTERISTIC parameter_SOCHandler_Enable "" VALUE 0x0000 Scalar_UBYTE 0 CM_ENUM_ENABLE 0 1 /end CHARACTERISTIC
/begin CHARACTERISTIC parameter_SOCHold_Enable "" VALUE 0x0000 Scalar_UBYTE 0 CM_ENUM_ENABLE 0 1 /end CHARACTERISTIC
/begin CHARACTERISTIC parameter_SOCLimits_Enable "" VALUE 0x0000 Scalar_UBYTE 0 CM_ENUM_ENABLE 0 1 /end CHARACTERISTIC
/begin CHARACTERISTIC parameter_abortThreshold_Heating "" VALUE 0x0000 Scalar_SWORD 0 CM_int16_deg_C -40 32767 /end CHARACTERISTIC
/begin CHARACTERISTIC parameter_batteryLimiter_Enable "" VALUE 0x0000 Scalar_UBYTE 0 CM_ENUM_ENABLE 0 1 /end CHARACTERISTIC
/begin CHARACTERISTIC parameter_calculateTemperature_Enable "" VALUE 0x0000 Scalar_UBYTE 0 CM_ENUM_ENABLE 0 1 /end CHARACTERISTIC
/begin CHARACTERISTIC parameter_calculateVoltage_Enable "" VALUE 0x0000 Scalar_UBYTE 0 CM_ENUM_ENABLE 0 1 /end CHARACTERISTIC
/begin CHARACTERISTIC parameter_cellDataLookup_Enable "" VALUE 0x0000 Scalar_UBYTE 0 CM_ENUM_ENABLE 0 1 /end CHARACTERISTIC
/begin CHARACTERISTIC parameter_cellLookupLimiter_Enable "" VALUE 0x0000 Scalar_UBYTE 0 CM_ENUM_ENABLE 0 1 /end CHARACTERISTIC
/begin CHARACTERISTIC parameter_cellModelLimiter_Enable "" VALUE 0x0000 Scalar_UBYTE 0 CM_ENUM_ENABLE 0 1 /end CHARACTERISTIC
/begin CHARACTERISTIC parameter_chargeLimiter_Enable "" VALUE 0x0000 Scalar_UBYTE 0 CM_ENUM_ENABLE 0 1 /end CHARACTERISTIC
/begin CHARACTERISTIC parameter_chargeVoltageHysteresis_Cell "" VALUE 0x0000 Scalar_UWORD 0 CM_uint16_m_into_V 0 65535 /end CHARACTERISTIC
/begin CHARACTERISTIC parameter_chargeVoltagePulse_Cell "" VALUE 0x0000 Scalar_UWORD 0 CM_uint16_m_into_V 0 65535 /end CHARACTERISTIC
/begin CHARACTERISTIC parameter_chargingCurrentContinuousFilter_Enable "" VALUE 0x0000 Scalar_UBYTE 0 CM_ENUM_ENABLE 0 1 /end CHARACTERISTIC
/begin CHARACTERISTIC parameter_chargingCurrentCutOff "" VALUE 0x0000 Scalar_SLONG 0 CM_int32_m_into_A 0 2147483647 /end CHARACTERISTIC
/begin CHARACTERISTIC parameter_chargingCurrentCutOff_Reset "" VALUE 0x0000 Scalar_SLONG 0 CM_int32_m_into_A 0 2147483647 /end CHARACTERISTIC
/begin CHARACTERISTIC parameter_chargingCurrentPulseFilter_Enable "" VALUE 0x0000 Scalar_UBYTE 0 CM_ENUM_ENABLE 0 1 /end CHARACTERISTIC
/begin CHARACTERISTIC parameter_coefficient_PIDController "" VALUE 0x0000 Scalar_UBYTE 0 CM_uint8 0 255 /end CHARACTERISTIC
/begin CHARACTERISTIC parameter_coulombCounting_Enable "" VALUE 0x0000 Scalar_UBYTE 0 CM_ENUM_ENABLE 0 1 /end CHARACTERISTIC
/begin CHARACTERISTIC parameter_currentLimit_LinearToConstant "" VALUE 0x0000 Scalar_ULONG 0 CM_uint32_m_into_A 0 4294967295 /end CHARACTERISTIC
/begin CHARACTERISTIC parameter_currentLimit_RelativeToLinear "" VALUE 0x0000 Scalar_ULONG 0 CM_uint32_m_into_A 0 4294967295 /end CHARACTERISTIC
/begin CHARACTERISTIC parameter_defaultHeatingCurrent_Module "" VALUE 0x0000 Scalar_SLONG 0 CM_int32_m_into_A -50000 2147483647 /end CHARACTERISTIC
/begin CHARACTERISTIC parameter_deratingCutOff_Enable "" VALUE 0x0000 Scalar_UBYTE 0 CM_ENUM_ENABLE 0 1 /end CHARACTERISTIC
/begin CHARACTERISTIC parameter_deratingSOC_EOC "" VALUE 0x0000 Scalar_UWORD 0 CM_uint16_percent_ 0 65535 /end CHARACTERISTIC
/begin CHARACTERISTIC parameter_deratingSOC_EOD "" VALUE 0x0000 Scalar_UWORD 0 CM_uint16_percent_ 0 65535 /end CHARACTERISTIC
/begin CHARACTERISTIC parameter_derivative_PIDController "" VALUE 0x0000 Scalar_SWORD 0 CM_int16 -1000 32767 /end CHARACTERISTIC
/begin CHARACTERISTIC parameter_designCapacity_BOL_Cell "" VALUE 0x0000 Scalar_ULONG 0 CM_uint32_m_into_A_into_h 0 4294967295 /end CHARACTERISTIC
/begin CHARACTERISTIC parameter_designCapacity_Enable "" VALUE 0x0000 Scalar_UBYTE 0 CM_ENUM_ENABLE 0 1 /end CHARACTERISTIC
/begin CHARACTERISTIC parameter_dischargeLimiter_Enable "" VALUE 0x0000 Scalar_UBYTE 0 CM_ENUM_ENABLE 0 1 /end CHARACTERISTIC
/begin CHARACTERISTIC parameter_dischargeVoltageHysteresis_Cell "" VALUE 0x0000 Scalar_UWORD 0 CM_uint16_m_into_V 0 65535 /end CHARACTERISTIC
/begin CHARACTERISTIC parameter_dischargeVoltagePulse_Cell "" VALUE 0x0000 Scalar_UWORD 0 CM_uint16_m_into_V 0 65535 /end CHARACTERISTIC
/begin CHARACTERISTIC parameter_dischargingCurrentContinuousFilter_Enable "" VALUE 0x0000 Scalar_UBYTE 0 CM_ENUM_ENABLE 0 1 /end CHARACTERISTIC
/begin CHARACTERISTIC parameter_dischargingCurrentCutOff "" VALUE 0x0000 Scalar_SLONG 0 CM_int32_m_into_A 0 2147483647 /end CHARACTERISTIC
/begin CHARACTERISTIC parameter_dischargingCurrentPulseFilter_Enable "" VALUE 0x0000 Scalar_UBYTE 0 CM_ENUM_ENABLE 0 1 /end CHARACTERISTIC
/begin CHARACTERISTIC parameter_driveLimiter_Enable "" VALUE 0x0000 Scalar_UBYTE 0 CM_ENUM_ENABLE 0 1 /end CHARACTERISTIC
/begin CHARACTERISTIC parameter_driveVoltageHysteresis_Cell "" VALUE 0x0000 Scalar_UWORD 0 CM_uint16_m_into_V 0 65535 /end CHARACTERISTIC
/begin CHARACTERISTIC parameter_driveVoltage_Cell "" VALUE 0x0000 Scalar_UWORD 0 CM_uint16_m_into_V 0 65535 /end CHARACTERISTIC
/begin CHARACTERISTIC parameter_factory_EOC "" VALUE 0x0000 Scalar_UWORD 0 CM_uint16_percent_ 0 65535 /end CHARACTERISTIC
/begin CHARACTERISTIC parameter_factory_EOD "" VALUE 0x0000 Scalar_UWORD 0 CM_uint16_percent_ 0 65535 /end CHARACTERISTIC
/begin CHARACTERISTIC parameter_fullChargeCapacity_Enable "" VALUE 0x0000 Scalar_UBYTE 0 CM_ENUM_ENABLE 0 1 /end CHARACTERISTIC
/begin CHARACTERISTIC parameter_fullChargeCurrentHysteresisLimit "" VALUE 0x0000 Scalar_SLONG 0 CM_int32_m_into_A -100000 2147483647 /end CHARACTERISTIC
/begin CHARACTERISTIC parameter_fullChargeEnergy_Enable "" VALUE 0x0000 Scalar_UBYTE 0 CM_ENUM_ENABLE 0 1 /end CHARACTERISTIC
/begin CHARACTERISTIC parameter_fullChargeSOCHysteresisLimit "" VALUE 0x0000 Scalar_UWORD 0 CM_uint16_percent_ 0 65535 /end CHARACTERISTIC
/begin CHARACTERISTIC parameter_fullChargeSOC_Preheat "" VALUE 0x0000 Scalar_UWORD 0 CM_uint16_percent_ 0 65535 /end CHARACTERISTIC
/begin CHARACTERISTIC parameter_fullChargeVoltageHysteresisLimit "" VALUE 0x0000 Scalar_UWORD 0 CM_uint16_m_into_V 0 65535 /end CHARACTERISTIC
/begin CHARACTERISTIC parameter_fullDischargeSOCHysteresisLimit "" VALUE 0x0000 Scalar_UWORD 0 CM_uint16_percent_ 0 65535 /end CHARACTERISTIC
/begin CHARACTERISTIC parameter_fullDischargeVoltageHysteresisLimit "" VALUE 0x0000 Scalar_UWORD 0 CM_uint16_m_into_V 0 65535 /end CHARACTERISTIC
/begin CHARACTERISTIC parameter_gain_Filter "" VALUE 0x0000 Scalar_UBYTE 0 CM_uint8 0 255 /end CHARACTERISTIC
/begin CHARACTERISTIC parameter_gain_PIDController "" VALUE 0x0000 Scalar_UWORD 0 CM_uint16 0 65535 /end CHARACTERISTIC
/begin CHARACTERISTIC parameter_heatingCalculation_Enable "" VALUE 0x0000 Scalar_UBYTE 0 CM_ENUM_ENABLE 0 1 /end CHARACTERISTIC
/begin CHARACTERISTIC parameter_heatingFoil_Configuration "" VALUE 0x0000 Scalar_ULONG 0 CM_uint32 0 4294967295 /end CHARACTERISTIC
/begin CHARACTERISTIC parameter_integral_PIDController "" VALUE 0x0000 Scalar_UWORD 0 CM_uint16 0 65535 /end CHARACTERISTIC
/begin CHARACTERISTIC parameter_lowerThresholdHeatingEnergy "" VALUE 0x0000 Scalar_ULONG 0 CM_uint32_W_into_s 0 4294967295 /end CHARACTERISTIC
/begin CHARACTERISTIC parameter_maxCellVoltageFactor_Min "" VALUE 0x0000 Scalar_UWORD 0 CM_uint16_percent_ 0 65535 /end CHARACTERISTIC
/begin CHARACTERISTIC parameter_maxChangeSOC "" VALUE 0x0000 Scalar_ULONG 0 CM_uint32_percent_ 0 4294967295 /end CHARACTERISTIC
/begin CHARACTERISTIC parameter_maxChargingCurrent_Continuous "" VALUE 0x0000 Scalar_ULONG 0 CM_uint32_m_into_A 0 4294967295 /end CHARACTERISTIC
/begin CHARACTERISTIC parameter_maxChargingCurrent_Pulse "" VALUE 0x0000 Scalar_ULONG 0 CM_uint32_m_into_A 0 4294967295 /end CHARACTERISTIC
/begin CHARACTERISTIC parameter_maxCurrent_BrakingResistance "" VALUE 0x0000 Scalar_ULONG 0 CM_uint32_m_into_A 0 4294967295 /end CHARACTERISTIC
/begin CHARACTERISTIC parameter_maxDischargingCurrent_Continuous "" VALUE 0x0000 Scalar_ULONG 0 CM_uint32_m_into_A 0 4294967295 /end CHARACTERISTIC
/begin CHARACTERISTIC parameter_maxDischargingCurrent_Pulse "" VALUE 0x0000 Scalar_ULONG 0 CM_uint32_m_into_A 0 4294967295 /end CHARACTERISTIC
/begin CHARACTERISTIC parameter_maxDriveFactor_Min "" VALUE 0x0000 Scalar_UWORD 0 CM_uint16_percent_ 0 65535 /end CHARACTERISTIC
/begin CHARACTERISTIC parameter_maxLinearChangeRate_Current "" VALUE 0x0000 Scalar_ULONG 0 CM_uint32_m_into_A_per_s 0 4294967295 /end CHARACTERISTIC
/begin CHARACTERISTIC parameter_maxRegenerationFactor_Min "" VALUE 0x0000 Scalar_UWORD 0 CM_uint16_percent_ 0 65535 /end CHARACTERISTIC
/begin CHARACTERISTIC parameter_maxRelativeChangeRate_ChargingCurrent "" VALUE 0x0000 Scalar_ULONG 0 CM_uint32_percent__per_s 0 4294967295 /end CHARACTERISTIC
/begin CHARACTERISTIC parameter_maxRelativeChangeRate_Current "" VALUE 0x0000 Scalar_ULONG 0 CM_uint32_percent__per_s 0 4294967295 /end CHARACTERISTIC
/begin CHARACTERISTIC parameter_maxTemperatureHysteresis_Heating "" VALUE 0x0000 Scalar_SWORD 0 CM_int16_deg_C -40 32767 /end CHARACTERISTIC
/begin CHARACTERISTIC parameter_maxTemperature_Heating "" VALUE 0x0000 Scalar_SWORD 0 CM_int16_deg_C -40 32767 /end CHARACTERISTIC
/begin CHARACTERISTIC parameter_maxVoltageHysteresis_Cell "" VALUE 0x0000 Scalar_UWORD 0 CM_uint16_m_into_V 0 65535 /end CHARACTERISTIC
/begin CHARACTERISTIC parameter_mechanicalCoordinates "" VAL_BLK 0x0000 Scalar_UWORD 0 CM_uint16 0 65535 MATRIX_DIM 8 /end CHARACTERISTIC
/begin CHARACTERISTIC parameter_minCellVoltageFactor_Min "" VALUE 0x0000 Scalar_UWORD 0 CM_uint16_percent_ 0 65535 /end CHARACTERISTIC
/begin CHARACTERISTIC parameter_minSOCHold_High "" VALUE 0x0000 Scalar_ULONG 0 CM_uint32_percent_ 0 4294967295 /end CHARACTERISTIC
/begin CHARACTERISTIC parameter_minSOCHold_Low "" VALUE 0x0000 Scalar_ULONG 0 CM_uint32_percent_ 0 4294967295 /end CHARACTERISTIC
/begin CHARACTERISTIC parameter_minSOC_Drive "" VALUE 0x0000 Scalar_UWORD 0 CM_uint16_percent_ 0 65535 /end CHARACTERISTIC
/begin CHARACTERISTIC parameter_minTemperature_Drive "" VALUE 0x0000 Scalar_SWORD 0 CM_int16_deg_C -40 32767 /end CHARACTERISTIC
/begin CHARACTERISTIC parameter_minVoltageHysteresis_Cell "" VALUE 0x0000 Scalar_UWORD 0 CM_uint16_m_into_V 0 65535 /end CHARACTERISTIC
/begin CHARACTERISTIC parameter_moduleArrangement "" VAL_BLK 0x0000 Scalar_UWORD 0 CM_uint16 0 65535 MATRIX_DIM 8 /end CHARACTERISTIC
/begin CHARACTERISTIC parameter_moduleElectricalConnection "" VAL_BLK 0x0000 Scalar_UWORD 0 CM_uint16 0 65535 MATRIX_DIM 8 /end CHARACTERISTIC
/begin CHARACTERISTIC parameter_noCellsParallel "" VALUE 0x0000 Scalar_UBYTE 0 CM_uint8 1 255 /end CHARACTERISTIC
/begin CHARACTERISTIC parameter_noCellsSerial "" VALUE 0x0000 Scalar_UBYTE 0 CM_uint8 1 255 /end CHARACTERISTIC
/begin CHARACTERISTIC parameter_noModulesParallel "" VALUE 0x0000 Scalar_UBYTE 0 CM_uint8 1 255 /end CHARACTERISTIC
/begin CHARACTERISTIC parameter_noModulesSerial "" VALUE 0x0000 Scalar_UBYTE 0 CM_uint8 1 255 /end CHARACTERISTIC
/begin CHARACTERISTIC parameter_nominalVoltage_Cell "" VALUE 0x0000 Scalar_UWORD 0 CM_uint16_m_into_V 0 65535 /end CHARACTERISTIC
/begin CHARACTERISTIC parameter_nominal_EOC "" VALUE 0x0000 Scalar_UWORD 0 CM_uint16_percent_ 0 65535 /end CHARACTERISTIC
/begin CHARACTERISTIC parameter_nominal_EOD "" VALUE 0x0000 Scalar_UWORD 0 CM_uint16_percent_ 0 65535 /end CHARACTERISTIC
/begin CHARACTERISTIC parameter_regenerationLimiter_Enable "" VALUE 0x0000 Scalar_UBYTE 0 CM_ENUM_ENABLE 0 1 /end CHARACTERISTIC
/begin CHARACTERISTIC parameter_regenerativeVoltageHysteresis_Cell "" VALUE 0x0000 Scalar_UWORD 0 CM_uint16_m_into_V 0 65535 /end CHARACTERISTIC
/begin CHARACTERISTIC parameter_regenerativeVoltage_Cell "" VALUE 0x0000 Scalar_UWORD 0 CM_uint16_m_into_V 0 65535 /end CHARACTERISTIC
/begin CHARACTERISTIC parameter_relaxationCurrent "" VALUE 0x0000 Scalar_SLONG 0 CM_int32_m_into_A -50000 2147483647 /end CHARACTERISTIC
/begin CHARACTERISTIC parameter_relaxationTime "" VALUE 0x0000 Scalar_UWORD 0 CM_uint16_s 0 65535 /end CHARACTERISTIC
/begin CHARACTERISTIC parameter_remainingCapacity_Enable "" VALUE 0x0000 Scalar_UBYTE 0 CM_ENUM_ENABLE 0 1 /end CHARACTERISTIC
/begin CHARACTERISTIC parameter_samplingTime_Filter "" VALUE 0x0000 Scalar_UBYTE 0 CM_uint8 0 255 /end CHARACTERISTIC
/begin CHARACTERISTIC parameter_selfDischargeResistance_Cell "" VALUE 0x0000 Scalar_ULONG 0 CM_uint32___into_Ohm 0 4294967295 /end CHARACTERISTIC
/begin CHARACTERISTIC parameter_sleepCompensationCurrent "" VALUE 0x0000 Scalar_SLONG 0 CM_int32_m_into_A -1000 2147483647 /end CHARACTERISTIC
/begin CHARACTERISTIC parameter_sleepCompensation_Enable "" VALUE 0x0000 Scalar_UBYTE 0 CM_ENUM_ENABLE 0 1 /end CHARACTERISTIC
/begin CHARACTERISTIC parameter_targetTemperatureHysteresis_Heating "" VALUE 0x0000 Scalar_SWORD 0 CM_int16_deg_C -40 32767 /end CHARACTERISTIC
/begin CHARACTERISTIC parameter_targetTemperature_Heating "" VALUE 0x0000 Scalar_SWORD 0 CM_int16_deg_C -40 32767 /end CHARACTERISTIC
/begin CHARACTERISTIC parameter_temperatureFilter_Enable "" VALUE 0x0000 Scalar_UBYTE 0 CM_ENUM_ENABLE 0 1 /end CHARACTERISTIC
/begin CHARACTERISTIC parameter_timeConstant_Filter "" VALUE 0x0000 Scalar_ULONG 0 CM_uint32_s 0 4294967295 /end CHARACTERISTIC
/begin CHARACTERISTIC parameter_upperThresholdHeatingEnergy "" VALUE 0x0000 Scalar_ULONG 0 CM_uint32_W_into_s 0 4294967295 /end CHARACTERISTIC
/begin CHARACTERISTIC table_capacity "" CURVE 0x0000 Scalar_ULONG_Table_27 0 CM_uint32_m_into_A_into_h 0 4294967295
 /begin AXIS_DESCR COM_AXIS NO_INPUT_QUANTITY NO_COMPU_METHOD 27 0 0 AXIS_PTS_REF bins_temperature_ModuleTable /end AXIS_DESCR
/end CHARACTERISTIC
/begin CHARACTERISTIC table_heatingFoilResistance "" CURVE 0x0000 Scalar_ULONG_Table_27 0 CM_uint32_m_into_Ohm 0 4294967295
 /begin AXIS_DESCR COM_AXIS NO_INPUT_QUANTITY NO_COMPU_METHOD 27 0 0 AXIS_PTS_REF bins_temperature_ModuleTable /end AXIS_DESCR
/end CHARACTERISTIC
/begin CHARACTERISTIC table_powerCapability "" CURVE 0x0000 Scalar_UWORD_Table_21 0 CM_uint16_percent_ 0 65535
 /begin AXIS_DESCR COM_AXIS NO_INPUT_QUANTITY NO_COMPU_METHOD 21 0 0 AXIS_PTS_REF bins_PWM /end AXIS_DESCR
/end CHARACTERISTIC
/begin COMPU_METHOD CM_ENUM_CONNECTION "" TAB_VERB "" "" COMPU_TAB_REF VTAB_FOR_CM_ENUM_CONNECTION /end COMPU_METHOD
/begin COMPU_VTAB VTAB_FOR_CM_ENUM_CONNECTION "" TAB_VERB 2 0 "ENUM_CONNECTION_NOT_CONNECTED" 1 "ENUM_CONNECTION_CONNECTED" /end COMPU_VTAB
/begin COMPU_METHOD CM_ENUM_CURRENTLIMITED "" TAB_VERB "" "" COMPU_TAB_REF VTAB_FOR_CM_ENUM_CURRENTLIMITED /end COMPU_METHOD
/begin COMPU_VTAB VTAB_FOR_CM_ENUM_CURRENTLIMITED "" TAB_VERB 4 0 "ENUM_CURRENTLIMITED_OFF" 1 "ENUM_CURRENTLIMITED_ON" 2 "ENUM_CURRENTLIMITED_SIGNAL_ERROR" 3 "ENUM_CURRENTLIMITED_SIGNAL_NOT_AVAILABLE" /end COMPU_VTAB
/begin COMPU_METHOD CM_ENUM_DIAGNOSTIC_EVENT "" TAB_VERB "" "" COMPU_TAB_REF VTAB_FOR_CM_ENUM_DIAGNOSTIC_EVENT /end COMPU_METHOD
/begin COMPU_VTAB VTAB_FOR_CM_ENUM_DIAGNOSTIC_EVENT "" TAB_VERB 2 0 "ENUM_DIAGNOSTIC_EVENT_PASSED" 1 "ENUM_DIAGNOSTIC_EVENT_FAILED" /end COMPU_VTAB
/begin COMPU_METHOD CM_ENUM_ENABLE "" TAB_VERB "" "" COMPU_TAB_REF VTAB_FOR_CM_ENUM_ENABLE /end COMPU_METHOD
/begin COMPU_VTAB VTAB_FOR_CM_ENUM_ENABLE "" TAB_VERB 2 0 "ENUM_ENABLE_DISABLE" 1 "ENUM_ENABLE_ENABLE" /end COMPU_VTAB
/begin COMPU_METHOD CM_ENUM_GET_SET "" TAB_VERB "" "" COMPU_TAB_REF VTAB_FOR_CM_ENUM_GET_SET /end COMPU_METHOD
/begin COMPU_VTAB VTAB_FOR_CM_ENUM_GET_SET "" TAB_VERB 2 0 "ENUM_GET_SET_OFF" 1 "ENUM_GET_SET_ON" /end COMPU_VTAB
/begin COMPU_METHOD CM_ENUM_OPERATINGMODE_FAN "" TAB_VERB "" "" COMPU_TAB_REF VTAB_FOR_CM_ENUM_OPERATINGMODE_FAN /end COMPU_METHOD
/begin COMPU_VTAB VTAB_FOR_CM_ENUM_OPERATINGMODE_FAN "" TAB_VERB 3 0 "ENUM_OPERATINGMODE_FAN_OFF" 1 "ENUM_OPERATINGMODE_FAN_CONTINUOUS" 2 "ENUM_OPERATINGMODE_FAN_CONTROLLED" /end COMPU_VTAB
/begin COMPU_METHOD CM_ENUM_PARAMETER_NTC_CONFIGURATION "" TAB_VERB "" "" COMPU_TAB_REF VTAB_FOR_CM_ENUM_PARAMETER_NTC_CONFIGURATION /end COMPU_METHOD
/begin COMPU_VTAB VTAB_FOR_CM_ENUM_PARAMETER_NTC_CONFIGURATION "" TAB_VERB 4 0 "ENUM_PARAMETER_NTC_CONFIGURATION_NOT_CONNECTED" 3 "ENUM_PARAMETER_NTC_CONFIGURATION_CONNECTED_NTC_CELL" 5 "ENUM_PARAMETER_NTC_CONFIGURATION_CONNECTED_NTC_AUX1" 8 "ENUM_PARAMETER_NTC_CONFIGURATION_CONNECTED_NTC_AUX2" /end COMPU_VTAB
/begin COMPU_METHOD CM_ENUM_RELEASE_STATUS "" TAB_VERB "" "" COMPU_TAB_REF VTAB_FOR_CM_ENUM_RELEASE_STATUS /end COMPU_METHOD
/begin COMPU_VTAB VTAB_FOR_CM_ENUM_RELEASE_STATUS "" TAB_VERB 4 0 "ENUM_RELEASE_STATUS_DEVELOPMENT" 1 "ENUM_RELEASE_STATUS_RELEASE" 2 "ENUM_RELEASE_STATUS_RELEASE_CANDIDATE" 3 "ENUM_RELEASE_STATUS_TESTING" /end COMPU_VTAB
/begin COMPU_METHOD CM_ENUM_STATE_BALANCING "" TAB_VERB "" "" COMPU_TAB_REF VTAB_FOR_CM_ENUM_STATE_BALANCING /end COMPU_METHOD
/begin COMPU_VTAB VTAB_FOR_CM_ENUM_STATE_BALANCING "" TAB_VERB 2 0 "ENUM_STATE_BALANCING_INACTIVE" 1 "ENUM_STATE_BALANCING_ACTIVE" /end COMPU_VTAB
/begin COMPU_METHOD CM_ENUM_STATE_BMS "" TAB_VERB "" "" COMPU_TAB_REF VTAB_FOR_CM_ENUM_STATE_BMS /end COMPU_METHOD
/begin COMPU_VTAB VTAB_FOR_CM_ENUM_STATE_BMS "" TAB_VERB 14 0 "ENUM_STATE_BMS_INVALID" 1 "ENUM_STATE_BMS_IDLE" 2 "ENUM_STATE_BMS_SELF_TEST" 3 "ENUM_STATE_BMS_BCM_TEST" 4 "ENUM_STATE_BMS_READY" 5 "ENUM_STATE_BMS_PERIODIC_WAKEUP" 6 "ENUM_STATE_BMS_BALANCING" 10 "ENUM_STATE_BMS_DIAGNOSIS" 14 "ENUM_STATE_BMS_STANDALONE_DIAGNOSTIC_SERVICE_OPERATION" 16 "ENUM_STATE_BMS_DRIVE" 24 "ENUM_STATE_BMS_FATAL_ERROR_IRREVERSIBLE" 32 "ENUM_STATE_BMS_CHARGE" 72 "ENUM_STATE_BMS_EMERGENCY" 136 "ENUM_STATE_BMS_ERROR_REVERSIBLE" /end COMPU_VTAB
/begin COMPU_METHOD CM_ENUM_STATE_CAPACITYMEASUREMENT "" TAB_VERB "" "" COMPU_TAB_REF VTAB_FOR_CM_ENUM_STATE_CAPACITYMEASUREMENT /end COMPU_METHOD
/begin COMPU_VTAB VTAB_FOR_CM_ENUM_STATE_CAPACITYMEASUREMENT "" TAB_VERB 3 0 "ENUM_STATE_CAPACITYMEASUREMENT_MEASUREMENT_NOT_STARTED_YET" 1 "ENUM_STATE_CAPACITYMEASUREMENT_MEASUREMENT_STARTED" 2 "ENUM_STATE_CAPACITYMEASUREMENT_MEASUREMENT_CANNOT_BE_STARTED" /end COMPU_VTAB
/begin COMPU_METHOD CM_ENUM_STATE_ENERGYBALANCE_MODULE "" TAB_VERB "" "" COMPU_TAB_REF VTAB_FOR_CM_ENUM_STATE_ENERGYBALANCE_MODULE /end COMPU_METHOD
/begin COMPU_VTAB VTAB_FOR_CM_ENUM_STATE_ENERGYBALANCE_MODULE "" TAB_VERB 5 0 "ENUM_STATE_ENERGYBALANCE_MODULE_DEFAULT" 1 "ENUM_STATE_ENERGYBALANCE_MODULE_BALANCED" 2 "ENUM_STATE_ENERGYBALANCE_MODULE_BALANCED_HYSTERESIS" 3 "ENUM_STATE_ENERGYBALANCE_MODULE_IMBALANCED" 4 "ENUM_STATE_ENERGYBALANCE_MODULE_IMBALANCED_HYSTERESIS" /end COMPU_VTAB
/begin COMPU_METHOD CM_ENUM_STATE_HANDLER_SOC "" TAB_VERB "" "" COMPU_TAB_REF VTAB_FOR_CM_ENUM_STATE_HANDLER_SOC /end COMPU_METHOD
/begin COMPU_VTAB VTAB_FOR_CM_ENUM_STATE_HANDLER_SOC "" TAB_VERB 3 0 "ENUM_STATE_HANDLER_SOC_DEFAULT" 1 "ENUM_STATE_HANDLER_SOC_FULLCHARGE" 2 "ENUM_STATE_HANDLER_SOC_FULLDISCHARGE" /end COMPU_VTAB
/begin COMPU_METHOD CM_ENUM_STATE_HEATING "" TAB_VERB "" "" COMPU_TAB_REF VTAB_FOR_CM_ENUM_STATE_HEATING /end COMPU_METHOD
/begin COMPU_VTAB VTAB_FOR_CM_ENUM_STATE_HEATING "" TAB_VERB 2 0 "ENUM_STATE_HEATING_INACTIVE" 1 "ENUM_STATE_HEATING_ACTIVE" /end COMPU_VTAB
/begin COMPU_METHOD CM_ENUM_STATE_KERNEL_HEATING "" TAB_VERB "" "" COMPU_TAB_REF VTAB_FOR_CM_ENUM_STATE_KERNEL_HEATING /end COMPU_METHOD
/begin COMPU_VTAB VTAB_FOR_CM_ENUM_STATE_KERNEL_HEATING "" TAB_VERB 8 0 "ENUM_STATE_KERNEL_HEATING_DEFAULT" 1 "ENUM_STATE_KERNEL_HEATING_ERROR" 2 "ENUM_STATE_KERNEL_HEATING_OFF" 3 "ENUM_STATE_KERNEL_HEATING_PERIODIC_WAKEUP_ON" 4 "ENUM_STATE_KERNEL_HEATING_TRUCK_ON" 5 "ENUM_STATE_KERNEL_HEATING_PREHEAT" 6 "ENUM_STATE_KERNEL_HEATING_FULLCHARGE" 7 "ENUM_STATE_KERNEL_HEATING_CHARGER_ON" /end COMPU_VTAB
/begin COMPU_METHOD CM_ENUM_STATE_KERNEL_SOC "" TAB_VERB "" "" COMPU_TAB_REF VTAB_FOR_CM_ENUM_STATE_KERNEL_SOC /end COMPU_METHOD
/begin COMPU_VTAB VTAB_FOR_CM_ENUM_STATE_KERNEL_SOC "" TAB_VERB 7 0 "ENUM_STATE_KERNEL_SOC_DEFAULT" 1 "ENUM_STATE_KERNEL_SOC_FULLCHARGE" 2 "ENUM_STATE_KERNEL_SOC_FULLDISCHARGE" 3 "ENUM_STATE_KERNEL_SOC_SOCHOLD" 4 "ENUM_STATE_KERNEL_SOC_PWUP_REFERENCING" 5 "ENUM_STATE_KERNEL_SOC_OCV_REFERENCING" 6 "ENUM_STATE_KERNEL_SOC_COULOMBCOUNTING" /end COMPU_VTAB
/begin COMPU_METHOD CM_ENUM_STATE_TEMPERATURE_MODULE "" TAB_VERB "" "" COMPU_TAB_REF VTAB_FOR_CM_ENUM_STATE_TEMPERATURE_MODULE /end COMPU_METHOD
/begin COMPU_VTAB VTAB_FOR_CM_ENUM_STATE_TEMPERATURE_MODULE "" TAB_VERB 4 0 "ENUM_STATE_TEMPERATURE_MODULE_DEFAULT" 1 "ENUM_STATE_TEMPERATURE_MODULE_HOT" 2 "ENUM_STATE_TEMPERATURE_MODULE_HYSTERESIS" 3 "ENUM_STATE_TEMPERATURE_MODULE_COLD" /end COMPU_VTAB
/begin COMPU_METHOD CM_ENUM_STATUS "" TAB_VERB "" "" COMPU_TAB_REF VTAB_FOR_CM_ENUM_STATUS /end COMPU_METHOD
/begin COMPU_VTAB VTAB_FOR_CM_ENUM_STATUS "" TAB_VERB 3 0 "ENUM_STATUS_INVALID" 1 "ENUM_STATUS_ERROR" 2 "ENUM_STATUS_SUCCESS" /end COMPU_VTAB
/begin COMPU_METHOD CM_ENUM_TRUE_FALSE "" TAB_VERB "" "" COMPU_TAB_REF VTAB_FOR_CM_ENUM_TRUE_FALSE /end COMPU_METHOD
/begin COMPU_VTAB VTAB_FOR_CM_ENUM_TRUE_FALSE "" TAB_VERB 2 0 "ENUM_TRUE_FALSE_FALSE" 1 "ENUM_TRUE_FALSE_TRUE" /end COMPU_VTAB
/begin COMPU_METHOD CM_int16 "" IDENTICAL "%5.0" "" /end COMPU_METHOD
/begin COMPU_METHOD CM_int16_deg_C "" IDENTICAL "%5.0" "°C" /end COMPU_METHOD
/begin COMPU_METHOD CM_int16_percent_ "" IDENTICAL "%5.0" "%" /end COMPU_METHOD
/begin COMPU_METHOD CM_int32_m_into_A "" IDENTICAL "%10.0" "m*A" /end COMPU_METHOD
/begin COMPU_METHOD CM_int32_m_into_A_into_s "" IDENTICAL "%10.0" "m*A*s" /end COMPU_METHOD
/begin COMPU_METHOD CM_int32_percent_ "" IDENTICAL "%10.0" "%" /end COMPU_METHOD
/begin COMPU_METHOD CM_uint16 "" IDENTICAL "%5.0" "" /end COMPU_METHOD
/begin COMPU_METHOD CM_uint16_1_per_min "" IDENTICAL "%5.0" "1/min" /end COMPU_METHOD
/begin COMPU_METHOD CM_uint16_m_into_A "" IDENTICAL "%5.0" "m*A" /end COMPU_METHOD
/begin COMPU_METHOD CM_uint16_m_into_V "" IDENTICAL "%5.0" "m*V" /end COMPU_METHOD
/begin COMPU_METHOD CM_uint16_percent_ "" IDENTICAL "%5.0" "%" /end COMPU_METHOD
/begin COMPU_METHOD CM_uint16_s "" IDENTICAL "%5.0" "s" /end COMPU_METHOD
/begin COMPU_METHOD CM_uint32 "" IDENTICAL "%10.0" "" /end COMPU_METHOD
/begin COMPU_METHOD CM_uint32_A "" IDENTICAL "%10.0" "A" /end COMPU_METHOD
/begin COMPU_METHOD CM_uint32_V "" IDENTICAL "%10.0" "V" /end COMPU_METHOD
/begin COMPU_METHOD CM_uint32_W "" IDENTICAL "%10.0" "W" /end COMPU_METHOD
/begin COMPU_METHOD CM_uint32_W_into_h "" IDENTICAL "%10.0" "W*h" /end COMPU_METHOD
/begin COMPU_METHOD CM_uint32_W_into_s "" IDENTICAL "%10.0" "W*s" /end COMPU_METHOD
/begin COMPU_METHOD CM_uint32___into_Ohm "" IDENTICAL "%10.0" "µ*Ohm" /end COMPU_METHOD
/begin COMPU_METHOD CM_uint32_m_into_A "" IDENTICAL "%10.0" "m*A" /end COMPU_METHOD
/begin COMPU_METHOD CM_uint32_m_into_A_into_h "" IDENTICAL "%10.0" "m*A*h" /end COMPU_METHOD
/begin COMPU_METHOD CM_uint32_m_into_A_per_s "" IDENTICAL "%10.0" "m*A/s" /end COMPU_METHOD
/begin COMPU_METHOD CM_uint32_m_into_Ohm "" IDENTICAL "%10.0" "m*Ohm" /end COMPU_METHOD
/begin COMPU_METHOD CM_uint32_m_into_V "" IDENTICAL "%10.0" "m*V" /end COMPU_METHOD
/begin COMPU_METHOD CM_uint32_m_into_s "" IDENTICAL "%10.0" "m*s" /end COMPU_METHOD
/begin COMPU_METHOD CM_uint32_percent_ "" IDENTICAL "%10.0" "%" /end COMPU_METHOD
/begin COMPU_METHOD CM_uint32_percent__per_s "" IDENTICAL "%10.0" "%/s" /end COMPU_METHOD
/begin COMPU_METHOD CM_uint32_s "" IDENTICAL "%10.0" "s" /end COMPU_METHOD
/begin COMPU_METHOD CM_uint8 "" IDENTICAL "%3.0" "" /end COMPU_METHOD
/begin COMPU_METHOD CM_uint8_percent_ "" IDENTICAL "%3.0" "%" /end COMPU_METHOD
/begin RECORD_LAYOUT Scalar_SLONG FNC_VALUES 1 SLONG COLUMN_DIR DIRECT /end RECORD_LAYOUT
/begin RECORD_LAYOUT Scalar_SWORD FNC_VALUES 1 SWORD COLUMN_DIR DIRECT /end RECORD_LAYOUT
/begin RECORD_LAYOUT Scalar_UBYTE FNC_VALUES 1 UBYTE COLUMN_DIR DIRECT /end RECORD_LAYOUT
/begin RECORD_LAYOUT Scalar_ULONG FNC_VALUES 1 ULONG COLUMN_DIR DIRECT /end RECORD_LAYOUT
/begin RECORD_LAYOUT Scalar_UWORD FNC_VALUES 1 UWORD COLUMN_DIR DIRECT /end RECORD_LAYOUT
/begin RECORD_LAYOUT Scalar_UWORD_Bin_21 AXIS_PTS_X 1 UWORD INDEX_INCR DIRECT /end RECORD_LAYOUT
/begin RECORD_LAYOUT Scalar_SWORD_Bin_21 AXIS_PTS_X 1 SWORD INDEX_INCR DIRECT /end RECORD_LAYOUT
/begin RECORD_LAYOUT Scalar_SWORD_Bin_11 AXIS_PTS_X 1 SWORD INDEX_INCR DIRECT /end RECORD_LAYOUT
/begin RECORD_LAYOUT Scalar_SWORD_Bin_14 AXIS_PTS_X 1 SWORD INDEX_INCR DIRECT /end RECORD_LAYOUT
/begin RECORD_LAYOUT Scalar_SWORD_Bin_27 AXIS_PTS_X 1 SWORD INDEX_INCR DIRECT /end RECORD_LAYOUT
/begin RECORD_LAYOUT Scalar_UWORD_Map_21_21 FNC_VALUES 1 UWORD COLUMN_DIR DIRECT FIX_NO_AXIS_PTS_X 21 FIX_NO_AXIS_PTS_Y 21 /end RECORD_LAYOUT
/begin RECORD_LAYOUT Scalar_ULONG_Map_14_11 FNC_VALUES 1 ULONG COLUMN_DIR DIRECT FIX_NO_AXIS_PTS_X 14 FIX_NO_AXIS_PTS_Y 11 /end RECORD_LAYOUT
/begin RECORD_LAYOUT Scalar_ULONG_Map_21_21 FNC_VALUES 1 ULONG COLUMN_DIR DIRECT FIX_NO_AXIS_PTS_X 21 FIX_NO_AXIS_PTS_Y 21 /end RECORD_LAYOUT
/begin RECORD_LAYOUT Scalar_ULONG_Table_27 FNC_VALUES 1 ULONG COLUMN_DIR DIRECT FIX_NO_AXIS_PTS_X 27 /end RECORD_LAYOUT
/begin RECORD_LAYOUT Scalar_UWORD_Table_21 FNC_VALUES 1 UWORD COLUMN_DIR DIRECT FIX_NO_AXIS_PTS_X 21 /end RECORD_LAYOUT
/begin GROUP BMSAlgorithmInterface "BMSAlgorithmInterface" /* Root */ ROOT
 /begin SUB_GROUP batteryParameter serviceParameter data_Maps_Bins infoBlock KBSInput KBSOutput NVM_BMS NVM_CSC diagnosticEvent KBS_Feature /end SUB_GROUP
/end GROUP
/begin GROUP batteryParameter "batteryParameter"
 /begin REF_CHARACTERISTIC parameter_EOCVoltage_Cell parameter_EODVoltage_Cell parameter_NTC_Configuration parameter_chargingCurrentCutOff parameter_chargingCurrentCutOff_Reset parameter_designCapacity_BOL_Cell parameter_dischargingCurrentCutOff parameter_driveVoltage_Cell parameter_factory_EOC parameter_factory_EOD parameter_heatingFoil_Configuration parameter_maxChargingCurrent_Continuous parameter_maxChargingCurrent_Pulse parameter_maxDischargingCurrent_Continuous parameter_maxDischargingCurrent_Pulse parameter_mechanicalCoordinates parameter_moduleArrangement parameter_moduleElectricalConnection parameter_noCellsParallel parameter_noCellsSerial parameter_noModulesParallel parameter_noModulesSerial parameter_nominalVoltage_Cell parameter_nominal_EOC parameter_nominal_EOD parameter_regenerativeVoltage_Cell parameter_selfDischargeResistance_Cell /end REF_CHARACTERISTIC
/end GROUP
/begin GROUP serviceParameter "serviceParameter"
 /begin REF_MEASUREMENT buffer_NVM_BMS.parameter_service_EOC buffer_NVM_BMS.parameter_service_EOD buffer_NVM_BMS.parameter_service_PWUPHeating_Enable buffer_NVM_BMS.parameter_service_diagnosticDerating /end REF_MEASUREMENT
/end GROUP
/begin GROUP data_Maps_Bins "data_Maps_Bins"
 /begin REF_CHARACTERISTIC bins_PWM bins_SOC_CellMap bins_SOC_CurrentMap bins_temperature_CellMap bins_temperature_CurrentMap bins_temperature_ModuleTable map_OCV map_chargingCurrent_Continuous map_chargingCurrent_Pulse map_chargingInternalResistance map_dischargingCurrent_Continuous map_dischargingCurrent_Pulse map_dischargingInternalResistance table_capacity table_heatingFoilResistance table_powerCapability /end REF_CHARACTERISTIC
/end GROUP
/begin GROUP infoBlock "infoBlock"
 /begin REF_MEASUREMENT Interface_main_100msrtB.blockIdentifier_capacityEstimation Interface_main_100msrtB.blockIdentifier_currentDerating Interface_main_100msrtB.blockIdentifier_dataProcessing Interface_main_100msrtB.blockIdentifier_heatingStrategy Interface_main_100msrtB.blockIdentifier_stateOfCharge Interface_main_100msrtB.counter_capacityEstimation Interface_main_100msrtB.counter_currentDerating Interface_main_100msrtB.counter_dataProcessing Interface_main_100msrtB.counter_heatingStrategy Interface_main_100msrtB.counter_stateOfCharge Interface_main_100msrtB.interfaceVersion_capacityEstimation Interface_main_100msrtB.interfaceVersion_currentDerating Interface_main_100msrtB.interfaceVersion_dataProcessing Interface_main_100msrtB.interfaceVersion_heatingStrategy Interface_main_100msrtB.interfaceVersion_stateOfCharge Interface_main_100msrtB.status_Init_capacityEstimation Interface_main_100msrtB.status_Init_currentDerating Interface_main_100msrtB.status_Init_dataProcessing Interface_main_100msrtB.status_Init_heatingStrategy Interface_main_100msrtB.status_Init_stateOfCharge Interface_main_100msrtB.status_capacityEstimation Interface_main_100msrtB.status_currentDerating Interface_main_100msrtB.status_dataProcessing Interface_main_100msrtB.status_heatingStrategy Interface_main_100msrtB.status_stateOfCharge /end REF_MEASUREMENT
/end GROUP
/begin GROUP KBSInput "KBSInput"
 /begin REF_MEASUREMENT kbsInput.AhCounter_CurrentSensor kbsInput.avgPowerConsumption_Vehicle kbsInput.chargingCurrent kbsInput.chargingPower kbsInput.chargingVoltage kbsInput.current_Battery kbsInput.current_CPS kbsInput.dateTime kbsInput.durationLastCall_1000ms kbsInput.durationLastCall_100ms kbsInput.durationLastCall_10ms kbsInput.factorPowerReduction kbsInput.get_PWM_BCM kbsInput.get_balancing_Battery kbsInput.get_balancing_Cell kbsInput.get_enable_BCM kbsInput.get_heating_Module kbsInput.get_speed_Fan kbsInput.heatingCurrent_Module kbsInput.operatingMode_Fan kbsInput.selfDischargeTime kbsInput.state_BMS kbsInput.state_Charger kbsInput.state_Truck kbsInput.temperature_MasterPCB kbsInput.temperature_Sensor kbsInput.voltageAfterContactors kbsInput.voltageBeforeContactors kbsInput.voltageBetweenContactors kbsInput.voltage_Cell kbsInput.workTime_Component kbsInput.workTime_Truck /end REF_MEASUREMENT
/end GROUP
/begin GROUP KBSOutput "KBSOutput"
 /begin REF_MEASUREMENT kbsOutput.SOCwithSOH kbsOutput.SOCwithoutSOH kbsOutput.SOH_Capacity kbsOutput.SOH_Performance kbsOutput.currentLimited kbsOutput.maxChargeCurrent_Continuous kbsOutput.maxChargeCurrent_Pulse kbsOutput.maxChargePower_Continuous kbsOutput.maxChargePower_Pulse kbsOutput.maxDischargeCurrent_Continuous kbsOutput.maxDischargeCurrent_Pulse kbsOutput.maxDischargePower_Continuous kbsOutput.maxDischargePower_Pulse kbsOutput.remainingCapacity_Actual kbsOutput.set_balancing_Cell kbsOutput.set_enable_BCM kbsOutput.set_heating_Module kbsOutput.set_speed_Fan kbsOutput.state_balancing_Battery /end REF_MEASUREMENT
/end GROUP
/begin GROUP NVM_BMS "NVM_BMS" /begin SUB_GROUP init_buffer_NVM_BMS buffer_NVM_BMS /end SUB_GROUP /end GROUP
/begin GROUP init_buffer_NVM_BMS "init_buffer_NVM_BMS"
 /begin REF_MEASUREMENT Interface_initialize_NVM_BMSrtB.buffer_NVM_BMS_l.SOC_Handler_Battery Interface_initialize_NVM_BMSrtB.buffer_NVM_BMS_l.SOC_Kernel_Battery Interface_initialize_NVM_BMSrtB.buffer_NVM_BMS_l.SOC_Kernel_Cell Interface_initialize_NVM_BMSrtB.buffer_NVM_BMS_l.SOH_Handler_Battery Interface_initialize_NVM_BMSrtB.buffer_NVM_BMS_l.calendricAge_Battery Interface_initialize_NVM_BMSrtB.buffer_NVM_BMS_l.calendricAging_SOH_Battery Interface_initialize_NVM_BMSrtB.buffer_NVM_BMS_l.cellNumber Interface_initialize_NVM_BMSrtB.buffer_NVM_BMS_l.cyclicAging_SOH_Battery Interface_initialize_NVM_BMSrtB.buffer_NVM_BMS_l.deltaChangeResidual_SOC Interface_initialize_NVM_BMSrtB.buffer_NVM_BMS_l.deratingFactor_MaxCellVoltage Interface_initialize_NVM_BMSrtB.buffer_NVM_BMS_l.deratingFactor_MaxDrive Interface_initialize_NVM_BMSrtB.buffer_NVM_BMS_l.deratingFactor_MaxRegeneration Interface_initialize_NVM_BMSrtB.buffer_NVM_BMS_l.deratingFactor_MinCellVoltage Interface_initialize_NVM_BMSrtB.buffer_NVM_BMS_l.energy_Battery Interface_initialize_NVM_BMSrtB.buffer_NVM_BMS_l.energy_NegativeDischarge_Battery Interface_initialize_NVM_BMSrtB.buffer_NVM_BMS_l.energy_PositiveCharge_Battery Interface_initialize_NVM_BMSrtB.buffer_NVM_BMS_l.energy_PositiveDischarge_Battery Interface_initialize_NVM_BMSrtB.buffer_NVM_BMS_l.heatingEnergy_Module Interface_initialize_NVM_BMSrtB.buffer_NVM_BMS_l.idleTime_Battery Interface_initialize_NVM_BMSrtB.buffer_NVM_BMS_l.maxChargeCurrent_Continuous Interface_initialize_NVM_BMSrtB.buffer_NVM_BMS_l.maxChargeCurrent_Pulse Interface_initialize_NVM_BMSrtB.buffer_NVM_BMS_l.maxDischargeCurrent_Continuous Interface_initialize_NVM_BMSrtB.buffer_NVM_BMS_l.maxDischargeCurrent_Pulse Interface_initialize_NVM_BMSrtB.buffer_NVM_BMS_l.minHeatingEnergy_String Interface_initialize_NVM_BMSrtB.buffer_NVM_BMS_l.noFullCycles_Battery Interface_initialize_NVM_BMSrtB.buffer_NVM_BMS_l.operationTime_Battery Interface_initialize_NVM_BMSrtB.buffer_NVM_BMS_l.parameter_service_EOC Interface_initialize_NVM_BMSrtB.buffer_NVM_BMS_l.parameter_service_EOD Interface_initialize_NVM_BMSrtB.buffer_NVM_BMS_l.parameter_service_PWUPHeating_Enable Interface_initialize_NVM_BMSrtB.buffer_NVM_BMS_l.parameter_service_diagnosticDerating Interface_initialize_NVM_BMSrtB.buffer_NVM_BMS_l.state_energyBalance_Module Interface_initialize_NVM_BMSrtB.buffer_NVM_BMS_l.state_temperature_Module /end REF_MEASUREMENT
/end GROUP
/begin GROUP buffer_NVM_BMS "buffer_NVM_BMS"
 /begin REF_MEASUREMENT buffer_NVM_BMS.SOC_Handler_Battery buffer_NVM_BMS.SOC_Kernel_Battery buffer_NVM_BMS.SOC_Kernel_Cell buffer_NVM_BMS.SOH_Handler_Battery buffer_NVM_BMS.calendricAge_Battery buffer_NVM_BMS.calendricAging_SOH_Battery buffer_NVM_BMS.cellNumber buffer_NVM_BMS.cyclicAging_SOH_Battery buffer_NVM_BMS.deltaChangeResidual_SOC buffer_NVM_BMS.deratingFactor_MaxCellVoltage buffer_NVM_BMS.deratingFactor_MaxDrive buffer_NVM_BMS.deratingFactor_MaxRegeneration buffer_NVM_BMS.deratingFactor_MinCellVoltage buffer_NVM_BMS.energy_Battery buffer_NVM_BMS.energy_NegativeDischarge_Battery buffer_NVM_BMS.energy_PositiveCharge_Battery buffer_NVM_BMS.energy_PositiveDischarge_Battery buffer_NVM_BMS.heatingEnergy_Module buffer_NVM_BMS.idleTime_Battery buffer_NVM_BMS.maxChargeCurrent_Continuous buffer_NVM_BMS.maxChargeCurrent_Pulse buffer_NVM_BMS.maxDischargeCurrent_Continuous buffer_NVM_BMS.maxDischargeCurrent_Pulse buffer_NVM_BMS.minHeatingEnergy_String buffer_NVM_BMS.noFullCycles_Battery buffer_NVM_BMS.operationTime_Battery buffer_NVM_BMS.parameter_service_EOC buffer_NVM_BMS.parameter_service_EOD buffer_NVM_BMS.parameter_service_PWUPHeating_Enable buffer_NVM_BMS.parameter_service_diagnosticDerating buffer_NVM_BMS.state_energyBalance_Module buffer_NVM_BMS.state_temperature_Module /end REF_MEASUREMENT
/end GROUP
/begin GROUP NVM_CSC "NVM_CSC" /begin SUB_GROUP buffer_NVM_CSC data_NVM_CSC /end SUB_GROUP /end GROUP
/begin GROUP buffer_NVM_CSC "buffer_NVM_CSC"
 /begin REF_MEASUREMENT buffer_NVM_CSC.SOH_Kernel_Module buffer_NVM_CSC.calendricAge_Module buffer_NVM_CSC.calendricAging_SOH_Module buffer_NVM_CSC.cyclicAging_SOH_Module buffer_NVM_CSC.energy_Module buffer_NVM_CSC.energy_NegativeDischarge_Module buffer_NVM_CSC.energy_PositiveCharge_Module buffer_NVM_CSC.energy_PositiveDischarge_Module buffer_NVM_CSC.idleTime_Module buffer_NVM_CSC.operationTime_Module /end REF_MEASUREMENT
/end GROUP
/begin GROUP data_NVM_CSC "data_NVM_CSC"
 /begin REF_MEASUREMENT Interface_initialize_NVM_CSCrtB.data_NVM_CSC_init.CSC1.SOH_Kernel_Module Interface_initialize_NVM_CSCrtB.data_NVM_CSC_init.CSC1.calendricAge_Module Interface_initialize_NVM_CSCrtB.data_NVM_CSC_init.CSC1.calendricAging_SOH_Module Interface_initialize_NVM_CSCrtB.data_NVM_CSC_init.CSC1.cyclicAging_SOH_Module Interface_initialize_NVM_CSCrtB.data_NVM_CSC_init.CSC1.energy_Module Interface_initialize_NVM_CSCrtB.data_NVM_CSC_init.CSC1.energy_NegativeDischarge_Module Interface_initialize_NVM_CSCrtB.data_NVM_CSC_init.CSC1.energy_PositiveCharge_Module Interface_initialize_NVM_CSCrtB.data_NVM_CSC_init.CSC1.energy_PositiveDischarge_Module Interface_initialize_NVM_CSCrtB.data_NVM_CSC_init.CSC1.idleTime_Module Interface_initialize_NVM_CSCrtB.data_NVM_CSC_init.CSC1.operationTime_Module Interface_initialize_NVM_CSCrtB.data_NVM_CSC_init.CSC2.SOH_Kernel_Module Interface_initialize_NVM_CSCrtB.data_NVM_CSC_init.CSC2.calendricAge_Module Interface_initialize_NVM_CSCrtB.data_NVM_CSC_init.CSC2.calendricAging_SOH_Module Interface_initialize_NVM_CSCrtB.data_NVM_CSC_init.CSC2.cyclicAging_SOH_Module Interface_initialize_NVM_CSCrtB.data_NVM_CSC_init.CSC2.energy_Module Interface_initialize_NVM_CSCrtB.data_NVM_CSC_init.CSC2.energy_NegativeDischarge_Module Interface_initialize_NVM_CSCrtB.data_NVM_CSC_init.CSC2.energy_PositiveCharge_Module Interface_initialize_NVM_CSCrtB.data_NVM_CSC_init.CSC2.energy_PositiveDischarge_Module Interface_initialize_NVM_CSCrtB.data_NVM_CSC_init.CSC2.idleTime_Module Interface_initialize_NVM_CSCrtB.data_NVM_CSC_init.CSC2.operationTime_Module Interface_initialize_NVM_CSCrtB.data_NVM_CSC_init.CSC3.SOH_Kernel_Module Interface_initialize_NVM_CSCrtB.data_NVM_CSC_init.CSC3.calendricAge_Module Interface_initialize_NVM_CSCrtB.data_NVM_CSC_init.CSC3.calendricAging_SOH_Module Interface_initialize_NVM_CSCrtB.data_NVM_CSC_init.CSC3.cyclicAging_SOH_Module Interface_initialize_NVM_CSCrtB.data_NVM_CSC_init.CSC3.energy_Module Interface_initialize_NVM_CSCrtB.data_NVM_CSC_init.CSC3.energy_NegativeDischarge_Module Interface_initialize_NVM_CSCrtB.data_NVM_CSC_init.CSC3.energy_PositiveCharge_Module Interface_initialize_NVM_CSCrtB.data_NVM_CSC_init.CSC3.energy_PositiveDischarge_Module Interface_initialize_NVM_CSCrtB.data_NVM_CSC_init.CSC3.idleTime_Module Interface_initialize_NVM_CSCrtB.data_NVM_CSC_init.CSC3.operationTime_Module Interface_initialize_NVM_CSCrtB.data_NVM_CSC_init.CSC4.SOH_Kernel_Module Interface_initialize_NVM_CSCrtB.data_NVM_CSC_init.CSC4.calendricAge_Module Interface_initialize_NVM_CSCrtB.data_NVM_CSC_init.CSC4.calendricAging_SOH_Module Interface_initialize_NVM_CSCrtB.data_NVM_CSC_init.CSC4.cyclicAging_SOH_Module Interface_initialize_NVM_CSCrtB.data_NVM_CSC_init.CSC4.energy_Module Interface_initialize_NVM_CSCrtB.data_NVM_CSC_init.CSC4.energy_NegativeDischarge_Module Interface_initialize_NVM_CSCrtB.data_NVM_CSC_init.CSC4.energy_PositiveCharge_Module Interface_initialize_NVM_CSCrtB.data_NVM_CSC_init.CSC4.energy_PositiveDischarge_Module Interface_initialize_NVM_CSCrtB.data_NVM_CSC_init.CSC4.idleTime_Module Interface_initialize_NVM_CSCrtB.data_NVM_CSC_init.CSC4.operationTime_Module Interface_initialize_NVM_CSCrtB.data_NVM_CSC_init.CSC5.SOH_Kernel_Module Interface_initialize_NVM_CSCrtB.data_NVM_CSC_init.CSC5.calendricAge_Module Interface_initialize_NVM_CSCrtB.data_NVM_CSC_init.CSC5.calendricAging_SOH_Module Interface_initialize_NVM_CSCrtB.data_NVM_CSC_init.CSC5.cyclicAging_SOH_Module Interface_initialize_NVM_CSCrtB.data_NVM_CSC_init.CSC5.energy_Module Interface_initialize_NVM_CSCrtB.data_NVM_CSC_init.CSC5.energy_NegativeDischarge_Module Interface_initialize_NVM_CSCrtB.data_NVM_CSC_init.CSC5.energy_PositiveCharge_Module Interface_initialize_NVM_CSCrtB.data_NVM_CSC_init.CSC5.energy_PositiveDischarge_Module Interface_initialize_NVM_CSCrtB.data_NVM_CSC_init.CSC5.idleTime_Module Interface_initialize_NVM_CSCrtB.data_NVM_CSC_init.CSC5.operationTime_Module Interface_initialize_NVM_CSCrtB.data_NVM_CSC_init.CSC6.SOH_Kernel_Module Interface_initialize_NVM_CSCrtB.data_NVM_CSC_init.CSC6.calendricAge_Module Interface_initialize_NVM_CSCrtB.data_NVM_CSC_init.CSC6.calendricAging_SOH_Module Interface_initialize_NVM_CSCrtB.data_NVM_CSC_init.CSC6.cyclicAging_SOH_Module Interface_initialize_NVM_CSCrtB.data_NVM_CSC_init.CSC6.energy_Module Interface_initialize_NVM_CSCrtB.data_NVM_CSC_init.CSC6.energy_NegativeDischarge_Module Interface_initialize_NVM_CSCrtB.data_NVM_CSC_init.CSC6.energy_PositiveCharge_Module Interface_initialize_NVM_CSCrtB.data_NVM_CSC_init.CSC6.energy_PositiveDischarge_Module Interface_initialize_NVM_CSCrtB.data_NVM_CSC_init.CSC6.idleTime_Module Interface_initialize_NVM_CSCrtB.data_NVM_CSC_init.CSC6.operationTime_Module Interface_initialize_NVM_CSCrtB.data_NVM_CSC_init.CSC7.SOH_Kernel_Module Interface_initialize_NVM_CSCrtB.data_NVM_CSC_init.CSC7.calendricAge_Module Interface_initialize_NVM_CSCrtB.data_NVM_CSC_init.CSC7.calendricAging_SOH_Module Interface_initialize_NVM_CSCrtB.data_NVM_CSC_init.CSC7.cyclicAging_SOH_Module Interface_initialize_NVM_CSCrtB.data_NVM_CSC_init.CSC7.energy_Module Interface_initialize_NVM_CSCrtB.data_NVM_CSC_init.CSC7.energy_NegativeDischarge_Module Interface_initialize_NVM_CSCrtB.data_NVM_CSC_init.CSC7.energy_PositiveCharge_Module Interface_initialize_NVM_CSCrtB.data_NVM_CSC_init.CSC7.energy_PositiveDischarge_Module Interface_initialize_NVM_CSCrtB.data_NVM_CSC_init.CSC7.idleTime_Module Interface_initialize_NVM_CSCrtB.data_NVM_CSC_init.CSC7.operationTime_Module Interface_initialize_NVM_CSCrtB.data_NVM_CSC_init.CSC8.SOH_Kernel_Module Interface_initialize_NVM_CSCrtB.data_NVM_CSC_init.CSC8.calendricAge_Module Interface_initialize_NVM_CSCrtB.data_NVM_CSC_init.CSC8.calendricAging_SOH_Module Interface_initialize_NVM_CSCrtB.data_NVM_CSC_init.CSC8.cyclicAging_SOH_Module Interface_initialize_NVM_CSCrtB.data_NVM_CSC_init.CSC8.energy_Module Interface_initialize_NVM_CSCrtB.data_NVM_CSC_init.CSC8.energy_NegativeDischarge_Module Interface_initialize_NVM_CSCrtB.data_NVM_CSC_init.CSC8.energy_PositiveCharge_Module Interface_initialize_NVM_CSCrtB.data_NVM_CSC_init.CSC8.energy_PositiveDischarge_Module Interface_initialize_NVM_CSCrtB.data_NVM_CSC_init.CSC8.idleTime_Module Interface_initialize_NVM_CSCrtB.data_NVM_CSC_init.CSC8.operationTime_Module /end REF_MEASUREMENT
/end GROUP
/begin GROUP diagnosticEvent "diagnosticEvent"
 /begin REF_MEASUREMENT Interface_main_100ms_rtZeventMonitor.diagnosticEvent_10.data_individualSnapshot Interface_main_100ms_rtZeventMonitor.diagnosticEvent_10.identifier_diagnosticEvent Interface_main_100ms_rtZeventMonitor.diagnosticEvent_10.size_individualSnapshot Interface_main_100ms_rtZeventMonitor.diagnosticEvent_10.status_diagnosticEvent Interface_main_100ms_rtZeventMonitor.diagnosticEvent_11.data_individualSnapshot Interface_main_100ms_rtZeventMonitor.diagnosticEvent_11.identifier_diagnosticEvent Interface_main_100ms_rtZeventMonitor.diagnosticEvent_11.size_individualSnapshot Interface_main_100ms_rtZeventMonitor.diagnosticEvent_11.status_diagnosticEvent Interface_main_100ms_rtZeventMonitor.diagnosticEvent_12.data_individualSnapshot Interface_main_100ms_rtZeventMonitor.diagnosticEvent_12.identifier_diagnosticEvent Interface_main_100ms_rtZeventMonitor.diagnosticEvent_12.size_individualSnapshot Interface_main_100ms_rtZeventMonitor.diagnosticEvent_12.status_diagnosticEvent Interface_main_100ms_rtZeventMonitor.diagnosticEvent_13.data_individualSnapshot Interface_main_100ms_rtZeventMonitor.diagnosticEvent_13.identifier_diagnosticEvent Interface_main_100ms_rtZeventMonitor.diagnosticEvent_13.size_individualSnapshot Interface_main_100ms_rtZeventMonitor.diagnosticEvent_13.status_diagnosticEvent Interface_main_100ms_rtZeventMonitor.diagnosticEvent_14.data_individualSnapshot Interface_main_100ms_rtZeventMonitor.diagnosticEvent_14.identifier_diagnosticEvent Interface_main_100ms_rtZeventMonitor.diagnosticEvent_14.size_individualSnapshot Interface_main_100ms_rtZeventMonitor.diagnosticEvent_14.status_diagnosticEvent Interface_main_100ms_rtZeventMonitor.diagnosticEvent_15.data_individualSnapshot Interface_main_100ms_rtZeventMonitor.diagnosticEvent_15.identifier_diagnosticEvent Interface_main_100ms_rtZeventMonitor.diagnosticEvent_15.size_individualSnapshot Interface_main_100ms_rtZeventMonitor.diagnosticEvent_15.status_diagnosticEvent Interface_main_100ms_rtZeventMonitor.diagnosticEvent_16.data_individualSnapshot Interface_main_100ms_rtZeventMonitor.diagnosticEvent_16.identifier_diagnosticEvent Interface_main_100ms_rtZeventMonitor.diagnosticEvent_16.size_individualSnapshot Interface_main_100ms_rtZeventMonitor.diagnosticEvent_16.status_diagnosticEvent Interface_main_100ms_rtZeventMonitor.diagnosticEvent_17.data_individualSnapshot Interface_main_100ms_rtZeventMonitor.diagnosticEvent_17.identifier_diagnosticEvent Interface_main_100ms_rtZeventMonitor.diagnosticEvent_17.size_individualSnapshot Interface_main_100ms_rtZeventMonitor.diagnosticEvent_17.status_diagnosticEvent Interface_main_100ms_rtZeventMonitor.diagnosticEvent_18.data_individualSnapshot Interface_main_100ms_rtZeventMonitor.diagnosticEvent_18.identifier_diagnosticEvent Interface_main_100ms_rtZeventMonitor.diagnosticEvent_18.size_individualSnapshot Interface_main_100ms_rtZeventMonitor.diagnosticEvent_18.status_diagnosticEvent Interface_main_100ms_rtZeventMonitor.diagnosticEvent_19.data_individualSnapshot Interface_main_100ms_rtZeventMonitor.diagnosticEvent_19.identifier_diagnosticEvent Interface_main_100ms_rtZeventMonitor.diagnosticEvent_19.size_individualSnapshot Interface_main_100ms_rtZeventMonitor.diagnosticEvent_19.status_diagnosticEvent Interface_main_100ms_rtZeventMonitor.diagnosticEvent_1.data_individualSnapshot Interface_main_100ms_rtZeventMonitor.diagnosticEvent_1.identifier_diagnosticEvent Interface_main_100ms_rtZeventMonitor.diagnosticEvent_1.size_individualSnapshot Interface_main_100ms_rtZeventMonitor.diagnosticEvent_1.status_diagnosticEvent Interface_main_100ms_rtZeventMonitor.diagnosticEvent_20.data_individualSnapshot Interface_main_100ms_rtZeventMonitor.diagnosticEvent_20.identifier_diagnosticEvent Interface_main_100ms_rtZeventMonitor.diagnosticEvent_20.size_individualSnapshot Interface_main_100ms_rtZeventMonitor.diagnosticEvent_20.status_diagnosticEvent Interface_main_100ms_rtZeventMonitor.diagnosticEvent_21.data_individualSnapshot Interface_main_100ms_rtZeventMonitor.diagnosticEvent_21.identifier_diagnosticEvent Interface_main_100ms_rtZeventMonitor.diagnosticEvent_21.size_individualSnapshot Interface_main_100ms_rtZeventMonitor.diagnosticEvent_21.status_diagnosticEvent Interface_main_100ms_rtZeventMonitor.diagnosticEvent_22.data_individualSnapshot Interface_main_100ms_rtZeventMonitor.diagnosticEvent_22.identifier_diagnosticEvent Interface_main_100ms_rtZeventMonitor.diagnosticEvent_22.size_individualSnapshot Interface_main_100ms_rtZeventMonitor.diagnosticEvent_22.status_diagnosticEvent Interface_main_100ms_rtZeventMonitor.diagnosticEvent_2.data_individualSnapshot Interface_main_100ms_rtZeventMonitor.diagnosticEvent_2.identifier_diagnosticEvent Interface_main_100ms_rtZeventMonitor.diagnosticEvent_2.size_individualSnapshot Interface_main_100ms_rtZeventMonitor.diagnosticEvent_2.status_diagnosticEvent Interface_main_100ms_rtZeventMonitor.diagnosticEvent_3.data_individualSnapshot Interface_main_100ms_rtZeventMonitor.diagnosticEvent_3.identifier_diagnosticEvent Interface_main_100ms_rtZeventMonitor.diagnosticEvent_3.size_individualSnapshot Interface_main_100ms_rtZeventMonitor.diagnosticEvent_3.status_diagnosticEvent Interface_main_100ms_rtZeventMonitor.diagnosticEvent_4.data_individualSnapshot Interface_main_100ms_rtZeventMonitor.diagnosticEvent_4.identifier_diagnosticEvent Interface_main_100ms_rtZeventMonitor.diagnosticEvent_4.size_individualSnapshot Interface_main_100ms_rtZeventMonitor.diagnosticEvent_4.status_diagnosticEvent Interface_main_100ms_rtZeventMonitor.diagnosticEvent_5.data_individualSnapshot Interface_main_100ms_rtZeventMonitor.diagnosticEvent_5.identifier_diagnosticEvent Interface_main_100ms_rtZeventMonitor.diagnosticEvent_5.size_individualSnapshot Interface_main_100ms_rtZeventMonitor.diagnosticEvent_5.status_diagnosticEvent Interface_main_100ms_rtZeventMonitor.diagnosticEvent_6.data_individualSnapshot Interface_main_100ms_rtZeventMonitor.diagnosticEvent_6.identifier_diagnosticEvent Interface_main_100ms_rtZeventMonitor.diagnosticEvent_6.size_individualSnapshot Interface_main_100ms_rtZeventMonitor.diagnosticEvent_6.status_diagnosticEvent Interface_main_100ms_rtZeventMonitor.diagnosticEvent_7.data_individualSnapshot Interface_main_100ms_rtZeventMonitor.diagnosticEvent_7.identifier_diagnosticEvent Interface_main_100ms_rtZeventMonitor.diagnosticEvent_7.size_individualSnapshot Interface_main_100ms_rtZeventMonitor.diagnosticEvent_7.status_diagnosticEvent Interface_main_100ms_rtZeventMonitor.diagnosticEvent_8.data_individualSnapshot Interface_main_100ms_rtZeventMonitor.diagnosticEvent_8.identifier_diagnosticEvent Interface_main_100ms_rtZeventMonitor.diagnosticEvent_8.size_individualSnapshot Interface_main_100ms_rtZeventMonitor.diagnosticEvent_8.status_diagnosticEvent Interface_main_100ms_rtZeventMonitor.diagnosticEvent_9.data_individualSnapshot Interface_main_100ms_rtZeventMonitor.diagnosticEvent_9.identifier_diagnosticEvent Interface_main_100ms_rtZeventMonitor.diagnosticEvent_9.size_individualSnapshot Interface_main_100ms_rtZeventMonitor.diagnosticEvent_9.status_diagnosticEvent monitor.diagnosticEvent_1.identifier_diagnosticEvent monitor.diagnosticEvent_1.size_individualSnapshot monitor.diagnosticEvent_1.status_diagnosticEvent monitor.diagnosticEvent_10.identifier_diagnosticEvent monitor.diagnosticEvent_10.size_individualSnapshot monitor.diagnosticEvent_10.status_diagnosticEvent monitor.diagnosticEvent_11.identifier_diagnosticEvent monitor.diagnosticEvent_11.size_individualSnapshot monitor.diagnosticEvent_11.status_diagnosticEvent monitor.diagnosticEvent_12.identifier_diagnosticEvent monitor.diagnosticEvent_12.size_individualSnapshot monitor.diagnosticEvent_12.status_diagnosticEvent monitor.diagnosticEvent_13.identifier_diagnosticEvent monitor.diagnosticEvent_13.size_individualSnapshot monitor.diagnosticEvent_13.status_diagnosticEvent monitor.diagnosticEvent_14.identifier_diagnosticEvent monitor.diagnosticEvent_14.size_individualSnapshot monitor.diagnosticEvent_14.status_diagnosticEvent monitor.diagnosticEvent_15.identifier_diagnosticEvent monitor.diagnosticEvent_15.size_individualSnapshot monitor.diagnosticEvent_15.status_diagnosticEvent monitor.diagnosticEvent_16.identifier_diagnosticEvent monitor.diagnosticEvent_16.size_individualSnapshot monitor.diagnosticEvent_16.status_diagnosticEvent monitor.diagnosticEvent_17.identifier_diagnosticEvent monitor.diagnosticEvent_17.size_individualSnapshot monitor.diagnosticEvent_17.status_diagnosticEvent monitor.diagnosticEvent_18.identifier_diagnosticEvent monitor.diagnosticEvent_18.size_individualSnapshot monitor.diagnosticEvent_18.status_diagnosticEvent monitor.diagnosticEvent_19.identifier_diagnosticEvent monitor.diagnosticEvent_19.size_individualSnapshot monitor.diagnosticEvent_19.status_diagnosticEvent monitor.diagnosticEvent_2.identifier_diagnosticEvent monitor.diagnosticEvent_2.size_individualSnapshot monitor.diagnosticEvent_2.status_diagnosticEvent monitor.diagnosticEvent_20.identifier_diagnosticEvent monitor.diagnosticEvent_20.size_individualSnapshot monitor.diagnosticEvent_20.status_diagnosticEvent monitor.diagnosticEvent_21.identifier_diagnosticEvent monitor.diagnosticEvent_21.size_individualSnapshot monitor.diagnosticEvent_21.status_diagnosticEvent monitor.diagnosticEvent_22.identifier_diagnosticEvent monitor.diagnosticEvent_22.size_individualSnapshot monitor.diagnosticEvent_22.status_diagnosticEvent monitor.diagnosticEvent_3.identifier_diagnosticEvent monitor.diagnosticEvent_3.size_individualSnapshot monitor.diagnosticEvent_3.status_diagnosticEvent monitor.diagnosticEvent_4.identifier_diagnosticEvent monitor.diagnosticEvent_4.size_individualSnapshot monitor.diagnosticEvent_4.status_diagnosticEvent monitor.diagnosticEvent_5.identifier_diagnosticEvent monitor.diagnosticEvent_5.size_individualSnapshot monitor.diagnosticEvent_5.status_diagnosticEvent monitor.diagnosticEvent_6.identifier_diagnosticEvent monitor.diagnosticEvent_6.size_individualSnapshot monitor.diagnosticEvent_6.status_diagnosticEvent monitor.diagnosticEvent_7.identifier_diagnosticEvent monitor.diagnosticEvent_7.size_individualSnapshot monitor.diagnosticEvent_7.status_diagnosticEvent monitor.diagnosticEvent_8.identifier_diagnosticEvent monitor.diagnosticEvent_8.size_individualSnapshot monitor.diagnosticEvent_8.status_diagnosticEvent monitor.diagnosticEvent_9.identifier_diagnosticEvent monitor.diagnosticEvent_9.size_individualSnapshot monitor.diagnosticEvent_9.status_diagnosticEvent /end REF_MEASUREMENT
/end GROUP
/begin GROUP KBS_Feature "KBS_Feature"
 /begin SUB_GROUP stateOfCharge heatingStrategy currentDerating dataProcessing capacityEstimation /end SUB_GROUP
/end GROUP
/begin GROUP stateOfCharge "stateOfCharge"
 /begin SUB_GROUP parameter_stateOfCharge input_stateOfCharge output_stateOfCharge /end SUB_GROUP
/end GROUP
/begin GROUP parameter_stateOfCharge "parameter_stateOfCharge" /begin SUB_GROUP algorithm_stateOfCharge system_stateOfCharge /end SUB_GROUP /end GROUP
/begin GROUP algorithm_stateOfCharge "algorithm_stateOfCharge"
 /begin REF_CHARACTERISTIC parameter_OCVReferencing_Enable parameter_PWUPReferencing_Enable parameter_SOCFullChargeHysteresis_Enable parameter_SOCFullCharge_Enable parameter_SOCFullDischargeHysteresis_Enable parameter_SOCFullDischarge_Enable parameter_SOCHandler_Enable parameter_SOCHold_Enable parameter_coulombCounting_Enable parameter_fullChargeCurrentHysteresisLimit parameter_fullChargeSOCHysteresisLimit parameter_fullChargeVoltageHysteresisLimit parameter_fullDischargeSOCHysteresisLimit parameter_fullDischargeVoltageHysteresisLimit parameter_maxChangeSOC parameter_minSOCHold_High parameter_minSOCHold_Low parameter_relaxationCurrent parameter_relaxationTime parameter_sleepCompensationCurrent parameter_sleepCompensation_Enable /end REF_CHARACTERISTIC
/end GROUP
/begin GROUP system_stateOfCharge "system_stateOfCharge"
 /begin REF_CHARACTERISTIC parameter_EOCVoltage_Cell parameter_EODVoltage_Cell parameter_chargingCurrentCutOff parameter_dischargingCurrentCutOff parameter_noCellsParallel parameter_noCellsSerial parameter_noModulesParallel parameter_noModulesSerial parameter_selfDischargeResistance_Cell /end REF_CHARACTERISTIC
/end GROUP
/begin GROUP input_stateOfCharge "input_stateOfCharge"
 /begin REF_MEASUREMENT Interface_main_100msrtB.OCV_Map_Cell Interface_main_100msrtB.SOC_Map_Cell Interface_main_100msrtB.avgCellVoltage_Pack Interface_main_100msrtB.cellNumber Interface_main_100msrtB.fullChargeCapacity Interface_main_100msrtB.internalResistanceCharged_Cell Interface_main_100msrtB.internalResistanceDischarged_Cell Interface_main_100msrtB.maxCellVoltage_Pack Interface_main_100msrtB.maxChargeCurrent_Continuous Interface_main_100msrtB.maxDischargeCurrent_Pulse Interface_main_100msrtB.maxSOC Interface_main_100msrtB.minCellVoltage_Pack Interface_main_100msrtB.minSOC buffer_NVM_BMS.cellNumber buffer_NVM_BMS.maxChargeCurrent_Continuous buffer_NVM_BMS.maxDischargeCurrent_Pulse buffer_NVM_BMS.parameter_service_EOC buffer_NVM_BMS.parameter_service_EOD Interface_main_100msrtB.update_input_Values.bus_KBSInput.AhCounter_CurrentSensor Interface_main_100msrtB.update_input_Values.bus_KBSInput.current_Battery Interface_main_100msrtB.update_input_Values.bus_KBSInput.current_CPS Interface_main_100msrtB.update_input_Values.bus_KBSInput.get_balancing_Battery Interface_main_100msrtB.update_input_Values.bus_KBSInput.heatingCurrent_Module Interface_main_100msrtB.update_input_Values.bus_KBSInput.selfDischargeTime Interface_main_100msrtB.update_input_Values.bus_KBSInput.state_BMS Interface_main_100msrtB.update_input_Values.bus_KBSInput.voltageAfterContactors Interface_main_100msrtB.update_input_Values.bus_KBSInput.voltageBeforeContactors Interface_main_100msrtB.update_input_Values.bus_KBSInput.voltage_Cell Interface_main_100msrtB.read_buffer_NVM_BMS_stateOfCharge.NVM_BMS_last_SOC_Handler_Battery Interface_main_100msrtB.read_buffer_NVM_BMS_stateOfCharge.NVM_BMS_last_SOC_Kernel_Battery Interface_main_100msrtB.read_buffer_NVM_BMS_stateOfCharge.NVM_BMS_last_SOC_Kernel_Cell Interface_main_100msrtB.assignLastValues.last_counter_stateOfCharge Interface_main_100msrtB.read_buffer_NVM_BMS_stateOfCharge.NVM_BMS_last_deltaChangeResidual_SOC Interface_main_100msrtB.assignLastValues.last_relaxationTime Interface_main_100msrtB.assignLastValues.last_state_Handler_stateOfCharge Interface_main_100msrtB.assignLastValues.last_state_sleepCompensation_SOC /end REF_MEASUREMENT
/end GROUP
/begin GROUP output_stateOfCharge "output_stateOfCharge"
 /begin REF_MEASUREMENT Interface_main_100msrtB.SOC_Handler_Battery Interface_main_100msrtB.SOC_Kernel_Battery Interface_main_100msrtB.SOC_Kernel_Cell Interface_main_100msrtB.SOC_Kernel_Module Interface_main_100msrtB.SOCwithSOH Interface_main_100msrtB.SOCwithoutSOH Interface_main_100msrtB.deltaChangeResidual_SOC Interface_main_100msrtB.deltaChange_SOC Interface_main_100msrtB.deltaChange_SOC_CCM Interface_main_100msrtB.fullChargeHysteresis_SOC Interface_main_100msrtB.fullDischargeHysteresis_SOC Interface_main_100msrtB.highestSOCImbalance Interface_main_100msrtB.integratedCurrent_Battery Interface_main_100msrtB.relaxationTime Interface_main_100msrtB.state_Handler_stateOfCharge Interface_main_100msrtB.state_Kernel_stateOfCharge Interface_main_100msrtB.state_relaxation_SOC Interface_main_100msrtB.state_sleepCompensation_SOC buffer_NVM_BMS.SOC_Handler_Battery buffer_NVM_BMS.SOC_Kernel_Battery buffer_NVM_BMS.SOC_Kernel_Cell buffer_NVM_BMS.deltaChangeResidual_SOC /end REF_MEASUREMENT
/end GROUP
/begin GROUP heatingStrategy "heatingStrategy"
 /begin SUB_GROUP parameter_heatingStrategy input_heatingStrategy output_heatingStrategy /end SUB_GROUP
/end GROUP
/begin GROUP parameter_heatingStrategy "parameter_heatingStrategy" /begin SUB_GROUP algorithm_heatingStrategy system_heatingStrategy /end SUB_GROUP /end GROUP
/begin GROUP algorithm_heatingStrategy "algorithm_heatingStrategy"
 /begin REF_CHARACTERISTIC parameter_abortThreshold_Heating parameter_defaultHeatingCurrent_Module parameter_fullChargeSOC_Preheat parameter_heatingCalculation_Enable parameter_lowerThresholdHeatingEnergy parameter_maxTemperatureHysteresis_Heating parameter_maxTemperature_Heating parameter_minSOC_Drive parameter_minTemperature_Drive parameter_targetTemperatureHysteresis_Heating parameter_targetTemperature_Heating parameter_upperThresholdHeatingEnergy /end REF_CHARACTERISTIC
/end GROUP
/begin GROUP system_heatingStrategy "system_heatingStrategy"
 /begin REF_CHARACTERISTIC bins_temperature_ModuleTable parameter_chargingCurrentCutOff parameter_heatingFoil_Configuration parameter_mechanicalCoordinates parameter_moduleArrangement parameter_moduleElectricalConnection parameter_noCellsParallel parameter_noCellsSerial parameter_noModulesParallel parameter_noModulesSerial table_heatingFoilResistance /end REF_CHARACTERISTIC
/end GROUP
/begin GROUP input_heatingStrategy "input_heatingStrategy"
 /begin REF_MEASUREMENT Interface_main_100msrtB.SOC_Kernel_Module Interface_main_100msrtB.SOCwithSOH Interface_main_100msrtB.maxChargeCurrent_Continuous_woHeating Interface_main_100msrtB.maxTemperature_Module Interface_main_100msrtB.maxTemperature_Pack Interface_main_100msrtB.minTemperature_Module Interface_main_100msrtB.minTemperature_Pack buffer_NVM_BMS.parameter_service_PWUPHeating_Enable Interface_main_100msrtB.update_input_Values.bus_KBSInput.current_Battery Interface_main_100msrtB.update_input_Values.bus_KBSInput.get_heating_Module Interface_main_100msrtB.update_input_Values.bus_KBSInput.heatingCurrent_Module Interface_main_100msrtB.update_input_Values.bus_KBSInput.state_BMS Interface_main_100msrtB.update_input_Values.bus_KBSInput.state_Charger Interface_main_100msrtB.update_input_Values.bus_KBSInput.state_Truck Interface_main_100msrtB.update_input_Values.bus_KBSInput.voltageAfterContactors Interface_main_100msrtB.update_input_Values.bus_KBSInput.voltageBeforeContactors Interface_main_100msrtB.assignLastValues.last_counter_heatingStrategy Interface_main_100msrtB.read_buffer_NVM_BMS_heatingStrategy.NVM_BMS_last_heatingEnergy_Module Interface_main_100msrtB.read_buffer_NVM_BMS_heatingStrategy.NVM_BMS_last_minHeatingEnergy_String Interface_main_100msrtB.read_buffer_NVM_BMS_heatingStrategy.NVM_BMS_last_state_energyBalance_Module Interface_main_100msrtB.read_buffer_NVM_BMS_heatingStrategy.NVM_BMS_last_state_temperature_Module /end REF_MEASUREMENT
/end GROUP
/begin GROUP output_heatingStrategy "output_heatingStrategy"
 /begin REF_MEASUREMENT Interface_main_100msrtB.avgCurrent_Heating Interface_main_100msrtB.heatingEnergyImbalance_Module Interface_main_100msrtB.heatingEnergy_Module Interface_main_100msrtB.heatingTime Interface_main_100msrtB.hysteresisTemperature_Heating Interface_main_100msrtB.maxCurrent_Heating Interface_main_100msrtB.minCurrent_Heating Interface_main_100msrtB.minHeatingEnergy_String Interface_main_100msrtB.set_heating_Module Interface_main_100msrtB.state_Kernel_heatingStrategy Interface_main_100msrtB.state_energyBalance_Module Interface_main_100msrtB.state_heating_Battery Interface_main_100msrtB.state_temperature_Module Interface_main_100msrtB.targetTemperature_Heating Interface_main_100msrtB.totalCurrent_Heating buffer_NVM_BMS.heatingEnergy_Module buffer_NVM_BMS.minHeatingEnergy_String buffer_NVM_BMS.state_energyBalance_Module buffer_NVM_BMS.state_temperature_Module /end REF_MEASUREMENT
/end GROUP
/begin GROUP currentDerating "currentDerating"
 /begin SUB_GROUP parameter_currentDerating input_currentDerating output_currentDerating /end SUB_GROUP
/end GROUP
/begin GROUP parameter_currentDerating "parameter_currentDerating" /begin SUB_GROUP algorithm_currentDerating system_currentDerating /end SUB_GROUP /end GROUP
/begin GROUP algorithm_currentDerating "algorithm_currentDerating"
 /begin REF_CHARACTERISTIC parameter_BCMCheck_Enable parameter_EOCLimiter_Enable parameter_EOCVoltageOffset_Cell parameter_EODVoltageOffset_Cell parameter_PIDController_Enable parameter_batteryLimiter_Enable parameter_cellLookupLimiter_Enable parameter_cellModelLimiter_Enable parameter_chargeLimiter_Enable parameter_chargeVoltageHysteresis_Cell parameter_chargeVoltagePulse_Cell parameter_chargingCurrentContinuousFilter_Enable parameter_chargingCurrentPulseFilter_Enable parameter_coefficient_PIDController parameter_currentLimit_LinearToConstant parameter_currentLimit_RelativeToLinear parameter_deratingCutOff_Enable parameter_deratingSOC_EOC parameter_deratingSOC_EOD parameter_derivative_PIDController parameter_dischargeLimiter_Enable parameter_dischargeVoltageHysteresis_Cell parameter_dischargeVoltagePulse_Cell parameter_dischargingCurrentContinuousFilter_Enable parameter_dischargingCurrentPulseFilter_Enable parameter_driveLimiter_Enable parameter_driveVoltageHysteresis_Cell parameter_gain_PIDController parameter_integral_PIDController parameter_maxCellVoltageFactor_Min parameter_maxDriveFactor_Min parameter_maxLinearChangeRate_Current parameter_maxRegenerationFactor_Min parameter_maxRelativeChangeRate_ChargingCurrent parameter_maxRelativeChangeRate_Current parameter_maxVoltageHysteresis_Cell parameter_minCellVoltageFactor_Min parameter_minVoltageHysteresis_Cell parameter_regenerationLimiter_Enable parameter_regenerativeVoltageHysteresis_Cell /end REF_CHARACTERISTIC
/end GROUP
/begin GROUP system_currentDerating "system_currentDerating"
 /begin REF_CHARACTERISTIC bins_PWM bins_SOC_CellMap bins_SOC_CurrentMap bins_temperature_CellMap bins_temperature_CurrentMap map_OCV map_chargingCurrent_Continuous map_chargingCurrent_Pulse map_chargingInternalResistance map_dischargingCurrent_Continuous map_dischargingCurrent_Pulse map_dischargingInternalResistance parameter_EOCVoltage_Cell parameter_EODVoltage_Cell parameter_chargingCurrentCutOff parameter_chargingCurrentCutOff_Reset parameter_driveVoltage_Cell parameter_maxChargingCurrent_Continuous parameter_maxChargingCurrent_Pulse parameter_maxCurrent_BrakingResistance parameter_maxDischargingCurrent_Continuous parameter_maxDischargingCurrent_Pulse parameter_noCellsParallel parameter_noCellsSerial parameter_noModulesParallel parameter_noModulesSerial parameter_regenerativeVoltage_Cell table_powerCapability /end REF_CHARACTERISTIC
/end GROUP
/begin GROUP input_currentDerating "input_currentDerating"
 /begin REF_MEASUREMENT Interface_main_100msrtB.SOC_Handler_Battery Interface_main_100msrtB.SOC_Kernel_Battery Interface_main_100msrtB.avgTemperature_Pack Interface_main_100msrtB.maxCellVoltage_Pack Interface_main_100msrtB.maxSOC Interface_main_100msrtB.maxTemperature_Pack Interface_main_100msrtB.minCellVoltage_Pack Interface_main_100msrtB.minTemperature_Pack Interface_main_100msrtB.totalCurrent_Heating buffer_NVM_BMS.SOC_Handler_Battery buffer_NVM_BMS.SOC_Kernel_Battery buffer_NVM_BMS.parameter_service_diagnosticDerating Interface_main_100msrtB.update_input_Values.bus_KBSInput.current_Battery Interface_main_100msrtB.update_input_Values.bus_KBSInput.factorPowerReduction Interface_main_100msrtB.update_input_Values.bus_KBSInput.get_PWM_BCM Interface_main_100msrtB.update_input_Values.bus_KBSInput.get_balancing_Battery Interface_main_100msrtB.update_input_Values.bus_KBSInput.get_enable_BCM Interface_main_100msrtB.update_input_Values.bus_KBSInput.state_BMS Interface_main_100msrtB.assignLastValues.last_PWM_BCM_Out Interface_main_100msrtB.assignLastValues.last_counter_currentDerating Interface_main_100msrtB.read_buffer_NVM_BMS_currentDerating.NVM_BMS_last_deratingFactor_MaxCellVoltage Interface_main_100msrtB.read_buffer_NVM_BMS_currentDerating.NVM_BMS_last_deratingFactor_MaxDrive Interface_main_100msrtB.read_buffer_NVM_BMS_currentDerating.NVM_BMS_last_deratingFactor_MaxRegeneration Interface_main_100msrtB.read_buffer_NVM_BMS_currentDerating.NVM_BMS_last_deratingFactor_MinCellVoltage Interface_main_100msrtB.read_buffer_NVM_BMS_currentDerating.NVM_BMS_last_maxChargeCurrent_Continuous Interface_main_100msrtB.read_buffer_NVM_BMS_currentDerating.NVM_BMS_last_maxChargeCurrent_Pulse Interface_main_100msrtB.read_buffer_NVM_BMS_currentDerating.NVM_BMS_last_maxDischargeCurrent_Continuous Interface_main_100msrtB.read_buffer_NVM_BMS_currentDerating.NVM_BMS_last_maxDischargeCurrent_Pulse /end REF_MEASUREMENT
/end GROUP
/begin GROUP output_currentDerating "output_currentDerating"
 /begin REF_MEASUREMENT Interface_main_100msrtB.PWM_BCM_Out Interface_main_100msrtB.capabilityFactor_BrakingResistor Interface_main_100msrtB.correctionFactor_RelativeChange Interface_main_100msrtB.correctionFactor_RelativeChange_Charging Interface_main_100msrtB.currentLimited Interface_main_100msrtB.deratingFactor_MaxCellVoltage Interface_main_100msrtB.deratingFactor_MaxDrive Interface_main_100msrtB.deratingFactor_MaxRegeneration Interface_main_100msrtB.deratingFactor_MinCellVoltage Interface_main_100msrtB.impedance_Battery Interface_main_100msrtB.linearChange Interface_main_100msrtB.maxChargeCurrent_Continuous Interface_main_100msrtB.maxChargeCurrent_Continuous_woHeating Interface_main_100msrtB.maxChargeCurrent_Pulse Interface_main_100msrtB.maxChargeCurrent_Pulse_Balancing Interface_main_100msrtB.maxChargePower_Continuous Interface_main_100msrtB.maxChargePower_Pulse Interface_main_100msrtB.maxDeratingFactor Interface_main_100msrtB.maxDeratingFactor_Charging Interface_main_100msrtB.maxDischargeCurrent_Continuous Interface_main_100msrtB.maxDischargeCurrent_Pulse Interface_main_100msrtB.maxDischargeCurrent_Pulse_Balancing Interface_main_100msrtB.maxDischargePower_Continuous Interface_main_100msrtB.maxDischargePower_Pulse buffer_NVM_BMS.deratingFactor_MaxCellVoltage buffer_NVM_BMS.deratingFactor_MaxDrive buffer_NVM_BMS.deratingFactor_MaxRegeneration buffer_NVM_BMS.deratingFactor_MinCellVoltage buffer_NVM_BMS.maxChargeCurrent_Continuous buffer_NVM_BMS.maxChargeCurrent_Pulse buffer_NVM_BMS.maxDischargeCurrent_Continuous buffer_NVM_BMS.maxDischargeCurrent_Pulse /end REF_MEASUREMENT
/end GROUP
/begin GROUP dataProcessing "dataProcessing"
 /begin SUB_GROUP parameter_dataProcessing input_dataProcessing output_dataProcessing /end SUB_GROUP
/end GROUP
/begin GROUP parameter_dataProcessing "parameter_dataProcessing" /begin SUB_GROUP algorithm_dataProcessing system_dataProcessing /end SUB_GROUP /end GROUP
/begin GROUP algorithm_dataProcessing "algorithm_dataProcessing"
 /begin REF_CHARACTERISTIC parameter_SOCLimits_Enable parameter_calculateTemperature_Enable parameter_calculateVoltage_Enable parameter_cellDataLookup_Enable parameter_gain_Filter parameter_samplingTime_Filter parameter_temperatureFilter_Enable parameter_timeConstant_Filter /end REF_CHARACTERISTIC
/end GROUP
/begin GROUP system_dataProcessing "system_dataProcessing"
 /begin REF_CHARACTERISTIC bins_SOC_CellMap bins_temperature_CellMap bins_temperature_ModuleTable map_OCV map_chargingInternalResistance map_dischargingInternalResistance parameter_NTC_Configuration parameter_factory_EOC parameter_factory_EOD parameter_noCellsParallel parameter_noCellsSerial parameter_noModulesParallel parameter_noModulesSerial parameter_nominal_EOC parameter_nominal_EOD table_capacity /end REF_CHARACTERISTIC
/end GROUP
/begin GROUP input_dataProcessing "input_dataProcessing"
 /begin REF_MEASUREMENT Interface_main_100msrtB.SOC_Kernel_Cell buffer_NVM_BMS.SOC_Kernel_Cell buffer_NVM_BMS.parameter_service_EOC buffer_NVM_BMS.parameter_service_EOD Interface_main_100msrtB.update_input_Values.bus_KBSInput.temperature_Sensor Interface_main_100msrtB.update_input_Values.bus_KBSInput.voltage_Cell Interface_main_100msrtB.assignLastValues.last_OCV_Map_Cell Interface_main_100msrtB.assignLastValues.last_SOC_Map_Cell Interface_main_100msrtB.assignLastValues.last_capacity_Table_Cell Interface_main_100msrtB.read_buffer_NVM_BMS_dataProcessing.NVM_BMS_last_cellNumber Interface_main_100msrtB.assignLastValues.last_counter_dataProcessing Interface_main_100msrtB.assignLastValues.last_internalResistanceCharged_Cell Interface_main_100msrtB.assignLastValues.last_internalResistanceDischarged_Cell /end REF_MEASUREMENT
/end GROUP
/begin GROUP output_dataProcessing "output_dataProcessing"
 /begin REF_MEASUREMENT Interface_main_100msrtB.OCV_Map_Cell Interface_main_100msrtB.SOC_Map_Cell Interface_main_100msrtB.avgCellVoltage_Module Interface_main_100msrtB.avgCellVoltage_Pack Interface_main_100msrtB.avgTemperature_Module Interface_main_100msrtB.avgTemperature_Pack Interface_main_100msrtB.capacity_Table_Cell Interface_main_100msrtB.cellNumber Interface_main_100msrtB.internalResistanceCharged_Cell Interface_main_100msrtB.internalResistanceDischarged_Cell Interface_main_100msrtB.maxCellVoltage_Module Interface_main_100msrtB.maxCellVoltage_Pack Interface_main_100msrtB.maxSOC Interface_main_100msrtB.maxTemperature_Module Interface_main_100msrtB.maxTemperature_Pack Interface_main_100msrtB.minCellVoltage_Module Interface_main_100msrtB.minCellVoltage_Pack Interface_main_100msrtB.minSOC Interface_main_100msrtB.minTemperature_Module Interface_main_100msrtB.minTemperature_Pack Interface_main_100msrtB.voltage_Module buffer_NVM_BMS.cellNumber /end REF_MEASUREMENT
/end GROUP
/begin GROUP capacityEstimation "capacityEstimation"
 /begin SUB_GROUP parameter_capacityEstimation input_capacityEstimation output_capacityEstimation /end SUB_GROUP
/end GROUP
/begin GROUP parameter_capacityEstimation "parameter_capacityEstimation" /begin SUB_GROUP algorithm_capacityEstimation system_capacityEstimation /end SUB_GROUP /end GROUP
/begin GROUP algorithm_capacityEstimation "algorithm_capacityEstimation"
 /begin REF_CHARACTERISTIC parameter_designCapacity_Enable parameter_fullChargeCapacity_Enable parameter_fullChargeEnergy_Enable parameter_remainingCapacity_Enable /end REF_CHARACTERISTIC
/end GROUP
/begin GROUP system_capacityEstimation "system_capacityEstimation"
 /begin REF_CHARACTERISTIC parameter_designCapacity_BOL_Cell parameter_factory_EOC parameter_factory_EOD parameter_noCellsParallel parameter_noCellsSerial parameter_noModulesParallel parameter_noModulesSerial parameter_nominalVoltage_Cell parameter_nominal_EOC parameter_nominal_EOD /end REF_CHARACTERISTIC
/end GROUP
/begin GROUP input_capacityEstimation "input_capacityEstimation"
 /begin REF_MEASUREMENT Interface_main_100msrtB.SOC_Kernel_Battery Interface_main_100msrtB.SOC_Kernel_Cell Interface_main_100msrtB.SOCwithSOH Interface_main_100msrtB.capacity_Table_Cell buffer_NVM_BMS.SOC_Kernel_Battery buffer_NVM_BMS.SOC_Kernel_Cell buffer_NVM_BMS.parameter_service_EOC buffer_NVM_BMS.parameter_service_EOD Interface_main_100msrtB.update_input_Values.bus_KBSInput.state_BMS Interface_main_100msrtB.assignLastValues.last_counter_capacityEstimation /end REF_MEASUREMENT
/end GROUP
/begin GROUP output_capacityEstimation "output_capacityEstimation"
 /begin REF_MEASUREMENT Interface_main_100msrtB.designCapacity_BOL Interface_main_100msrtB.designCapacity_SOH Interface_main_100msrtB.fullChargeCapacity Interface_main_100msrtB.fullChargeCapacity_Max Interface_main_100msrtB.fullChargeCapacity_Useable Interface_main_100msrtB.fullChargeEnergy Interface_main_100msrtB.fullChargeEnergy_Max Interface_main_100msrtB.fullChargeEnergy_Useable Interface_main_100msrtB.remainingCapacity_Actual Interface_main_100msrtB.remainingCapacity_Actual_Cell Interface_main_100msrtB.remainingCapacity_Useable Interface_main_100msrtB.useableSOC_Factory Interface_main_100msrtB.useableSOC_Service Interface_main_100msrtB.useableSOH_Nominal /end REF_MEASUREMENT
/end GROUP
/end MODULE
/end PROJECT
/* (add any file trailer comments here) */
/* EOF BMSAlgorithmInterface.a2l*/
